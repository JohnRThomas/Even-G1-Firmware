## CMakeLists.txt
```
# JBD013 panel: SPIM callbacks and panel drivers on the nrfx SPIM fakes.
cmake_minimum_required(VERSION 3.20.0)
include(${CMAKE_CURRENT_LIST_DIR}/../common/unit_setup.cmake)
project(unit_panel)

g1_unit_firmware(spim_spis/spim.c panel_display/jbd013_api.c panel_display/hal_driver.c
                 panel_display/jbd_panel_flush.c panel_display/panel_fb.c)
g1_unit_fakes(nrfx log)
target_sources(app PRIVATE
  src/panel_support.c
  src/test_spim.c
  src/test_panel_cmd.c
  src/test_panel_init.c
  src/test_panel_power.c
  src/test_panel_brightness.c
  src/test_panel_flush.c
  src/test_panel_fb.c
)
target_include_directories(app PRIVATE src)
```

## prj.conf
```kconfig
# the 64 KB frame buffer and the harness state exceed the common arena
CONFIG_COMMON_LIBC_MALLOC_ARENA_SIZE=245760
```

## src/panel_support.c
```c
/* jbd_panel.c is #included so its static register cache can be reset. */
#include <stdio.h>
#include <stdlib.h>
#include <string.h>
#include <zephyr/ztest.h>

#include "harness.h"
#include "panel_support.h"

#include "panel_display/jbd_panel.c"

DEFINE_FAKE_VALUE_FUNC(int, getDeviceRole);
DEFINE_FAKE_VALUE_FUNC(int, power_for_panel);
DEFINE_FAKE_VALUE_FUNC(int, power_down_panel);
DEFINE_FAKE_VALUE_FUNC(int, opt3007_chip_init, struct opt3007_context *);
DEFINE_FAKE_VOID_FUNC(opt3007_chip_deinit);
DEFINE_FAKE_VALUE_FUNC(int, panel_related, struct jbd_panel_context *, int, void *);

struct panel_calls panel_calls;

static int power_for_panel_record(void)
{
	panel_calls.power_on_at = g1_fake_spim.count;
	return 0;
}

static int power_down_panel_record(void)
{
	panel_calls.power_down_at = g1_fake_spim.count;
	return 0;
}

static int opt3007_chip_init_record(struct opt3007_context *ctx)
{
	ARG_UNUSED(ctx);
	panel_calls.opt_init_at = g1_fake_spim.count;
	return 0;
}

static void opt3007_chip_deinit_record(void)
{
	panel_calls.opt_deinit_at = g1_fake_spim.count;
}

struct jbd_panel_context *panel_ctx(void)
{
	return &g1_state()->panel;
}

struct spi_master_ctx *panel_spi(void)
{
	return &g1_state()->spi;
}

uint8_t **panel_fb(void)
{
	return g1_state()->panel.panel_buffer;
}

uint8_t *panel_frame(void)
{
	return g1_state()->panel.current_buffer;
}

void panel_spi_up(void)
{
	struct spi_master_ctx *spi = panel_spi();

	zassert_equal(spi->init_cb(spi), 0);
	zassert_equal(spi->is_initialized, 1, "SPI init failed");
	g1_fake_spim_clear_log();
}

void panel_running(void)
{
	panel_spi_up();
	panel_ctx()->spi_callbacks = panel_spi();
	panel_ctx()->init_done = 1;
}

void panel_answer_id(void)
{
	/* JBD013 ID 0xBD 0x4010, after one high-Z byte */
	static const uint8_t id[] = {0x00, 0xbd, 0x40, 0x10};

	g1_fake_spim_respond(0x9f, id, sizeof(id));
}

void panel_reset_reg_cache(void)
{
	JBD_LUM_REG_VAL = 0;
	JBD_CUR_REG_VAL = 0;
}

int panel_cached_lum(void)
{
	return JBD_LUM_REG_VAL;
}

int panel_cached_cur(void)
{
	return JBD_CUR_REG_VAL;
}

int panel_xfer_count(void)
{
	int n = 0;

	for (int i = 0; i < g1_fake_spim.count; i++) {
		n += g1_fake_spim.log[i].op == G1_SPIM_OP_XFER;
	}
	return n;
}

const struct g1_spim_entry *panel_xfer(int n)
{
	int i = g1_fake_spim_xfer_index(n);

	return i < 0 ? NULL : &g1_fake_spim.log[i];
}

static void hex_short(const uint8_t *b, size_t len, char *out, size_t size)
{
	g1_hex_format(b, MIN(len, (size_t)24), out, size);
}

bool panel_xfer_check(int n, const char *hex, char *msg, size_t size)
{
	static uint8_t want[64];
	const struct g1_spim_entry *e = panel_xfer(n);
	char got_s[128], want_s[128];
	int len = g1_hex_parse(hex, want, sizeof(want));

	if (len < 0) {
		snprintf(msg, size, "bad expected hex \"%s\"", hex);
		return false;
	}
	g1_hex_format(want, len, want_s, sizeof(want_s));
	if (e == NULL) {
		snprintf(msg, size, "transfer %d: none (%d transfers), expected %s", n,
			 panel_xfer_count(), want_s);
		return false;
	}
	if (e->inst != PANEL_SPI_BUS || e->result != NRFX_SUCCESS || e->mosi == NULL) {
		snprintf(msg, size, "transfer %d: SPIM%u result 0x%x mosi %p, expected %s on SPIM4", n,
			 e->inst, e->result, (const void *)e->mosi, want_s);
		return false;
	}
	hex_short(e->mosi, e->len, got_s, sizeof(got_s));
	if (e->len != (size_t)len || memcmp(e->mosi, want, len) != 0) {
		snprintf(msg, size, "transfer %d:\n  got      (%zu) %s\n  expected (%d) %s", n, e->len,
			 got_s, len, want_s);
		return false;
	}
	return true;
}

void panel_journal_line(const struct g1_spim_entry *e, char *out, size_t size)
{
	const uint8_t *b = e->mosi;
	size_t o;

	if (e->len == 0 || b == NULL) {
		snprintf(out, size, "(nothing clocked)");
		return;
	}
	if (b[0] == SPI_WR_BUFFER && e->len >= 6) {
		uint32_t coord = (((uint32_t)b[1] << 16) | ((uint32_t)b[2] << 8) | b[3]) & 0x7ffff;

		snprintf(out, size, "02 x=%u y=%u bytes=%u", (unsigned int)(coord & 0x3ff),
			 (unsigned int)((coord >> 10) & 0x1ff), (unsigned int)(e->len - 6));
		return;
	}
	o = snprintf(out, size, "%02X", b[0]);
	if (e->len > 1 && o + 1 < size) {
		out[o++] = ' ';
		out[o] = '\0';
		for (size_t i = 1; i < e->len && o + 3 <= size; i++) {
			o += snprintf(out + o, size - o, "%02X", b[i]);
		}
	}
}

bool panel_journal_check(int first, const char *const *lines, int n, char *msg, size_t size)
{
	char got[64];

	for (int i = 0; i < n; i++) {
		const struct g1_spim_entry *e = panel_xfer(first + i);

		if (e == NULL) {
			snprintf(msg, size, "journal entry %d: no transfer, expected \"%s\"", i,
				 lines[i]);
			return false;
		}
		panel_journal_line(e, got, sizeof(got));
		if (strcmp(got, lines[i]) != 0) {
			snprintf(msg, size, "journal entry %d (transfer %d): got \"%s\", expected \"%s\"",
				 i, first + i, got, lines[i]);
			return false;
		}
	}
	return true;
}

static void panel_rule_before(const struct ztest_unit_test *test, void *data)
{
	struct GlassesState *gs = g1_state();

	ARG_UNUSED(test);
	ARG_UNUSED(data);

	RESET_FAKE(getDeviceRole);
	RESET_FAKE(power_for_panel);
	RESET_FAKE(power_down_panel);
	RESET_FAKE(opt3007_chip_init);
	RESET_FAKE(opt3007_chip_deinit);
	RESET_FAKE(panel_related);
	power_for_panel_fake.custom_fake = power_for_panel_record;
	power_down_panel_fake.custom_fake = power_down_panel_record;
	opt3007_chip_init_fake.custom_fake = opt3007_chip_init_record;
	opt3007_chip_deinit_fake.custom_fake = opt3007_chip_deinit_record;
	panel_calls = (struct panel_calls){-1, -1, -1, -1};

	gs->spi.is_initialized = 0;
	gs->spi.pins[0] = PANEL_SPI_BUS;
	gs->spi.pins[1] = PANEL_SPI_SCK;
	gs->spi.pins[2] = PANEL_SPI_MOSI;
	gs->spi.pins[3] = PANEL_SPI_MISO;
	gs->spi.ss = PANEL_SPI_SS;
	gs->spi.speed_mhz = PANEL_SPI_MHZ;
	spi_master_register_context(&gs->spi);
	register_jdb_panel_context(&gs->panel);
	zassert_true((uintptr_t)gs->panel.current_buffer != 5, "frame buffer allocation failed");

	gs->panel.panel_brightness_level = PANEL_DEFAULT_LEVEL;
	gs->panel.lum_gear = PANEL_DEFAULT_LUMGEAR;
	gs->panel.brightness_max = PANEL_DEFAULT_LUMGEAR;
	gs->panel.brightness_percent = 100;

	panel_reset_reg_cache();
	JDB_PANEL_ID = 0;
}

static void panel_rule_after(const struct ztest_unit_test *test, void *data)
{
	struct GlassesState *gs = g1_state();

	ARG_UNUSED(test);
	ARG_UNUSED(data);

	if (gs->panel.current_buffer) {
		free(gs->panel.current_buffer - 5);
		gs->panel.current_buffer = NULL;
	}
}

ZTEST_RULE(panel_support, panel_rule_before, panel_rule_after);
```

## src/panel_support.h
```c
/* Each test starts with the SPI wired but closed and factory brightness. */
#ifndef PANEL_SUPPORT_H_
#define PANEL_SUPPORT_H_

#include <stdbool.h>
#include <stddef.h>
#include <stdint.h>
#include <zephyr/fff.h>
#include <glasses_state.h>

#include "fakes_nrfx.h"
#include "panel_display/panel.h"
#include "spim_spis/spim.h"

#define PANEL_SPI_BUS  4
#define PANEL_SPI_SCK  8
#define PANEL_SPI_MOSI 9
#define PANEL_SPI_MISO 10
#define PANEL_SPI_SS   11
#define PANEL_SPI_MHZ  32

#define PANEL_DEFAULT_LEVEL   0x15
#define PANEL_DEFAULT_LUMGEAR 0x3f

/* the lens draws 640x200 */
#define JBD_ROW_BYTES 320
#define FRAME_ROWS    200
#define FRAME_BYTES   (FRAME_ROWS * JBD_ROW_BYTES)

/* no firmware header declares these */
int panel_set_brightness_level(struct jbd_panel_context *c, uint8_t level);
int panel_suspend(struct jbd_panel_context *c);
int panel_off(struct jbd_panel_context *c);
int panel_resume(struct jbd_panel_context *c);
int panel_on(struct jbd_panel_context *c);
int jdb_panel_init(struct jbd_panel_context *c);

DECLARE_FAKE_VALUE_FUNC(int, getDeviceRole);
DECLARE_FAKE_VALUE_FUNC(int, power_for_panel);
DECLARE_FAKE_VALUE_FUNC(int, power_down_panel);
DECLARE_FAKE_VALUE_FUNC(int, opt3007_chip_init, struct opt3007_context *);
DECLARE_FAKE_VOID_FUNC(opt3007_chip_deinit);
DECLARE_FAKE_VALUE_FUNC(int, panel_related, struct jbd_panel_context *, int, void *);

/* SPIM log index at each fake's last call, -1 if none */
struct panel_calls {
	int power_on_at;
	int power_down_at;
	int opt_init_at;
	int opt_deinit_at;
};
extern struct panel_calls panel_calls;

struct jbd_panel_context *panel_ctx(void);
struct spi_master_ctx *panel_spi(void);
uint8_t **panel_fb(void);
uint8_t *panel_frame(void);

void panel_spi_up(void);
/* init_done without the init transactions */
void panel_running(void);
void panel_answer_id(void);

void panel_reset_reg_cache(void);
int panel_cached_lum(void);
int panel_cached_cur(void);

int panel_xfer_count(void);
const struct g1_spim_entry *panel_xfer(int n);
bool panel_xfer_check(int n, const char *hex, char *msg, size_t size);
/* cache writes: "02 x=<x> y=<y> bytes=<n>", n without the last byte */
void panel_journal_line(const struct g1_spim_entry *e, char *out, size_t size);
bool panel_journal_check(int first, const char *const *lines, int n, char *msg, size_t size);

#define PANEL_MSG_SIZE 2048

#define expect_xfer(n, hex)                                                                        \
	do {                                                                                       \
		static char _p_msg[PANEL_MSG_SIZE];                                                \
		zassert_true(panel_xfer_check((n), (hex), _p_msg, sizeof(_p_msg)), "%s", _p_msg); \
	} while (0)

#define expect_journal(first, lines, n)                                                            \
	do {                                                                                       \
		static char _p_msg[PANEL_MSG_SIZE];                                                \
		zassert_true(panel_journal_check((first), (lines), (n), _p_msg, sizeof(_p_msg)),   \
			     "%s", _p_msg);                                                        \
	} while (0)

#endif /* PANEL_SUPPORT_H_ */
```

## src/test_panel_brightness.c
```c
/*
 * Brightness level to LUM (36h) / CUR (46h). At lum gear 63, level 0 is LUM 14 * 111 = 0x0612, CUR
 * 0; levels from 6 have LUM 64 * 111 = 0x1BC0, CUR level - 6.
 */
#include <stdio.h>
#include <string.h>
#include <zephyr/ztest.h>

#include "harness.h"
#include "panel_support.h"

#define LUM_MAX_90HZ 7109
#define CUR_MAX      63
#define LEVEL_MAX    0x2a

ZTEST_SUITE(panel_brightness, NULL, NULL, NULL, NULL, NULL);

static void curve(uint8_t level, uint16_t *lum, uint8_t *cur)
{
	*lum = 0xdead;
	*cur = 0xee;
	update_brightness_level_for_jdb_panel(level, lum, cur);
}

static void set_gear(uint16_t gear)
{
	panel_ctx()->lum_gear = gear;
	panel_ctx()->brightness_max = gear;
}

ZTEST(panel_brightness, test_curve_end_points_at_the_factory_gear)
{
	uint16_t lum;
	uint8_t cur;

	curve(0, &lum, &cur);
	zassert_equal(lum, 0x0612, "level 0: LUM 0x%04x", lum);
	zassert_equal(cur, 0);

	curve(LEVEL_MAX, &lum, &cur);
	zassert_equal(lum, 0x1bc0, "level 0x2a: LUM 0x%04x", lum);
	zassert_equal(cur, 36);
}

ZTEST(panel_brightness, test_curve_stays_in_the_register_ranges_for_every_gear)
{
	for (uint16_t gear = 0; gear <= 63; gear++) {
		set_gear(gear);
		for (int level = 0; level <= LEVEL_MAX; level++) {
			uint16_t lum;
			uint8_t cur;

			curve(level, &lum, &cur);
			zassert_true(lum >= 1 && lum <= LUM_MAX_90HZ, "gear %u level %d: LUM %u",
				     gear, level, lum);
			zassert_true(cur <= CUR_MAX, "gear %u level %d: CUR %u", gear, level, cur);
		}
	}
}

/* 1 brighter, 0 same, -1 darker */
static int level_step(int level)
{
	uint16_t lum0, lum1;
	uint8_t cur0, cur1;

	curve(level - 1, &lum0, &cur0);
	curve(level, &lum1, &cur1);
	if (lum1 < lum0 || cur1 < cur0) {
		return -1;
	}
	return (lum1 > lum0 || cur1 > cur0) ? 1 : 0;
}

ZTEST(panel_brightness, test_every_level_step_is_brighter_at_the_factory_gear)
{
	for (int level = 1; level <= LEVEL_MAX; level++) {
		zassert_equal(level_step(level), 1, "level %d is not brighter than level %d",
			      level, level - 1);
	}
}

/* integer steps repeat values at low gears */
ZTEST(panel_brightness, test_no_level_step_is_darker_for_any_gear)
{
	for (uint16_t gear = 0; gear <= 63; gear++) {
		set_gear(gear);
		for (int level = 1; level <= LEVEL_MAX; level++) {
			zassert_true(level_step(level) >= 0, "gear %u: level %d darker than %d", gear,
				     level, level - 1);
		}
	}
}

ZTEST(panel_brightness, test_levels_below_6_ramp_lum_at_the_lowest_current)
{
	uint16_t full, lum;
	uint8_t cur;

	curve(6, &full, &cur);
	zassert_equal(cur, 0);
	for (int level = 0; level <= 5; level++) {
		curve(level, &lum, &cur);
		zassert_equal(cur, 0, "level %d", level);
		zassert_true(lum < full, "level %d: LUM %u, full scale %u", level, lum, full);
	}
}

/* includes the factory level 0x15, which the panel init sequence writes as LUM 0x1BC0, CUR 0x0F */
ZTEST(panel_brightness, test_levels_from_6_raise_the_current_one_step_each)
{
	uint16_t lum;
	uint8_t cur;

	for (int level = 6; level <= LEVEL_MAX; level++) {
		curve(level, &lum, &cur);
		zassert_equal(lum, 0x1bc0, "level %d", level);
		zassert_equal(cur, level - 6, "level %d", level);
	}
}

ZTEST(panel_brightness, test_percent_scales_lum_only)
{
	uint16_t lum;
	uint8_t cur;

	panel_ctx()->brightness_percent = 80;
	curve(PANEL_DEFAULT_LEVEL, &lum, &cur);
	zassert_equal(lum, 5683); /* 7104 * 80 / 100 */
	zassert_equal(cur, 0x0f);

	panel_ctx()->brightness_percent = 70;
	curve(PANEL_DEFAULT_LEVEL, &lum, &cur);
	zassert_equal(lum, 4972); /* 7104 * 70 / 100 */

	panel_ctx()->brightness_percent = 100;
	curve(PANEL_DEFAULT_LEVEL, &lum, &cur);
	zassert_equal(lum, 0x1bc0);
}

ZTEST(panel_brightness, test_lowest_settings_keep_the_panel_lit)
{
	uint16_t lum;
	uint8_t cur;

	set_gear(0);
	panel_ctx()->brightness_percent = 70;
	curve(0, &lum, &cur);

	zassert_equal(lum, 1);
	zassert_equal(cur, 0);
}

/* Defect: no level range check; from 0x46, CUR = level - 6 sets the reserved bits 7:6. */
ZTEST_EXPECT_FAIL(panel_brightness, test_out_of_range_level_keeps_reserved_current_bits_clear);
ZTEST(panel_brightness, test_out_of_range_level_keeps_reserved_current_bits_clear)
{
	static const uint8_t levels[] = {0x46, 0x80, 0xff};

	for (size_t i = 0; i < ARRAY_SIZE(levels); i++) {
		uint16_t lum;
		uint8_t cur;

		curve(levels[i], &lum, &cur);
		zassert_true(cur <= CUR_MAX, "level 0x%02x: CUR 0x%02x", levels[i], cur);
	}
}

ZTEST(panel_brightness, test_set_brightness_sends_the_recorded_sequence)
{
	panel_running();

	set_brightness_to_panel_reg(PANEL_DEFAULT_LEVEL);

	zassert_equal(panel_xfer_count(), 7);
	expect_xfer(0, "06");
	expect_xfer(1, "a9");
	expect_xfer(2, "36 1b c0");
	expect_xfer(3, "46 0f");
	expect_xfer(4, "31 04");
	expect_xfer(5, "a3");
	expect_xfer(6, "97");
}

ZTEST(panel_brightness, test_set_brightness_puts_the_curve_on_the_wire_for_every_level)
{
	panel_running();

	for (int level = 0; level <= LEVEL_MAX; level++) {
		char lum_hex[16], cur_hex[16];
		uint16_t lum;
		uint8_t cur;

		curve(level, &lum, &cur);
		snprintf(lum_hex, sizeof(lum_hex), "36 %02x %02x", lum >> 8, lum & 0xff);
		snprintf(cur_hex, sizeof(cur_hex), "46 %02x", cur);
		g1_fake_spim_clear_log();

		set_brightness_to_panel_reg(level);

		zassert_equal(panel_xfer_count(), 7, "level %d", level);
		expect_xfer(2, lum_hex);
		expect_xfer(3, cur_hex);
	}
}

ZTEST(panel_brightness, test_running_change_waits_for_panel_init)
{
	panel_spi_up();
	panel_ctx()->spi_callbacks = panel_spi();
	panel_ctx()->init_done = 0;

	set_brightness_to_panel_reg_in_running(PANEL_DEFAULT_LEVEL);

	zassert_equal(panel_xfer_count(), 0);
}

ZTEST(panel_brightness, test_running_change_writes_both_registers_the_first_time)
{
	panel_running();

	set_brightness_to_panel_reg_in_running(PANEL_DEFAULT_LEVEL);

	zassert_equal(panel_xfer_count(), 7);
	expect_xfer(0, "06");
	expect_xfer(1, "a9");
	expect_xfer(2, "36 1b c0");
	expect_xfer(3, "46 0f");
	expect_xfer(4, "31 04");
	expect_xfer(5, "a3");
	expect_xfer(6, "97");
}

ZTEST(panel_brightness, test_running_change_skips_an_unchanged_register)
{
	panel_running();
	set_brightness_to_panel_reg_in_running(PANEL_DEFAULT_LEVEL);
	g1_fake_spim_clear_log();

	set_brightness_to_panel_reg_in_running(PANEL_DEFAULT_LEVEL + 1);

	zassert_equal(panel_xfer_count(), 6);
	expect_xfer(0, "06");
	expect_xfer(1, "a9");
	expect_xfer(2, "46 10");
	expect_xfer(3, "31 04");
	expect_xfer(4, "a3");
	expect_xfer(5, "97");
}

static void panel_registers(uint16_t *lum, uint8_t *cur)
{
	for (int n = 0; n < panel_xfer_count(); n++) {
		const struct g1_spim_entry *e = panel_xfer(n);

		if (e->len == 3 && e->head[0] == SPI_WR_LUM_REG) {
			*lum = (uint16_t)((e->head[1] << 8) | e->head[2]);
		} else if (e->len == 2 && e->head[0] == SPI_WR_CURRENT_REG) {
			*cur = e->head[1];
		}
	}
}

ZTEST(panel_brightness, test_running_changes_keep_the_registers_on_the_curve)
{
	/* panel reset values */
	uint16_t lum = 0x1bc5;
	uint8_t cur = 0x00;

	panel_running();
	for (int step = 0; step <= 2 * LEVEL_MAX; step++) {
		int level = step <= LEVEL_MAX ? step : 2 * LEVEL_MAX - step;
		uint16_t want_lum;
		uint8_t want_cur;

		curve(level, &want_lum, &want_cur);
		g1_fake_spim_clear_log();

		set_brightness_to_panel_reg_in_running(level);

		panel_registers(&lum, &cur);
		zassert_equal(lum, want_lum, "level %d: panel LUM %u", level, lum);
		zassert_equal(cur, want_cur, "level %d: panel CUR %u", level, cur);
	}
}

ZTEST(panel_brightness, test_wr_lum_and_cur_reg_writes_only_what_changed)
{
	panel_running();

	wr_lum_and_cur_reg(0x0100, 5);
	wr_lum_and_cur_reg(0x0100, 6);
	wr_lum_and_cur_reg(0x0200, 6);

	zassert_equal(panel_xfer_count(), 4);
	expect_xfer(0, "36 01 00");
	expect_xfer(1, "46 05");
	expect_xfer(2, "46 06");
	expect_xfer(3, "36 02 00");
	zassert_equal(panel_cached_lum(), 0x0200);
	zassert_equal(panel_cached_cur(), 6);
}

/*
 * Defect: direct writes skip the register cache, so a running change back to the cached value is
 * not sent.
 */
ZTEST_EXPECT_FAIL(panel_brightness, test_running_change_after_a_direct_write_reaches_the_panel);
ZTEST(panel_brightness, test_running_change_after_a_direct_write_reaches_the_panel)
{
	panel_running();
	set_brightness_to_panel_reg_in_running(6);
	set_brightness_to_panel_reg(10);
	g1_fake_spim_clear_log();

	set_brightness_to_panel_reg_in_running(6);

	zassert_true(g1_fake_spim_find_cmd(SPI_WR_CURRENT_REG, 0) >= 0,
		     "the current register still holds level 10's CUR 4");
	expect_xfer(2, "46 00");
}

ZTEST(panel_brightness, test_set_brightness_callback_stores_the_level_only)
{
	struct jbd_panel_context *c = panel_ctx();

	panel_running();

	zassert_equal(c->set_brightness_cb(c, 0x20), 0x20);

	zassert_equal(c->panel_brightness_level, 0x20);
	zassert_equal(panel_xfer_count(), 0);
}
```

## src/test_panel_cmd.c
```c
/*
 * JBD013 command layer. Every command is its own CSB window; nothing may follow a sync for 0.83 ms.
 */
#include <string.h>
#include <zephyr/ztest.h>

#include "harness.h"
#include "panel_support.h"

static void panel_cmd_before(void *f)
{
	ARG_UNUSED(f);
	panel_running();
}

ZTEST_SUITE(panel_cmd, NULL, NULL, panel_cmd_before, NULL, NULL);

static void expect_fill_window(int n, const char *hdr, uint8_t fill, size_t pixel_bytes)
{
	const struct g1_spim_entry *e = panel_xfer(n);
	uint8_t want[5];

	zassert_not_null(e, "no transfer %d", n);
	zassert_not_null(e->mosi);
	zassert_equal(g1_hex_parse(hdr, want, sizeof(want)), 5);
	zassert_mem_equal(e->mosi, want, 5, "transfer %d header", n);
	zassert_equal(e->len, 5 + pixel_bytes + 1, "transfer %d: %zu bytes", n, e->len);
	for (size_t i = 0; i < pixel_bytes; i++) {
		zassert_equal(e->mosi[5 + i], fill, "transfer %d pixel byte %zu", n, i);
	}
}

static void fill_frame_pattern(void)
{
	uint8_t *f = panel_frame();

	for (int i = 0; i < FRAME_BYTES; i++) {
		f[i] = (uint8_t)(i * 7 + i / 320);
	}
}

ZTEST(panel_cmd, test_send_cmd_is_one_byte_in_its_own_window)
{
	send_cmd(SPI_SYNC);

	zassert_equal(panel_xfer_count(), 1);
	expect_xfer(0, "97");
	zassert_equal(panel_xfer(0)->tx_len, 1);
}

ZTEST(panel_cmd, test_wr_status_reg_sends_register_then_value)
{
	wr_status_reg(SPI_WR_STATUS_REG2, 0x04);

	zassert_equal(panel_xfer_count(), 1);
	expect_xfer(0, "31 04");
}

ZTEST(panel_cmd, test_wr_cur_reg_sends_the_current_byte)
{
	wr_cur_reg(0x24);

	zassert_equal(panel_xfer_count(), 1);
	expect_xfer(0, "46 24");
}

ZTEST(panel_cmd, test_wr_lum_reg_sends_luminance_msb_first)
{
	wr_lum_reg(0x1bc0);

	zassert_equal(panel_xfer_count(), 1);
	expect_xfer(0, "36 1b c0");
}

ZTEST(panel_cmd, test_wr_offset_reg_sends_row_then_column_then_syncs)
{
	/* (0x0c, 0x0a) is the reset value */
	wr_offset_reg(0x0c, 0x0a);

	zassert_equal(panel_xfer_count(), 2);
	expect_xfer(0, "c0 0c 0a");
	expect_xfer(1, "97");
}

ZTEST(panel_cmd, test_nothing_follows_a_sync_within_the_reload_time)
{
	const struct g1_spim_entry *sync, *next;

	wr_offset_reg(0, 0);
	wr_offset_reg(24, 20);

	sync = panel_xfer(1);
	next = panel_xfer(2);
	zassert_not_null(next);
	zassert_equal(sync->head[0], SPI_SYNC);
	zassert_true(next->t_us - sync->t_us >= 830, "%u us after the sync",
		     next->t_us - sync->t_us);
}

ZTEST(panel_cmd, test_read_id_clocks_9f_and_three_more_bytes)
{
	panel_answer_id();

	zassert_equal(spi_read_id(), JBD_PANEL_DEVICE_ID);

	zassert_equal(panel_xfer_count(), 1);
	expect_xfer(0, "9f 00 00 00");
	zassert_equal(panel_xfer(0)->rx_len, 4);
}

ZTEST(panel_cmd, test_clr_cache_fills_the_frame_buffer)
{
	uint8_t *f = panel_frame();

	clr_cache(0x5a);

	for (int i = 0; i < FRAME_BYTES; i++) {
		zassert_equal(f[i], 0x5a, "frame byte %d", i);
	}
}

ZTEST(panel_cmd, test_clr_cache_writes_all_480_cache_rows_in_three_windows)
{
	clr_cache(0x5a);

	zassert_equal(panel_xfer_count(), 3);
	expect_fill_window(0, "02 00 00 00 ff", 0x5a, 192 * JBD_ROW_BYTES);
	expect_fill_window(1, "02 03 00 00 ff", 0x5a, 192 * JBD_ROW_BYTES);
	expect_fill_window(2, "02 06 00 00 ff", 0x5a, 96 * JBD_ROW_BYTES);
	zassert_equal(g1_fake_spim.too_long, 0, "a transfer exceeds the EasyDMA limit");
}

ZTEST(panel_cmd, test_jbd_clear_cache_sync_clears_then_syncs)
{
	jbd_clear_cache_sync(0);

	zassert_equal(panel_xfer_count(), 4);
	expect_fill_window(0, "02 00 00 00 ff", 0x00, 192 * JBD_ROW_BYTES);
	expect_fill_window(1, "02 03 00 00 ff", 0x00, 192 * JBD_ROW_BYTES);
	expect_fill_window(2, "02 06 00 00 ff", 0x00, 96 * JBD_ROW_BYTES);
	expect_xfer(3, "97");
}

static K_THREAD_STACK_DEFINE(clear_stack, 4096);
static struct k_thread clear_thread;

static void clear_entry(void *p1, void *p2, void *p3)
{
	ARG_UNUSED(p1);
	ARG_UNUSED(p2);
	ARG_UNUSED(p3);
	jbd_clear_cache_sync(0);
}

ZTEST(panel_cmd, test_jbd_clear_cache_sync_waits_for_the_lcd_mutex)
{
	int while_held, joined;
	uint8_t frame_while_held;
	k_tid_t tid;

	memset(panel_frame(), 0xff, FRAME_BYTES);
	lock_lcd_mutex(K_FOREVER);
	tid = k_thread_create(&clear_thread, clear_stack, K_THREAD_STACK_SIZEOF(clear_stack),
			      clear_entry, NULL, NULL, NULL, K_PRIO_PREEMPT(5), 0, K_NO_WAIT);
	k_sleep(K_MSEC(50));
	while_held = panel_xfer_count();
	/* the fill precedes the locked transfer */
	frame_while_held = panel_frame()[0];
	unlock_lcd_mutex();
	joined = k_thread_join(tid, K_SECONDS(1));
	if (joined != 0) {
		k_thread_abort(tid);
	}

	zassert_equal(frame_while_held, 0x00, "the clearing thread did not run");
	zassert_equal(while_held, 0, "%d transfers while another thread held lcd_mutex",
		      while_held);
	zassert_equal(joined, 0, "jbd_clear_cache_sync() did not finish after the unlock");
	zassert_equal(panel_xfer_count(), 4);
}

ZTEST(panel_cmd, test_display_image_writes_one_window_at_x_y_then_syncs)
{
	const struct g1_spim_entry *e;

	fill_frame_pattern();
	display_image(0x20, 0x10, panel_frame(), 20 * JBD_ROW_BYTES);

	zassert_equal(panel_xfer_count(), 2);
	e = panel_xfer(0);
	zassert_mem_equal(e->mosi, ((uint8_t[]){0x02, 0x00, 0x40, 0x20, 0xff}), 5);
	zassert_equal(e->len, 5 + 20 * JBD_ROW_BYTES + 1);
	zassert_mem_equal(e->mosi + 5, panel_frame(), 20 * JBD_ROW_BYTES);
	expect_xfer(1, "97");
}

ZTEST(panel_cmd, test_full_frame_draw_splits_at_192_rows)
{
	struct jbd_panel_context *c = panel_ctx();
	const struct g1_spim_entry *e;

	/* current_row is x, current_column y */
	c->current_row = 0x20;
	c->current_column = 0x10;
	c->draw_image_cb(c);

	zassert_equal(panel_xfer_count(), 3);
	e = panel_xfer(0);
	zassert_mem_equal(e->mosi, ((uint8_t[]){0x02, 0x00, 0x40, 0x20, 0xff}), 5);
	zassert_equal(e->len, 5 + 192 * JBD_ROW_BYTES + 1);
	e = panel_xfer(1);
	zassert_mem_equal(e->mosi, ((uint8_t[]){0x02, 0x03, 0x40, 0x20, 0xff}), 5);
	zassert_equal(e->len, 5 + 8 * JBD_ROW_BYTES + 1);
	expect_xfer(2, "97");
	zassert_equal(g1_fake_spim.too_long, 0);
}

/*
 * Defect: spi_wr_buffer() ignores its buffer argument, so rows 0..7 are resent instead of 192..199.
 */
ZTEST_EXPECT_FAIL(panel_cmd, test_full_frame_draw_sends_rows_192_to_199_last);
ZTEST(panel_cmd, test_full_frame_draw_sends_rows_192_to_199_last)
{
	struct jbd_panel_context *c = panel_ctx();
	const struct g1_spim_entry *e;

	fill_frame_pattern();
	c->draw_image_cb(c);

	e = panel_xfer(1);
	zassert_not_null(e);
	zassert_equal(e->len, 5 + 8 * JBD_ROW_BYTES + 1);
	zassert_mem_equal(e->mosi + 5, panel_frame() + 192 * JBD_ROW_BYTES, 8 * JBD_ROW_BYTES,
			  "second window does not carry frame rows 192..199");
}

ZTEST(panel_cmd, test_draw_needs_an_initialised_panel)
{
	struct jbd_panel_context *c = panel_ctx();

	c->init_done = 0;
	c->draw_image_cb(c);

	zassert_equal(panel_xfer_count(), 0);
}
```

## src/test_panel_fb.c
```c
/*
 * Frame buffer helpers. panel_buffer[200] aliases row 0 and [201] current_row. _clean_fb_data()
 * ends are inclusive.
 */
#include <string.h>
#include <zephyr/ztest.h>

#include "harness.h"
#include "panel_support.h"

static uint8_t before_img[FRAME_BYTES];

static uint8_t *row(int y)
{
	return panel_frame() + y * JBD_ROW_BYTES;
}

static void fill(uint8_t v)
{
	memset(panel_frame(), v, FRAME_BYTES);
}

static void fill_pattern(void)
{
	for (int i = 0; i < FRAME_BYTES; i++) {
		panel_frame()[i] = (uint8_t)(i * 13 + i / JBD_ROW_BYTES);
	}
	memcpy(before_img, panel_frame(), FRAME_BYTES);
}

ZTEST_SUITE(panel_fb, NULL, NULL, NULL, NULL, NULL);

ZTEST(panel_fb, test_frame_rows_are_320_bytes_apart)
{
	struct jbd_panel_context *c = panel_ctx();

	for (int y = 0; y < FRAME_ROWS; y++) {
		zassert_equal_ptr(c->panel_buffer[y], panel_frame() + y * JBD_ROW_BYTES, "row %d", y);
	}
	zassert_equal(c->current_buffer_size, FRAME_BYTES);
	zassert_equal_ptr(get_jdb_panel_context(), &g1_state()->panel);
}

ZTEST(panel_fb, test_clean_clears_inclusive_rows_and_byte_columns)
{
	fill(0xff);

	zassert_equal(_clean_fb_data(panel_fb(), 0x00, 20, 5, 41, 7), 11);

	for (int y = 4; y <= 8; y++) {
		for (int b = 9; b <= 21; b++) {
			bool inside = y >= 5 && y <= 7 && b >= 10 && b <= 20;

			zassert_equal(row(y)[b], inside ? 0x00 : 0xff, "row %d byte %d", y, b);
		}
	}
}

ZTEST(panel_fb, test_clean_widens_odd_pixels_to_whole_bytes)
{
	fill(0xff);

	zassert_equal(_clean_fb_data(panel_fb(), 0x00, 21, 5, 40, 5), 11);

	zassert_equal(row(5)[9], 0xff);
	zassert_equal(row(5)[10], 0x00);
	zassert_equal(row(5)[20], 0x00);
	zassert_equal(row(5)[21], 0xff);
}

ZTEST(panel_fb, test_clean_rejects_inverted_ranges)
{
	fill_pattern();

	zassert_equal(_clean_fb_data(panel_fb(), 0x00, 30, 5, 20, 7), -1);
	zassert_equal(_clean_fb_data(panel_fb(), 0x00, 0, 9, 10, 8), -1);
	zassert_equal(_clean_fb_data(panel_fb(), 0x00, 0, 250, 10, 300), -1);

	zassert_mem_equal(panel_frame(), before_img, FRAME_BYTES);
}

/* Defect: x_end 640 is inclusive here, so the clear spills into the next row. */
ZTEST_EXPECT_FAIL(panel_fb, test_clean_to_the_right_edge_stays_in_its_rows);
ZTEST(panel_fb, test_clean_to_the_right_edge_stays_in_its_rows)
{
	int ret;

	fill(0xff);

	ret = _clean_fb_data(panel_fb(), 0x00, 600, 10, 640, 20);

	zassert_equal(row(21)[0], 0xff, "row 21 byte 0 cleared");
	zassert_equal(row(20)[319], 0x00);
	zassert_equal(ret, 20);
}

ZTEST_EXPECT_FAIL(panel_fb, test_clean_past_the_bottom_stays_in_the_frame);
ZTEST(panel_fb, test_clean_past_the_bottom_stays_in_the_frame)
{
	fill(0xff);

	zassert_equal(_clean_fb_data(panel_fb(), 0x00, 0, 195, 9, 250), 5);

	zassert_equal(row(199)[0], 0x00);
	for (int b = 0; b < 5; b++) {
		zassert_equal(row(0)[b], 0xff, "row 0 byte %d cleared", b);
	}
}

ZTEST(panel_fb, test_copy_places_w_bytes_per_row_at_x_y)
{
	static const uint8_t src[3][4] = {
		{0x11, 0x22, 0x33, 0x44}, {0x55, 0x66, 0x77, 0x88}, {0x99, 0xaa, 0xbb, 0xcc}};

	fill(0xff);

	zassert_equal(copy_to_frame_buffer(panel_fb(), &src[0][0], 4, 3, 100, 50), 50);

	for (int i = 0; i < 3; i++) {
		zassert_mem_equal(&row(50 + i)[50], src[i], 4, "row %d", 50 + i);
		zassert_equal(row(50 + i)[49], 0xff);
		zassert_equal(row(50 + i)[54], 0xff);
	}
	zassert_equal(row(49)[50], 0xff);
	zassert_equal(row(53)[50], 0xff);
}

ZTEST(panel_fb, test_copy_at_an_odd_x_starts_on_the_byte_of_x_minus_1)
{
	static const uint8_t src[2] = {0x12, 0x34};

	fill(0xff);

	copy_to_frame_buffer(panel_fb(), src, 2, 1, 101, 7);

	zassert_equal(row(7)[49], 0xff);
	zassert_mem_equal(&row(7)[50], src, 2);
}

ZTEST_EXPECT_FAIL(panel_fb, test_copy_at_the_right_edge_stays_in_its_row);
ZTEST(panel_fb, test_copy_at_the_right_edge_stays_in_its_row)
{
	static const uint8_t src[4] = {0x12, 0x34, 0x56, 0x78};

	fill(0xff);

	copy_to_frame_buffer(panel_fb(), src, 4, 1, 636, 10);

	zassert_equal(row(11)[0], 0xff, "row 11 written");
	zassert_equal(row(11)[1], 0xff, "row 11 written");
}

ZTEST_EXPECT_FAIL(panel_fb, test_copy_below_the_frame_draws_nothing);
ZTEST(panel_fb, test_copy_below_the_frame_draws_nothing)
{
	static const uint8_t src[4] = {0x12, 0x34, 0x56, 0x78};

	fill_pattern();

	copy_to_frame_buffer(panel_fb(), src, 4, 1, 100, 230);

	zassert_mem_equal(panel_frame(), before_img, FRAME_BYTES, "frame changed");
}

/* Crashes: the second row pointer is current_row, 0 here. */
ZTEST(panel_fb, test_copy_of_two_rows_below_the_frame_draws_nothing)
{
	static const uint8_t src[2][4] = {{0x12, 0x34, 0x56, 0x78}, {0x12, 0x34, 0x56, 0x78}};

	ztest_test_skip();

	fill_pattern();
	copy_to_frame_buffer(panel_fb(), &src[0][0], 4, 2, 100, 230);
	zassert_mem_equal(panel_frame(), before_img, FRAME_BYTES, "frame changed");
}

ZTEST(panel_fb, test_copy_raw_takes_x_as_a_byte_column)
{
	static const uint8_t src[2][3] = {{0x01, 0x02, 0x03}, {0x04, 0x05, 0x06}};

	fill(0xff);

	zassert_equal(copy_to_frame_buffer_raw(panel_fb(), &src[0][0], 3, 2, 32, 12), 12);

	zassert_mem_equal(&row(12)[32], src[0], 3);
	zassert_mem_equal(&row(13)[32], src[1], 3);
	zassert_equal(row(12)[31], 0xff);
	zassert_equal(row(12)[35], 0xff);
}

ZTEST(panel_fb, test_or_merges_w_pixels_per_row)
{
	static const uint8_t src[2][4] = {{0xa0, 0xa0, 0xa0, 0xa0}, {0x50, 0x50, 0x50, 0x50}};

	fill(0x0f);

	zassert_equal(or_to_frame_buffer(panel_fb(), &src[0][0], 8, 2, 100, 20), 20);

	for (int b = 50; b < 54; b++) {
		zassert_equal(row(20)[b], 0xaf, "row 20 byte %d", b);
		zassert_equal(row(21)[b], 0x5f, "row 21 byte %d", b);
	}
	zassert_equal(row(20)[49], 0x0f);
	zassert_equal(row(20)[54], 0x0f);
	zassert_equal(row(22)[50], 0x0f);
}

ZTEST_EXPECT_FAIL(panel_fb, test_or_at_the_right_edge_stays_in_its_row);
ZTEST(panel_fb, test_or_at_the_right_edge_stays_in_its_row)
{
	static const uint8_t src[4] = {0xa0, 0xa0, 0xa0, 0xa0};

	fill(0x0f);

	or_to_frame_buffer(panel_fb(), src, 8, 1, 636, 10);

	zassert_equal(row(11)[0], 0x0f, "row 11 written");
	zassert_equal(row(11)[1], 0x0f, "row 11 written");
}

ZTEST(panel_fb, test_copy_rows_moves_a_block)
{
	fill_pattern();

	copy_frame_buffer_rows(panel_fb(), 100, 50, 20, 10, 3, 40);

	for (int i = 0; i < 3; i++) {
		zassert_mem_equal(&row(50 + i)[50], &before_img[(10 + i) * JBD_ROW_BYTES + 10], 20,
				  "row %d", 50 + i);
		zassert_equal(row(50 + i)[49], before_img[(50 + i) * JBD_ROW_BYTES + 49]);
		zassert_equal(row(50 + i)[70], before_img[(50 + i) * JBD_ROW_BYTES + 70]);
	}
	zassert_mem_equal(&row(10)[10], &before_img[10 * JBD_ROW_BYTES + 10], 20, "source changed");
}

ZTEST(panel_fb, test_copy_rows_scrolls_up_by_one_row)
{
	fill_pattern();

	copy_frame_buffer_rows(panel_fb(), 0, 10, 0, 11, 5, 640);

	for (int i = 0; i < 5; i++) {
		zassert_mem_equal(row(10 + i), &before_img[(11 + i) * JBD_ROW_BYTES], JBD_ROW_BYTES,
				  "row %d", 10 + i);
	}
}

/* Defect: rows are copied top-down, which breaks overlapping moves down. */
ZTEST_EXPECT_FAIL(panel_fb, test_copy_rows_scrolls_down_by_one_row);
ZTEST(panel_fb, test_copy_rows_scrolls_down_by_one_row)
{
	fill_pattern();

	copy_frame_buffer_rows(panel_fb(), 0, 11, 0, 10, 5, 640);

	for (int i = 0; i < 5; i++) {
		zassert_mem_equal(row(11 + i), &before_img[(10 + i) * JBD_ROW_BYTES], JBD_ROW_BYTES,
				  "row %d", 11 + i);
	}
}

ZTEST(panel_fb, test_clear_panel_zeroes_exactly_the_frame)
{
	struct jbd_panel_context *c = panel_ctx();
	uint8_t *after = panel_frame() + FRAME_BYTES;

	fill(0xff);
	memset(after, 0xa5, 3);

	c->clear_cb(c);

	for (int i = 0; i < FRAME_BYTES; i++) {
		zassert_equal(panel_frame()[i], 0x00, "frame byte %d", i);
	}
	zassert_mem_equal(after, ((uint8_t[]){0xa5, 0xa5, 0xa5}), 3);
}
```

## src/test_panel_flush.c
```c
/*
 * Frame buffer flush: one 02 cache write per row, then a 97 sync. x_end is exclusive, y_end
 * inclusive.
 */
#include <stdio.h>
#include <string.h>
#include <zephyr/ztest.h>

#include "harness.h"
#include "panel_support.h"

static uint8_t snapshot[5 + FRAME_BYTES + 3];

static void fill_frame_pattern(void)
{
	uint8_t *f = panel_frame();

	for (int i = 0; i < FRAME_BYTES; i++) {
		f[i] = (uint8_t)(i * 7 + i / JBD_ROW_BYTES);
	}
}

static void panel_flush_before(void *f)
{
	ARG_UNUSED(f);
	panel_running();
	fill_frame_pattern();
}

ZTEST_SUITE(panel_flush, NULL, NULL, panel_flush_before, NULL, NULL);

static void expect_row_window(int n, const char *hdr, int from, size_t n_bytes)
{
	const struct g1_spim_entry *e = panel_xfer(n);
	uint8_t want[5];

	zassert_not_null(e, "no transfer %d", n);
	zassert_not_null(e->mosi);
	zassert_equal(g1_hex_parse(hdr, want, sizeof(want)), 5);
	zassert_mem_equal(e->mosi, want, 5, "transfer %d header", n);
	zassert_true(e->len >= 5 + n_bytes, "transfer %d: %zu bytes", n, e->len);
	zassert_mem_equal(e->mosi + 5, panel_frame() + from, n_bytes, "transfer %d pixels", n);
}

ZTEST(panel_flush, test_flush_is_refused_before_panel_init)
{
	panel_ctx()->init_done = 0;

	zassert_equal(_reflash_fb_data_to_lcd(0, 0, 0, 0, 640, 199), -1);

	zassert_equal(panel_xfer_count(), 0);
}

ZTEST(panel_flush, test_flush_sends_one_window_per_row_then_syncs)
{
	/* address (y << 10) | x */
	zassert_equal(_reflash_fb_data_to_lcd(0x20, 0x10, 100, 10, 300, 12), 0);

	zassert_equal(panel_xfer_count(), 4);
	expect_row_window(0, "02 00 68 84 ff", 10 * JBD_ROW_BYTES + 50, 100);
	expect_row_window(1, "02 00 6c 84 ff", 11 * JBD_ROW_BYTES + 50, 100);
	expect_row_window(2, "02 00 70 84 ff", 12 * JBD_ROW_BYTES + 50, 100);
	expect_xfer(3, "97");
}

ZTEST(panel_flush, test_full_frame_flush_sends_200_rows_of_320_bytes)
{
	zassert_equal(_reflash_fb_data_to_lcd(0, 0, 0, 0, 640, 199), 0);

	zassert_equal(panel_xfer_count(), FRAME_ROWS + 1);
	for (int y = 0; y < FRAME_ROWS; y++) {
		char hdr[32];
		uint32_t addr = (uint32_t)y << 10;

		snprintf(hdr, sizeof(hdr), "02 %02x %02x %02x ff", (addr >> 16) & 0xff,
			 (addr >> 8) & 0xff, addr & 0xff);
		expect_row_window(y, hdr, y * JBD_ROW_BYTES, JBD_ROW_BYTES);
	}
	expect_row_window(199, "02 03 1c 00 ff", 199 * JBD_ROW_BYTES, JBD_ROW_BYTES);
	expect_xfer(FRAME_ROWS, "97");
}

ZTEST(panel_flush, test_flush_leaves_the_frame_buffer_as_it_was)
{
	uint8_t *start = panel_frame() - 5;

	memcpy(snapshot, start, sizeof(snapshot));

	zassert_equal(_reflash_fb_data_to_lcd(0, 0, 0, 0, 640, 199), 0);
	zassert_equal(_reflash_fb_data_to_lcd(0x20, 0x10, 100, 10, 301, 12), 0);

	zassert_mem_equal(start, snapshot, sizeof(snapshot));
}

/* Defect: no trailing dummy clocks, so the panel drops each row's last pixel. */
ZTEST_EXPECT_FAIL(panel_flush, test_row_window_ends_with_the_dummy_clocks);
ZTEST(panel_flush, test_row_window_ends_with_the_dummy_clocks)
{
	zassert_equal(_reflash_fb_data_to_lcd(0x20, 0x10, 100, 10, 300, 10), 0);

	zassert_equal(panel_xfer(0)->len, 5 + 100 + 1, "row window of %zu bytes for 100 pixel bytes",
		      panel_xfer(0)->len);
}

/* Defect: y_end is clipped to 200, not 199, so row 200 is read past the frame buffer. */
ZTEST_EXPECT_FAIL(panel_flush, test_flush_stops_at_the_last_frame_row);
ZTEST(panel_flush, test_flush_stops_at_the_last_frame_row)
{
	zassert_equal(_reflash_fb_data_to_lcd(0, 0, 0, 195, 20, 250), 0);

	zassert_equal(panel_xfer_count(), 6, "%d transfers", panel_xfer_count());
}

ZTEST(panel_flush, test_flush_ex_reads_rows_shifted_by_offset)
{
	zassert_equal(_reflash_fb_data_to_lcd_ex(0x20, 0x10, 100, 10, 300, 11, 5), 0);

	zassert_equal(panel_xfer_count(), 3);
	expect_row_window(0, "02 00 68 84 ff", 15 * JBD_ROW_BYTES + 50, 100);
	expect_row_window(1, "02 00 6c 84 ff", 16 * JBD_ROW_BYTES + 50, 100);
	expect_xfer(2, "97");
}

ZTEST(panel_flush, test_a_failed_row_does_not_stop_the_flush)
{
	uint8_t *start = panel_frame() - 5;

	memcpy(snapshot, start, sizeof(snapshot));
	g1_fake_spim.xfer_error = NRFX_ERROR_BUSY;
	g1_fake_spim.xfer_error_skip = 1;
	g1_fake_spim.xfer_error_count = 1;

	(void)_reflash_fb_data_to_lcd(0x20, 0x10, 100, 10, 300, 12);

	zassert_equal(panel_xfer_count(), 4);
	zassert_equal(panel_xfer(1)->result, NRFX_ERROR_BUSY);
	expect_row_window(2, "02 00 70 84 ff", 12 * JBD_ROW_BYTES + 50, 100);
	expect_xfer(3, "97");
	zassert_mem_equal(start, snapshot, sizeof(snapshot), "frame buffer not restored");
}
```

## src/test_panel_init.c
```c
/*
 * Panel bring-up. Commands: 66 99 reset, 06 write enable, 01/31 status registers, 02 cache write,
 * C0 offset, 71/73 mode/mirror, 46 current, A3 enable, 97 sync.
 */
#include <string.h>
#include <zephyr/ztest.h>

#include "harness.h"
#include "panel_support.h"

static const char *const VENDOR_JOURNAL[] = {
	/* init */
	"66", "99", "06", "01 10",
	"02 x=0 y=0 bytes=61440", "02 x=0 y=192 bytes=61440", "02 x=0 y=384 bytes=30720",
	"C0 0000", "97", "C0 0014", "97", "C0 1800", "97", "C0 1814", "97", "C0 0C0A", "97",
	"71", "97", "73", "97",
	"46 0F", "31 04", "A3", "97",
	/* brightness */
	"06", "A9", "36 1BC0", "46 0F", "31 04", "A3", "97",
	/* read ID */
	"9F 000000",
	/* suspend */
	"B9 FF",
};

#define N_PANEL_INIT 25
#define N_BOOT_INIT  33
#define N_JOURNAL    ARRAY_SIZE(VENDOR_JOURNAL)

ZTEST_SUITE(panel_init, NULL, NULL, NULL, NULL, NULL);

ZTEST(panel_init, test_boot_and_suspend_match_the_vendor_recording)
{
	struct jbd_panel_context *c = panel_ctx();

	panel_spi_up();
	panel_answer_id();
	zassert_equal(c->init_cb(c), 0);
	zassert_equal(c->suspend_cb(c), 0);

	zassert_equal(panel_xfer_count(), N_JOURNAL, "%d transfers, the recording has %d",
		      panel_xfer_count(), (int)N_JOURNAL);
	expect_journal(0, VENDOR_JOURNAL, N_JOURNAL);
}

ZTEST(panel_init, test_panel_init_sends_its_commands_byte_exact)
{
	static const char *const cmds[] = {
		[0] = "66",          [1] = "99",          [2] = "06",          [3] = "01 10",
		[7] = "c0 00 00",    [8] = "97",          [9] = "c0 00 14",    [10] = "97",
		[11] = "c0 18 00",   [12] = "97",         [13] = "c0 18 14",   [14] = "97",
		[15] = "c0 0c 0a",   [16] = "97",         [17] = "71",         [18] = "97",
		[19] = "73",         [20] = "97",         [21] = "46 0f",      [22] = "31 04",
		[23] = "a3",         [24] = "97",
	};
	static const struct {
		uint8_t addr[3];
		size_t rows;
	} windows[] = {{{0x00, 0x00, 0x00}, 192}, {{0x03, 0x00, 0x00}, 192}, {{0x06, 0x00, 0x00}, 96}};

	panel_spi_up();
	panel_ctx()->spi_callbacks = panel_spi();
	panel_init();

	zassert_equal(panel_xfer_count(), N_PANEL_INIT);
	for (int i = 0; i < N_PANEL_INIT; i++) {
		if (cmds[i]) {
			expect_xfer(i, cmds[i]);
		}
	}
	for (int w = 0; w < 3; w++) {
		const struct g1_spim_entry *e = panel_xfer(4 + w);
		size_t n = windows[w].rows * JBD_ROW_BYTES;

		zassert_equal(e->head[0], SPI_WR_BUFFER);
		zassert_mem_equal(&e->head[1], windows[w].addr, 3, "window %d address", w);
		zassert_equal(e->head[4], 0xff, "window %d dummy byte", w);
		zassert_equal(e->len, 5 + n + 1, "window %d length", w);
		for (size_t i = 0; i < n; i++) {
			zassert_equal(e->mosi[5 + i], 0x00, "window %d pixel byte %zu", w, i);
		}
	}
}

ZTEST(panel_init, test_panel_init_waits_out_every_sync)
{
	panel_spi_up();
	panel_ctx()->spi_callbacks = panel_spi();
	panel_init();

	for (int i = 0; i + 1 < panel_xfer_count(); i++) {
		const struct g1_spim_entry *e = panel_xfer(i);

		if (e->head[0] == SPI_SYNC) {
			uint32_t gap = panel_xfer(i + 1)->t_us - e->t_us;

			zassert_true(gap >= 830, "transfer %d: %u us after the sync", i + 1, gap);
		}
	}
}

ZTEST(panel_init, test_boot_init_reads_the_panel_id)
{
	struct jbd_panel_context *c = panel_ctx();

	panel_spi_up();
	panel_answer_id();

	zassert_equal(c->init_cb(c), 0);

	zassert_equal(JDB_PANEL_ID, JBD_PANEL_DEVICE_ID);
	zassert_equal(c->init_done, 1);
}

ZTEST(panel_init, test_boot_init_fails_when_the_panel_does_not_answer)
{
	struct jbd_panel_context *c = panel_ctx();

	panel_spi_up();

	zassert_equal(c->init_cb(c), -1);

	zassert_equal(JDB_PANEL_ID, 0);
	zassert_equal(c->init_done, 0);
	/* the commands are sent regardless */
	zassert_equal(panel_xfer_count(), N_BOOT_INIT);
}

ZTEST(panel_init, test_boot_init_applies_the_stored_brightness)
{
	struct jbd_panel_context *c = panel_ctx();

	panel_spi_up();
	panel_answer_id();
	c->panel_brightness_level = 0x2a;

	zassert_equal(c->init_cb(c), 0);

	/* 0x2a: full-scale LUM, CUR 0x2a - 6 */
	expect_xfer(N_PANEL_INIT + 2, "36 1b c0");
	expect_xfer(N_PANEL_INIT + 3, "46 24");
}
```

## src/test_panel_power.c
```c
/*
 * Panel suspend, off, resume and on. In deep power down (B9 FF) the panel only accepts ABh and
 * 66h/99h, so a resume starts with 66 99.
 */
#include <string.h>
#include <zephyr/ztest.h>

#include "harness.h"
#include "panel_support.h"

static const char *const VENDOR_INIT[] = {
	"66", "99", "06", "01 10",
	"02 x=0 y=0 bytes=61440", "02 x=0 y=192 bytes=61440", "02 x=0 y=384 bytes=30720",
	"C0 0000", "97", "C0 0014", "97", "C0 1800", "97", "C0 1814", "97", "C0 0C0A", "97",
	"71", "97", "73", "97",
	"46 0F", "31 04", "A3", "97",
	/* brightness */
	"06", "A9", "36 1BC0", "46 0F", "31 04", "A3", "97",
	/* read ID */
	"9F 000000",
};

#define N_PANEL_INIT 25
#define N_BRIGHTNESS 7

ZTEST_SUITE(panel_power, NULL, NULL, NULL, NULL, NULL);

static void suspended_panel(void)
{
	struct jbd_panel_context *c = panel_ctx();

	panel_running();
	zassert_equal(c->suspend_cb(c), 0);
	g1_fake_spim_clear_log();
	panel_calls = (struct panel_calls){-1, -1, -1, -1};
	power_for_panel_fake.call_count = 0;
	power_down_panel_fake.call_count = 0;
	opt3007_chip_init_fake.call_count = 0;
	opt3007_chip_deinit_fake.call_count = 0;
}

ZTEST(panel_power, test_suspend_sends_deep_power_down_with_its_dummy_byte)
{
	struct jbd_panel_context *c = panel_ctx();

	panel_running();
	zassert_equal(c->suspend_cb(c), 0);

	zassert_equal(panel_xfer_count(), 1);
	expect_xfer(0, "b9 ff");
}

ZTEST(panel_power, test_suspend_releases_the_spi_then_cuts_the_rail)
{
	struct jbd_panel_context *c = panel_ctx();
	int b9, uninit;

	panel_running();
	zassert_equal(c->suspend_cb(c), 0);

	b9 = g1_fake_spim_find_cmd(SPI_DEEP_POWER_DOWN, 0);
	uninit = g1_fake_spim_find(G1_SPIM_OP_UNINIT, 0);
	zassert_true(b9 >= 0 && uninit > b9, "B9 at %d, SPIM uninit at %d", b9, uninit);
	zassert_equal(g1_fake_spim.log[uninit].inst, 4);
	zassert_equal(power_down_panel_fake.call_count, 1);
	zassert_true(panel_calls.power_down_at > uninit, "rail off at %d, SPIM uninit at %d",
		     panel_calls.power_down_at, uninit);
}

ZTEST(panel_power, test_suspend_marks_panel_and_spi_down)
{
	struct jbd_panel_context *c = panel_ctx();

	panel_running();
	zassert_equal(c->suspend_cb(c), 0);

	zassert_equal(c->init_done, 0);
	zassert_equal(panel_spi()->is_initialized, 0);
}

ZTEST(panel_power, test_suspend_stops_the_light_sensor_before_the_rail_on_the_master)
{
	struct jbd_panel_context *c = panel_ctx();

	getDeviceRole_fake.return_val = 0;
	panel_running();
	zassert_equal(c->suspend_cb(c), 0);

	zassert_equal(opt3007_chip_deinit_fake.call_count, 1);
	zassert_true(panel_calls.opt_deinit_at <= panel_calls.power_down_at);
}

ZTEST(panel_power, test_suspend_leaves_the_light_sensor_alone_on_the_slave)
{
	struct jbd_panel_context *c = panel_ctx();

	getDeviceRole_fake.return_val = 1;
	panel_running();
	zassert_equal(c->suspend_cb(c), 0);

	zassert_equal(opt3007_chip_deinit_fake.call_count, 0);
	zassert_equal(power_down_panel_fake.call_count, 1);
}

ZTEST(panel_power, test_off_with_the_spi_down_does_nothing)
{
	struct jbd_panel_context *c = panel_ctx();

	zassert_equal(c->off_cb(c), 0);

	zassert_equal(g1_fake_spim.count, 0);
	zassert_equal(power_down_panel_fake.call_count, 0);
	zassert_equal(opt3007_chip_deinit_fake.call_count, 0);
}

ZTEST(panel_power, test_on_powers_the_rail_then_opens_the_spi_then_inits)
{
	struct jbd_panel_context *c = panel_ctx();
	int init, first;

	zassert_equal(c->on_cb(c), 0);

	init = g1_fake_spim_find(G1_SPIM_OP_INIT, 0);
	first = g1_fake_spim_find(G1_SPIM_OP_XFER, 0);
	zassert_true(init >= 0, "SPI not opened");
	zassert_true(panel_calls.power_on_at >= 0 && panel_calls.power_on_at <= init,
		     "rail on at %d, SPIM init at %d", panel_calls.power_on_at, init);
	zassert_true(first > init);
	zassert_equal(panel_xfer_count(), N_PANEL_INIT);
	expect_journal(0, VENDOR_INIT, N_PANEL_INIT);
	zassert_equal(c->init_done, 1);
}

ZTEST(panel_power, test_on_starts_the_light_sensor_after_the_panel_on_the_master)
{
	struct jbd_panel_context *c = panel_ctx();

	getDeviceRole_fake.return_val = 0;
	zassert_equal(c->on_cb(c), 0);

	zassert_equal(opt3007_chip_init_fake.call_count, 1);
	zassert_true(panel_calls.opt_init_at > panel_calls.power_on_at);
}

ZTEST(panel_power, test_on_leaves_the_light_sensor_alone_on_the_slave)
{
	struct jbd_panel_context *c = panel_ctx();

	getDeviceRole_fake.return_val = 1;
	zassert_equal(c->on_cb(c), 0);

	zassert_equal(opt3007_chip_init_fake.call_count, 0);
	zassert_equal(panel_xfer_count(), N_PANEL_INIT);
}

ZTEST(panel_power, test_on_with_the_spi_up_does_nothing)
{
	struct jbd_panel_context *c = panel_ctx();

	panel_spi_up();
	zassert_equal(c->on_cb(c), 0);

	zassert_equal(g1_fake_spim.count, 0);
	zassert_equal(power_for_panel_fake.call_count, 0);
}

ZTEST(panel_power, test_resume_after_suspend_restarts_the_panel_with_its_brightness)
{
	struct jbd_panel_context *c = panel_ctx();

	suspended_panel();

	zassert_equal(c->resume_cb(c), 0);

	zassert_equal(power_for_panel_fake.call_count, 1);
	zassert_true(g1_fake_spim_find(G1_SPIM_OP_INIT, 0) >= 0, "SPI not reopened");
	zassert_equal(panel_xfer_count(), N_PANEL_INIT + N_BRIGHTNESS);
	expect_journal(0, VENDOR_INIT, N_PANEL_INIT + N_BRIGHTNESS);
	zassert_equal(c->init_done, 1);
}

ZTEST(panel_power, test_resume_with_the_spi_up_reinitialises_and_reads_the_id)
{
	struct jbd_panel_context *c = panel_ctx();

	panel_spi_up();
	panel_answer_id();

	zassert_equal(c->resume_cb(c), 0);

	zassert_equal(g1_fake_spim_find(G1_SPIM_OP_INIT, 0), -1, "SPI reopened");
	zassert_equal(power_for_panel_fake.call_count, 0);
	zassert_equal(panel_xfer_count(), N_PANEL_INIT + N_BRIGHTNESS + 1);
	expect_journal(0, VENDOR_INIT, N_PANEL_INIT + N_BRIGHTNESS + 1);
	zassert_equal(c->init_done, 1);
}

ZTEST(panel_power, test_resume_is_refused_without_the_panel_module_bit)
{
	struct jbd_panel_context *c = panel_ctx();

	suspended_panel();
	g1_state()->module_mask &= ~LP_JBD_BIT;

	zassert_equal(c->resume_cb(c), -1);

	zassert_equal(g1_fake_spim.count, 0);
	zassert_equal(power_for_panel_fake.call_count, 0);
	zassert_equal(c->init_done, 0);
}

ZTEST(panel_power, test_resume_is_refused_while_the_panel_is_on)
{
	struct jbd_panel_context *c = panel_ctx();

	panel_running();

	zassert_equal(c->resume_cb(c), -1);

	zassert_equal(g1_fake_spim.count, 0);
}
```
