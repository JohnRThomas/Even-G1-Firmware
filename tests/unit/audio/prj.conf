## CMakeLists.txt
```
# Zephyr's dmic_nrfx_pdm.c runs on the nrfx fakes.
cmake_minimum_required(VERSION 3.20.0)
# interrupt controller binding for the overlay
list(APPEND DTS_ROOT ${CMAKE_CURRENT_LIST_DIR})
include(${CMAKE_CURRENT_LIST_DIR}/../common/unit_setup.cmake)
project(unit_audio)

g1_unit_firmware(ble_proto common_utils storage/setting_store.c storage/file_storage.c)
g1_unit_fakes(all)
target_sources(app PRIVATE
  src/pdm_driver.c
  src/fakes_ble_queue.c
  src/test_audio_stream.c
  src/test_dmic.c
)
target_include_directories(app PRIVATE src)
set_source_files_properties(src/pdm_driver.c PROPERTIES COMPILE_DEFINITIONS
  G1_UNIT_DMIC_NRFX_PDM_C="${ZEPHYR_BASE}/drivers/audio/dmic_nrfx_pdm.c")
```

## prj.conf
```kconfig
# liblc3 needs FPU
CONFIG_FPU=y
CONFIG_LIBLC3=y

# dmic_nrfx_pdm.c needs onoff
CONFIG_ONOFF=y
```

## boards/native_sim.overlay
```dts
/* g1_unit_intc stands in for the NVIC. */

/ {
	g1_unit_intc: g1-unit-intc {
		compatible = "vnd,g1-unit-intc";
		interrupt-controller;
		#interrupt-cells = <2>;
	};

	pdm0_default: pdm0_default {
	};

	pdm0: pdm@26000 {
		compatible = "nordic,nrf-pdm";
		reg = <0x26000 0x1000>;
		interrupt-parent = <&g1_unit_intc>;
		interrupts = <20 1>;
		status = "okay";
		pinctrl-0 = <&pdm0_default>;
		pinctrl-names = "default";
		clock-source = "PCLK32M";
		queue-size = <10>;
	};
};
```

## dts/bindings/vnd,g1-unit-intc.yaml
```yaml
description: |
  Interrupt controller stand-in for the audio unit suite: native_sim's devicetree has no
  interrupt controller, and the pdm0 node needs interrupts (the nordic,nrf-pdm binding
  requires them, Zephyr's dmic_nrfx_pdm.c reads DT_IRQN / DT_IRQ(priority)). Nothing
  raises these interrupts on the host.

compatible: "vnd,g1-unit-intc"

include: [base.yaml, interrupt-controller.yaml]

interrupt-cells:
  - irq
  - priority
```

## src/fakes_ble_queue.c
```c
#include <zephyr/kernel.h>

#include "fakes_ble_queue.h"

#include "ble/ble_ancs.h"

struct g1_pkt_log audio_bt_queue_log;

__weak int enqueue_bt_data(void *data, uint8_t len)
{
	g1_pkt_log_add(&audio_bt_queue_log, data, len);
	return 0;
}

static void fakes_ble_queue_reset(bool keep_media)
{
	ARG_UNUSED(keep_media);
	g1_pkt_log_clear(&audio_bt_queue_log);
}

G1_UNIT_RESET_HOOK(fakes_ble_queue_reset);
```

## src/fakes_ble_queue.h
```c
#ifndef G1_UNIT_AUDIO_FAKES_BLE_QUEUE_H_
#define G1_UNIT_AUDIO_FAKES_BLE_QUEUE_H_

#include "harness.h"

extern struct g1_pkt_log audio_bt_queue_log;

#endif /* G1_UNIT_AUDIO_FAKES_BLE_QUEUE_H_ */
```

## src/pdm_driver.c
```c
/* Zephyr's dmic_nrfx_pdm.c, #included for its state, with the Kconfig native_sim lacks. */
#define CONFIG_SOC_SERIES_NRF53X        1
#define CONFIG_AUDIO_DMIC_LOG_LEVEL     1
#define CONFIG_AUDIO_DMIC_INIT_PRIORITY 80

#include G1_UNIT_DMIC_NRFX_PDM_C

#include "pdm_driver.h"

bool pdm_driver_active(void)
{
	return dmic_nrfx_pdm_data0.active;
}

int pdm_driver_queued(void)
{
	return k_msgq_num_used_get(&dmic_nrfx_pdm_data0.rx_queue);
}

void pdm_driver_reset(void)
{
	struct dmic_nrfx_pdm_drv_data *d = &dmic_nrfx_pdm_data0;
	void *buffer;

	if (d->active) {
		(void)dmic_nrfx_pdm_trigger(DEVICE_DT_GET(PDM(0)), DMIC_TRIGGER_STOP);
	}
	while (k_msgq_get(&d->rx_queue, &buffer, K_NO_WAIT) == 0) {
		free_buffer(d, buffer);
	}
	d->active = false;
	d->stopping = false;
}
```

## src/pdm_driver.h
```c
#ifndef G1_UNIT_AUDIO_PDM_DRIVER_H_
#define G1_UNIT_AUDIO_PDM_DRIVER_H_

#include <stdbool.h>

bool pdm_driver_active(void);
int pdm_driver_queued(void);
/* stop, and free the queued blocks to the slab */
void pdm_driver_reset(void);

#endif /* G1_UNIT_AUDIO_PDM_DRIVER_H_ */
```

## src/test_audio_stream.c
```c
/* Manager sector: magic, reserved, 4 x {state, start, end, ts, crc32} LE. */
#include <string.h>
#include <zephyr/ztest.h>

#include "harness.h"
#include "fakes_audio.h"
#include "fakes_display.h"
#include "fakes_ipc.h"
#include "fakes_storage.h"

#include "sensors_audio/audio_stream.c"

#define MGR      0x400000u
#define BASE     0x421000u
#define BLOCK_SZ 0x20000u
#define MAGIC    0x5aa5aa5au

static void stream_before(void *fixture)
{
	ARG_UNUSED(fixture);

	k_msgq_purge(&audio_stream_msgq);
	audio_stream_crc = 0;
	audio_cache_offset = 0;
	audio_sector_count = 0;
	atomic_clear(&audio_block_in_use);
	audio_record_state = 0;
	audio_block_num = 0;
	memset(audio_cache, 0, sizeof(audio_cache));
}

ZTEST_SUITE(audio_stream, NULL, NULL, stream_before, NULL, NULL);

static uint32_t crc32_ref(const uint8_t *p, size_t n)
{
	uint32_t c = 0xffffffffu;

	for (size_t i = 0; i < n; i++) {
		c ^= p[i];
		for (int k = 0; k < 8; k++) {
			c = (c >> 1) ^ (0xedb88320u & (0u - (c & 1u)));
		}
	}
	return ~c;
}

static uint32_t get_le32(uint32_t addr)
{
	const uint8_t *p = &g1_fake_flash_image[addr];

	return p[0] | (p[1] << 8) | (p[2] << 16) | ((uint32_t)p[3] << 24);
}

static void put_le32(uint32_t addr, uint32_t v)
{
	g1_fake_flash_image[addr] = v;
	g1_fake_flash_image[addr + 1] = v >> 8;
	g1_fake_flash_image[addr + 2] = v >> 16;
	g1_fake_flash_image[addr + 3] = v >> 24;
}

struct blk {
	uint32_t state, start, end, ts, crc;
};

static struct blk get_block(int i)
{
	uint32_t a = MGR + 8 + i * 20;

	return (struct blk){get_le32(a), get_le32(a + 4), get_le32(a + 8), get_le32(a + 12),
			    get_le32(a + 16)};
}

static void put_block(int i, struct blk b)
{
	uint32_t a = MGR + 8 + i * 20;

	put_le32(a, b.state);
	put_le32(a + 4, b.start);
	put_le32(a + 8, b.end);
	put_le32(a + 12, b.ts);
	put_le32(a + 16, b.crc);
}

static void put_manager(void)
{
	memset(&g1_fake_flash_image[MGR], 0, 0x1000);
	put_le32(MGR, MAGIC);
}

static struct blk used(int i, uint32_t ts)
{
	return (struct blk){2, BASE + i * BLOCK_SZ, BASE + i * BLOCK_SZ + 0x100, ts, 0x1234 + i};
}

/* as the storage thread does */
static void drain(void)
{
	for (int guard = 0; getAudioMessageQueueNum() && guard < 100; guard++) {
		audioStreamFileManagerHandler();
	}
	zassert_equal(getAudioMessageQueueNum(), 0, "queue not drained");
}

static void fill_block(uint8_t *b, int n)
{
	for (int i = 0; i < AUDIO_STREAM_MSG_DATA; i++) {
		b[i] = (uint8_t)(n * 31 + i * 7);
	}
}

static void record(int count)
{
	uint8_t b[AUDIO_STREAM_MSG_DATA];

	zassert_equal(startAudioStreamRecord(), 0);
	drain();
	for (int n = 0; n < count; n++) {
		fill_block(b, n);
		zassert_equal(sendAudioStram2Cache(b), 0, "block %d", n);
		drain();
	}
}

/* main() clears bit 2 only when the stream ends */
ZTEST(audio_stream, test_request_dmic_stream_start_wakes_main_once)
{
	struct GlassesState *gs = g1_state();

	request_dmic_stream_start();
	zassert_true(gs->pending & BIT(2));
	zassert_equal(k_sem_take(&gs->main_sem, K_NO_WAIT), 0, "main_sem given");

	request_dmic_stream_start();
	zassert_equal(k_sem_count_get(&gs->main_sem), 0, "given again while pending");
	zassert_true(gs->pending & BIT(2));
}

ZTEST(audio_stream, test_start_record_queues_a_start_and_wakes_the_storage_thread)
{
	struct audio_stream_msg m;

	zassert_equal(startAudioStreamRecord(), 0);

	zassert_equal(getAudioMessageQueueNum(), 1);
	zassert_equal(k_sem_count_get(&flash_ops_sem), 1);
	zassert_equal(k_msgq_get(&audio_stream_msgq, &m, K_NO_WAIT), 0);
	zassert_equal(m.cmd, AUDIO_STREAM_START);
}

ZTEST(audio_stream, test_audio_data_is_queued_200_bytes_at_a_time)
{
	uint8_t b[AUDIO_STREAM_MSG_DATA];
	struct audio_stream_msg m;

	fill_block(b, 3);
	zassert_equal(sendAudioStram2Cache(b), 0);

	zassert_equal(k_sem_count_get(&flash_ops_sem), 1);
	zassert_equal(k_msgq_get(&audio_stream_msgq, &m, K_NO_WAIT), 0);
	zassert_equal(m.cmd, AUDIO_STREAM_DATA);
	zassert_equal(m.len, 200);
	zassert_mem_equal(m.data, b, 200);
}

ZTEST(audio_stream, test_stop_and_delete_requests_are_queued)
{
	struct audio_stream_msg m;

	zassert_equal(stopAudioStreamRecord(), 0);
	zassert_equal(delAudioStreamRecord(3), 0);

	zassert_equal(k_msgq_get(&audio_stream_msgq, &m, K_NO_WAIT), 0);
	zassert_equal(m.cmd, AUDIO_STREAM_STOP);
	zassert_equal(k_msgq_get(&audio_stream_msgq, &m, K_NO_WAIT), 0);
	zassert_equal(m.cmd, AUDIO_STREAM_DELETE);
	zassert_equal(m.len, 1);
	zassert_equal(m.data[0], 3);
	zassert_equal(k_sem_count_get(&flash_ops_sem), 2);
}

ZTEST(audio_stream, test_cache_queue_holds_18_messages_and_drops_the_19th)
{
	uint8_t b[AUDIO_STREAM_MSG_DATA] = {0};

	for (int i = 0; i < 18; i++) {
		zassert_equal(sendAudioStram2Cache(b), 0, "message %d", i);
	}
	zassert_equal(sendAudioStram2Cache(b), -1);
	zassert_equal(getAudioMessageQueueNum(), 18);
	zassert_equal(k_sem_count_get(&flash_ops_sem), 18);
	zassert_equal(stopAudioStreamRecord(), -1);
	zassert_equal(delAudioStreamRecord(1), -1);
}

/* sync 6 {1, 0}: quick note ends */
ZTEST(audio_stream, test_start_with_a_full_queue_ends_quick_note_on_both_lenses)
{
	uint8_t b[AUDIO_STREAM_MSG_DATA] = {0};

	for (int i = 0; i < 18; i++) {
		sendAudioStram2Cache(b);
	}
	zassert_equal(startAudioStreamRecord(), -1);

	zassert_equal(sync_to_slave_fake.call_count, 1);
	zassert_equal(sync_to_slave_fake.arg1_val, 6);
	zassert_equal(g1_sync_to_slave_log.len[0], 2);
	zassert_mem_equal(g1_sync_to_slave_log.data[0], ((uint8_t[]){0x01, 0x00}), 2);
	zassert_equal(display_DelayClose_fake.call_count, 1);
	zassert_equal(display_DelayClose_fake.arg0_val, 10000);
}

ZTEST(audio_stream, test_handler_with_an_empty_queue_touches_no_flash)
{
	zassert_equal(audioStreamFileManagerHandler(), 0);
	zassert_equal(g1_fake_flash_read_fake.call_count, 0);
	zassert_equal(g1_fake_flash_erase_fake.call_count, 0);
	zassert_equal(g1_fake_flash_write_fake.call_count, 0);
}

ZTEST(audio_stream, test_data_without_a_start_is_discarded)
{
	uint8_t b[AUDIO_STREAM_MSG_DATA] = {0};

	sendAudioStram2Cache(b);
	sendAudioStram2Cache(b);
	audioStreamFileManagerHandler();

	zassert_equal(getAudioMessageQueueNum(), 0);
	zassert_equal(g1_fake_flash_write_fake.call_count, 0);
	zassert_equal(audio_record_state, 0);
}

ZTEST(audio_stream, test_start_formats_a_blank_manager_sector)
{
	zassert_equal(startAudioStreamRecord(), 0);
	drain();

	zassert_equal(get_le32(MGR), MAGIC);
	zassert_equal(get_le32(MGR + 4), 0);
	for (int i = 0; i < 4; i++) {
		struct blk b = get_block(i);

		zassert_true(b.state == 0 && b.start == 0 && b.end == 0 && b.ts == 0 && b.crc == 0,
			     "block %d not cleared", i);
	}
	zassert_equal(audio_record_state, 1, "recording");
	zassert_equal(audio_block_num, 0);
}

ZTEST(audio_stream, test_start_picks_the_first_free_block)
{
	uint8_t b[AUDIO_STREAM_MSG_DATA];
	struct blk blk;

	put_manager();
	put_block(0, used(0, 100));
	put_block(1, used(1, 200));

	record(1);
	stopAudioStreamRecord();
	drain();

	blk = get_block(2);
	zassert_equal(blk.state, 2, "index 2 state %u", blk.state);
	zassert_equal(blk.start, BASE + 2 * BLOCK_SZ, "index 2 start 0x%x", blk.start);
	fill_block(b, 0);
	zassert_mem_equal(&g1_fake_flash_image[BASE + 2 * BLOCK_SZ], b, sizeof(b));
	zassert_equal(get_block(3).state, 0, "index 3 written too");
}

ZTEST(audio_stream, test_all_blocks_used_picks_the_oldest)
{
	static const uint32_t ts[4] = {500, 100, 300, 400};

	put_manager();
	for (int i = 0; i < 4; i++) {
		put_block(i, used(i, ts[i]));
	}
	g1_clock_set_date(1717171717);

	record(1);
	stopAudioStreamRecord();
	drain();

	for (int i = 0; i < 4; i++) {
		uint32_t want = i == 1 ? 1717171717 : ts[i];

		zassert_equal(get_block(i).ts, want, "index %d (ts %u): ts %u, want %u", i, ts[i],
			      get_block(i).ts, want);
	}
}

ZTEST(audio_stream, test_oldest_block_in_use_is_skipped)
{
	static const uint32_t ts[4] = {500, 100, 300, 400};

	put_manager();
	for (int i = 0; i < 4; i++) {
		put_block(i, used(i, ts[i]));
	}
	setAudioBlockInUse(2); /* block 2 = index 1 */
	g1_clock_set_date(1717171717);

	record(1);
	stopAudioStreamRecord();
	drain();

	for (int i = 0; i < 4; i++) {
		uint32_t want = i == 2 ? 1717171717 : ts[i];

		zassert_equal(get_block(i).ts, want, "index %d (ts %u): ts %u, want %u", i, ts[i],
			      get_block(i).ts, want);
	}
}

ZTEST(audio_stream, test_in_use_flag_set_get_clear)
{
	zassert_equal(getAudioBlockInUse(), 0, "none at boot");
	zassert_equal(setAudioBlockInUse(3), 0, "returns the previous value");
	zassert_equal(getAudioBlockInUse(), 3);
	zassert_equal(clearAudioBlockInUse(), 3);
	zassert_equal(getAudioBlockInUse(), 0);
}

ZTEST(audio_stream, test_audio_is_written_in_4_kib_sectors)
{
	uint8_t exp[0x1000];
	uint8_t b[AUDIO_STREAM_MSG_DATA];

	record(20);
	zassert_equal(g1_fake_flash_erase_fake.call_count, 1, "only the manager format");
	zassert_equal(audio_cache_offset, 4000);

	fill_block(b, 20);
	sendAudioStram2Cache(b);
	drain();

	zassert_equal(g1_fake_flash_erase_fake.arg1_val, BASE, "erase at 0x%x",
		      g1_fake_flash_erase_fake.arg1_val);
	zassert_equal(g1_fake_flash_erase_fake.arg2_val, 0x1000);
	for (int n = 0; n < 21; n++) {
		fill_block(b, n);
		memcpy(&exp[n * 200], b, MIN(200, 0x1000 - n * 200));
	}
	zassert_mem_equal(&g1_fake_flash_image[BASE], exp, 0x1000);
	zassert_equal(audio_cache_offset, 21 * 200 - 0x1000, "remainder %d", audio_cache_offset);
	zassert_equal(audio_sector_count, 1);
}

ZTEST(audio_stream, test_stop_records_the_block_with_length_date_and_crc)
{
	static uint8_t all[25 * 200];
	uint8_t b[AUDIO_STREAM_MSG_DATA];
	struct blk blk;

	put_manager();
	g1_clock_set_date(1717171717);
	record(25); /* one sector and 904 bytes */
	zassert_equal(stopAudioStreamRecord(), 0);
	drain();

	for (int n = 0; n < 25; n++) {
		fill_block(b, n);
		memcpy(&all[n * 200], b, 200);
	}
	zassert_mem_equal(&g1_fake_flash_image[BASE], all, sizeof(all));
	blk = get_block(0);
	zassert_equal(blk.state, 2);
	zassert_equal(blk.start, BASE);
	zassert_equal(blk.end, BASE + 5000, "end 0x%x", blk.end);
	zassert_equal(blk.ts, 1717171717);
	zassert_equal(blk.crc, crc32_ref(all, sizeof(all)), "crc 0x%08x, expected 0x%08x", blk.crc,
		      crc32_ref(all, sizeof(all)));
	zassert_equal(get_le32(MGR), MAGIC);
	zassert_equal(requestAudioInfoToApp_fake.call_count, 1);
	zassert_equal(requestAudioInfoToApp_fake.arg0_val, 1);
	zassert_equal(audio_record_state, 0, "idle again");
}

ZTEST(audio_stream, test_stop_keeps_the_other_recordings)
{
	put_manager();
	put_block(0, used(0, 100));
	put_block(2, used(2, 300));

	record(3);
	stopAudioStreamRecord();
	drain();

	zassert_equal(get_block(1).state, 2, "new recording in the first free block");
	zassert_equal(get_block(0).ts, 100);
	zassert_equal(get_block(0).crc, used(0, 100).crc);
	zassert_equal(get_block(2).ts, 300);
	zassert_equal(get_block(3).state, 0);
}

/* DEFECT: an empty stop erases the manager sector without writing it back. */
ZTEST_EXPECT_FAIL(audio_stream, test_stopping_an_empty_recording_keeps_the_other_recordings);
ZTEST(audio_stream, test_stopping_an_empty_recording_keeps_the_other_recordings)
{
	put_manager();
	put_block(1, used(1, 200));

	record(0);
	stopAudioStreamRecord();
	drain();

	zassert_equal(audio_record_state, 0);
	zassert_equal(requestAudioInfoToApp_fake.call_count, 0, "nothing recorded, nothing told");
	zassert_equal(get_le32(MGR), MAGIC, "manager magic 0x%08x", get_le32(MGR));
	zassert_equal(get_block(1).state, 2, "recording in block 2 lost");
}

ZTEST(audio_stream, test_start_during_recording_abandons_it)
{
	put_manager();
	record(3);

	startAudioStreamRecord();
	drain();

	zassert_equal(audio_record_state, 0);
	zassert_equal(get_block(0).state, 0);
	zassert_equal(requestAudioInfoToApp_fake.call_count, 0);
}

/* 18th sector: past the block area */
ZTEST(audio_stream, test_recording_stops_itself_at_the_end_of_its_block_area)
{
	uint8_t b[AUDIO_STREAM_MSG_DATA];
	int n;

	put_manager();
	record(368); /* 17 sectors + 3968 cached */
	zassert_equal(audio_sector_count, 17);
	zassert_equal(sync_to_slave_fake.call_count, 0);

	fill_block(b, 368);
	sendAudioStram2Cache(b);
	drain();

	zassert_equal(sync_to_slave_fake.call_count, 1);
	zassert_equal(sync_to_slave_fake.arg1_val, 6);
	zassert_mem_equal(g1_sync_to_slave_log.data[0], ((uint8_t[]){0x01, 0x00}), 2);
	zassert_equal(display_DelayClose_fake.arg0_val, 10000);
	n = get_block(0).end - BASE;
	zassert_equal(get_block(0).state, 2);
	zassert_equal(n, 73600, "%d bytes recorded", n);
	zassert_equal(audio_record_state, 0);
}

ZTEST(audio_stream, test_delete_frees_one_block)
{
	put_manager();
	for (int i = 0; i < 4; i++) {
		put_block(i, used(i, 100 + i));
	}

	delAudioStreamRecord(2);
	drain();

	zassert_equal(get_block(1).state, 0);
	zassert_equal(get_block(1).ts, 0);
	zassert_equal(get_block(0).state, 2);
	zassert_equal(get_block(2).state, 2);
	zassert_equal(get_block(3).state, 2);
	zassert_equal(get_block(3).ts, 103);
	zassert_equal(get_le32(MGR), MAGIC);
}

ZTEST(audio_stream, test_delete_0xff_frees_all_blocks)
{
	put_manager();
	for (int i = 0; i < 4; i++) {
		put_block(i, used(i, 100 + i));
	}

	delAudioStreamRecord(0xff);
	drain();

	zassert_equal(get_le32(MGR), MAGIC);
	for (int i = 0; i < 4; i++) {
		struct blk b = get_block(i);

		zassert_true(b.state == 0 && b.start == 0 && b.end == 0 && b.ts == 0 && b.crc == 0,
			     "block %d not cleared", i);
	}
}

/* the app sends 1..4 or 0xff */
ZTEST(audio_stream, test_delete_of_block_0_or_5_changes_nothing)
{
	put_manager();
	put_block(0, used(0, 100));

	delAudioStreamRecord(0);
	delAudioStreamRecord(5);
	drain();

	zassert_equal(g1_fake_flash_erase_fake.call_count, 0);
	zassert_equal(g1_fake_flash_write_fake.call_count, 0);
	zassert_equal(get_block(0).state, 2);
}

ZTEST(audio_stream, test_delete_during_recording_deletes_and_stops)
{
	put_manager();
	put_block(3, used(3, 400));
	record(2);

	delAudioStreamRecord(4);
	drain();

	zassert_equal(audio_record_state, 0, "recording stopped");
	zassert_equal(get_block(3).state, 0, "block 4 deleted");
	zassert_equal(get_block(0).state, 0, "the stopped recording is not recorded");
}
```

## src/test_dmic.c
```c
/* dmic_stream_start() loops, so it runs in a thread; the test plays the PDM. */
#include <string.h>
#include <zephyr/ztest.h>

#include "harness.h"
#include "fakes_ble_queue.h"
#include "fakes_misc.h"
#include "fakes_nrfx.h"
#include "pdm_driver.h"

#include "sensors_audio/dmic_audio.c"
#include "ble/ble_proto.h"

#define BLOCK_SAMPLES   1600 /* 100 ms at 16 kHz */
#define LC3_FRAMES      10
#define LC3_BYTES       20
#define F1_PAYLOAD      (LC3_FRAMES * LC3_BYTES)
#define PDMCLKCTRL_1280 168427520u /* nRF5340 PS Table 42 */

#define MIC_PRIORITY 0 /* as main() */

static K_THREAD_STACK_DEFINE(mic_stack, 16384);
static struct k_thread mic_thread;
static k_tid_t mic_tid;
static volatile bool mic_done;
static volatile int mic_ret;

static int16_t tone[BLOCK_SAMPLES];

static void mic_entry(void *p1, void *p2, void *p3)
{
	ARG_UNUSED(p1);
	ARG_UNUSED(p2);
	ARG_UNUSED(p3);
	mic_ret = dmic_stream_start();
	mic_done = true;
}

static void mic_start(void)
{
	mic_done = false;
	mic_ret = 0x7fffffff;
	mic_tid = k_thread_create(&mic_thread, mic_stack, K_THREAD_STACK_SIZEOF(mic_stack),
				  mic_entry, NULL, NULL, NULL, MIC_PRIORITY, 0, K_NO_WAIT);
	g1_clock_advance_ms(1);
}

static void mic_block(const int16_t *pcm)
{
	zassert_equal(g1_fake_pdm_capture(pcm, BLOCK_SAMPLES), 0, "PDM not running");
	g1_clock_advance_ms(1);
}

/* the loop ends after the next block */
static int mic_stop(void)
{
	dmic_stream_stop();
	if (g1_fake_pdm.op_state == G1_PDM_RUNNING) {
		mic_block(NULL);
	}
	g1_clock_advance_ms(1);
	zassert_true(mic_done, "stream still running");
	return mic_ret;
}

static void dmic_before(void *fixture)
{
	ARG_UNUSED(fixture);

	/* 1 kHz tone at 16 kHz */
	static const int16_t period[16] = {0,     3061,  5657,  7391,  8000,  7391,
					   5657,  3061,  0,     -3061, -5657, -7391,
					   -8000, -7391, -5657, -3061};

	for (int i = 0; i < BLOCK_SAMPLES; i++) {
		tone[i] = period[i % 16];
	}
	dmic_stop_state = 1;
	audio_flash_offset = AUDIO_FLASH_START;
	dmic_send_pending = 0;
	atomic_clear(&audio_stream_recording);
	mic_tid = NULL;
	mic_done = true;
}

static void dmic_after(void *fixture)
{
	ARG_UNUSED(fixture);

	if (mic_tid && !mic_done) {
		dmic_stop_state = 1;
		if (g1_fake_pdm.op_state == G1_PDM_RUNNING) {
			(void)g1_fake_pdm_capture(NULL, 0);
		}
		g1_clock_advance_ms(1);
		if (!mic_done) {
			g1_clock_advance_ms(READ_TIMEOUT + 10);
		}
		if (!mic_done) {
			k_thread_abort(mic_tid);
		}
	}
	mic_tid = NULL;
	pdm_driver_reset();
	(void)clean_dmic_msgq();
}

ZTEST_SUITE(dmic, NULL, NULL, dmic_before, dmic_after, NULL);

/* 10 ms frames, 16 kHz, 20 bytes, S16, fresh encoder */
static void lc3_reference(const int16_t *pcm, uint8_t *out)
{
	unsigned int size = lc3_encoder_size(10000, 16000);
	void *mem = malloc(size);
	lc3_encoder_t enc;

	zassert_not_null(mem);
	enc = lc3_setup_encoder(10000, 16000, 0, mem);
	zassert_not_null(enc);
	for (int i = 0; i < LC3_FRAMES; i++) {
		zassert_equal(lc3_encode(enc, LC3_PCM_FORMAT_S16, pcm + i * 160, 1, LC3_BYTES,
					 out + i * LC3_BYTES),
			      0);
	}
	free(mem);
}

ZTEST(dmic, test_start_programs_a_1280_khz_pdm_clock_with_ratio_80_for_16_khz)
{
	mic_start();

	zassert_true(g1_fake_pdm.initialized);
	zassert_equal(NRF_PDM0->PDMCLKCTRL, PDMCLKCTRL_1280, "PDMCLKCTRL 0x%08x",
		      NRF_PDM0->PDMCLKCTRL);
	zassert_equal(NRF_PDM0->RATIO, 1, "RATIO %u (1 = Ratio80)", NRF_PDM0->RATIO);
	zassert_equal(NRF_PDM0->MCLKCONFIG, 0, "MCLKCONFIG %u (0 = PCLK32M)", NRF_PDM0->MCLKCONFIG);
	zassert_equal(mic_stop(), 0);
}

ZTEST(dmic, test_start_samples_one_microphone_on_the_left_channel)
{
	mic_start();

	/* Mono = 1, EDGE LeftFalling = 0 */
	zassert_equal(NRF_PDM0->MODE, 0x1, "MODE 0x%x", NRF_PDM0->MODE);
	zassert_equal(mic_stop(), 0);
}

ZTEST(dmic, test_gain_0x40_is_set_after_configure_and_before_start)
{
	int init, gain, start;

	mic_start();

	init = g1_fake_pdm_log_find(G1_PDM_OP_INIT, 0);
	gain = g1_fake_pdm_log_find(G1_PDM_OP_GAIN_SET, 0);
	start = g1_fake_pdm_log_find(G1_PDM_OP_START, 0);
	zassert_true(init >= 0 && gain > init && start > gain, "init %d, gain %d, start %d", init,
		     gain, start);
	zassert_equal(g1_fake_pdm.log[gain].a, 0x40);
	zassert_equal(g1_fake_pdm.log[gain].b, 0x40);
	zassert_equal(nrf_pdm_gain_set_fake.arg0_val, NRF_PDM0);
	zassert_equal(g1_fake_pdm.gain_l_at_start, 0x40, "GAINL 0x%x", g1_fake_pdm.gain_l_at_start);
	zassert_equal(g1_fake_pdm.gain_r_at_start, 0x40, "GAINR 0x%x", g1_fake_pdm.gain_r_at_start);
	zassert_equal(mic_stop(), 0);
}

ZTEST(dmic, test_dma_buffers_are_100_ms_blocks)
{
	int i;

	mic_start();

	i = g1_fake_pdm_log_find(G1_PDM_OP_BUFFER_SET, 0);
	zassert_true(i >= 0);
	zassert_equal(g1_fake_pdm.log[i].b, BLOCK_SAMPLES, "%u samples",
		      (unsigned int)g1_fake_pdm.log[i].b);
	zassert_equal(mic_stop(), 0);
}

ZTEST(dmic, test_microphone_module_off_starts_nothing)
{
	g1_state()->module_mask &= ~BIT(1);

	zassert_equal(dmic_stream_start(), 0);
	zassert_equal(nrfx_pdm_init_fake.call_count, 0);
	zassert_equal(nrfx_pdm_start_fake.call_count, 0);
}

ZTEST(dmic, test_driver_configure_failure_ends_the_stream_without_starting)
{
	nrfx_pdm_init_fake.custom_fake = NULL;
	nrfx_pdm_init_fake.return_val = NRFX_ERROR_INTERNAL;

	zassert_equal(dmic_stream_start(), -1);
	zassert_equal(nrf_pdm_gain_set_fake.call_count, 0);
	zassert_equal(nrfx_pdm_start_fake.call_count, 0);
	zassert_equal(k_mem_slab_num_free_get(&dmic_mem_slab), BLOCK_COUNT);
}

/* two blocks are held by the DMA double buffer */
ZTEST(dmic, test_blocks_rotate_through_the_slab_without_running_out)
{
	mic_start();
	zassert_equal(k_mem_slab_num_free_get(&dmic_mem_slab), BLOCK_COUNT - 2);

	for (int i = 0; i < 3 * BLOCK_COUNT; i++) {
		mic_block(tone);
		zassert_equal(pdm_driver_queued(), 0, "block %d not read", i);
		zassert_equal(k_mem_slab_num_free_get(&dmic_mem_slab), BLOCK_COUNT - 2,
			      "block %d: %u free", i, k_mem_slab_num_free_get(&dmic_mem_slab));
	}
	zassert_equal(g1_fake_pdm.captured_blocks, 3 * BLOCK_COUNT);
	zassert_equal(g1_fake_pdm_log_find(G1_PDM_OP_EVT_OVERFLOW, 0), -1, "PDM overflow");
	zassert_equal(nrfx_pdm_stop_fake.call_count, 0, "driver stopped the PDM");

	zassert_equal(mic_stop(), 0);
	zassert_equal(k_mem_slab_num_free_get(&dmic_mem_slab), BLOCK_COUNT);
}

ZTEST(dmic, test_f1_frame_is_sequence_and_200_lc3_bytes)
{
	uint8_t exp[2 + F1_PAYLOAD] = {0xf1, 0x00};
	const uint8_t *f;
	size_t len;

	mic_start();
	mic_block(tone);

	zassert_equal(send_dmic_msg(g1_ble()), 0);

	zassert_equal(g1_frame_count(), 1);
	f = g1_frame_peek(0, &len);
	zassert_equal(len, 2 + F1_PAYLOAD, "F1 frame of %u bytes", (unsigned int)len);
	lc3_reference(tone, exp + 2);
	zassert_mem_equal(f, exp, sizeof(exp));
	zassert_equal(mic_stop(), 0);
}

ZTEST(dmic, test_dmic_queue_keeps_the_newest_10_blocks)
{
	uint8_t blk[DMIC_MSG_SIZE];

	zassert_equal(init_dmic_msgq(), 0);
	for (int i = 0; i < 11; i++) {
		memset(blk, i, sizeof(blk));
		zassert_equal(enqueue_dmic(blk), 0, "block %d", i);
	}
	zassert_equal(get_dmic_num_messages(), 10);
	zassert_equal(dequeue_dmic(blk), 0);
	zassert_equal(blk[0], 1, "oldest kept block %d", blk[0]);
	zassert_equal(blk[DMIC_MSG_SIZE - 1], 1);
	zassert_equal(clean_dmic_msgq(), 0);
}

/* Woken once through rx_sem; while that is pending, "f1 00 cc" is queued instead. */
ZTEST(dmic, test_first_block_wakes_the_ble_thread_through_rx_sem)
{
	struct ble_context *ble = g1_ble();

	mic_start();
	mic_block(tone);

	zassert_equal(dmic_send_pending, 1);
	zassert_equal(k_sem_count_get(&ble->rx_sem), 1);
	zassert_equal(audio_bt_queue_log.count, 0);
	zassert_equal(mic_stop(), 0);
}

ZTEST(dmic, test_block_while_the_ble_thread_is_awake_queues_an_f1_request)
{
	mic_start();
	mic_block(tone);
	mic_block(tone); /* rx_sem still given */

	zassert_equal(audio_bt_queue_log.count, 1);
	zassert_equal(audio_bt_queue_log.len[0], 3);
	zassert_mem_equal(audio_bt_queue_log.data[0], ((uint8_t[]){0xf1, 0x00, 0xcc}), 3);
	zassert_equal(mic_stop(), 0);
}

ZTEST(dmic, test_stop_ends_the_stream_after_the_next_block_and_stops_the_pdm)
{
	mic_start();
	mic_block(tone);
	zassert_equal(dmic_get_stop_state(), 0, "running");

	dmic_stream_stop();
	zassert_false(mic_done, "the loop ends after the block it is waiting for");
	mic_block(tone);

	zassert_true(mic_done);
	zassert_equal(mic_ret, 0);
	zassert_equal(dmic_get_stop_state(), 1);
	zassert_equal(nrfx_pdm_stop_fake.call_count, 1);
	zassert_equal(NRF_PDM0->ENABLE, 0);
	zassert_false(pdm_driver_active());
	zassert_equal(k_mem_slab_num_free_get(&dmic_mem_slab), BLOCK_COUNT);
}

ZTEST(dmic, test_no_audio_for_one_second_ends_the_stream_with_an_error)
{
	mic_start();
	g1_clock_advance_ms(1000 + 10);

	zassert_true(mic_done);
	zassert_equal(mic_ret, -1);
	zassert_equal(nrfx_pdm_stop_fake.call_count, 1);
	zassert_equal(k_mem_slab_num_free_get(&dmic_mem_slab), BLOCK_COUNT);
}

ZTEST(dmic, test_pause_keeps_capturing_but_sends_nothing)
{
	struct ble_context *ble = g1_ble();

	mic_start();
	dmic_stream_pause(1);
	zassert_equal(dmic_get_stop_state(), 2, "paused");
	mic_block(tone);
	mic_block(tone);

	zassert_false(mic_done);
	zassert_equal(get_dmic_num_messages(), 2, "blocks still encoded and queued");
	zassert_equal(dmic_send_pending, 0);
	zassert_equal(k_sem_count_get(&ble->rx_sem), 0);
	zassert_equal(audio_bt_queue_log.count, 0);

	dmic_stream_pause(0);
	zassert_equal(dmic_get_stop_state(), 0);
	mic_block(tone);
	zassert_equal(dmic_send_pending, 1);
	zassert_equal(mic_stop(), 0);
}

ZTEST(dmic, test_stop_state_is_reported_by_the_master_only)
{
	zassert_equal(dmic_get_stop_state(), 1, "stopped at boot");
	mic_start();
	zassert_equal(dmic_get_stop_state(), 0);
	zassert_equal(mic_stop(), 0);

	g1_unit_set_role(G1_ROLE_SLAVE);
	zassert_equal(dmic_get_stop_state(), 0);
}

ZTEST(dmic, test_restart_after_stop_reconfigures_the_pdm)
{
	int gain_calls;

	mic_start();
	mic_block(tone);
	zassert_equal(mic_stop(), 0);
	gain_calls = nrf_pdm_gain_set_fake.call_count;
	g1_fake_pdm.log_count = 0;

	mic_start();
	mic_block(tone);

	zassert_true(g1_fake_pdm_log_find(G1_PDM_OP_UNINIT, 0) >= 0, "old configuration released");
	zassert_true(g1_fake_pdm_log_find(G1_PDM_OP_INIT, 0) >= 0);
	zassert_equal(nrf_pdm_gain_set_fake.call_count, gain_calls + 1);
	zassert_equal(g1_fake_pdm.gain_l_at_start, 0x40);
	zassert_equal(get_dmic_num_messages(), 1);
	zassert_equal(mic_stop(), 0);
}
```
