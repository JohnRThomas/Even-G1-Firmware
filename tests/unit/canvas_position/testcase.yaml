## tests/unit/canvas_position/testcase.yaml
```yaml
tests:
  unit.canvas_position:
    platform_allow: native_sim
    integration_platforms:
      - native_sim
    tags: unit
```

## tests/unit/common/boards/native_sim_drivers.conf
```kconfig
# Kconfig for G1_UNIT_DRIVERS suites

CONFIG_EMUL=y
CONFIG_I2C=y
CONFIG_GPIO=y

# for flash_get_page_count()
CONFIG_FLASH=y
CONFIG_FLASH_PAGE_LAYOUT=y
```

## tests/unit/common/dts/bindings/vnd,g1-unit-charger.yaml
```yaml
description: |
  Unit tests only (driver substrate, common/boards/native_sim_drivers.overlay). Stand-in
  for the nPM1300 charger node (nordic,npm1300-charger, label pmic_charger) as a fake
  sensor driver, tests/unit/common/emul/fake_charger.c: the channels the firmware reads
  (SENSOR_CHAN_GAUGE_VOLTAGE / _TEMP / _AVG_CURRENT / _DESIRED_CHARGING_CURRENT and the
  nPM1300 status / error channels) return what the test scripted, latched at
  sensor_sample_fetch() like the real driver. Test API: common/emul/fake_charger.h.

compatible: "vnd,g1-unit-charger"

properties:
  current-microamp:
    type: int
    required: true
    description: |
      charge current, reported on SENSOR_CHAN_GAUGE_DESIRED_CHARGING_CURRENT as the
      real driver does (40000 on the lens, boards/nrf5340dk_nrf5340_cpuapp.overlay)
```

## tests/unit/common/dts/bindings/vnd,g1-unit-fake-device.yaml
```yaml
description: |
  Unit tests only. A devicetree node whose label the firmware passes to DEVICE_DT_GET
  (for example mx25r64 in src/storage/storage.h) but whose driver is not part of the
  suite. tests/unit/common/harness.c defines a device without API for every enabled
  node with this compatible, so the firmware compiles and device_is_ready() is true.
  A suite that wants a real driver behind the label deletes this node in its own
  boards/native_sim.overlay and puts the label on the emulated device instead.

compatible: "vnd,g1-unit-fake-device"
```

## tests/unit/common/dts/bindings/vnd,g1-unit-i2c-chip.yaml
```yaml
description: |
  Unit tests only (driver substrate, common/boards/native_sim_drivers.overlay). An I2C
  chip that the firmware talks to with raw i2c_* transfers (no Zephyr driver), on a
  zephyr,i2c-emul-controller bus. tests/unit/common/emul/devices.c gives every enabled
  node a stub device (the emulated bus needs a device for each child); the chip's
  emulator in common/emul/<chip>_emul.c binds to the node by its label with
  EMUL_DT_DEFINE(DT_NODELABEL(<label>), ...) and answers at the node's reg address.

compatible: "vnd,g1-unit-i2c-chip"

include: i2c-device.yaml
```

## tests/unit/common/dts/bindings/vnd,g1-unit-lsm6dso.yaml
```yaml
description: |
  Unit tests only (driver substrate, common/boards/native_sim_drivers.overlay). Stand-in
  for the LSM6DSO IMU node (st,lsm6dso on the lens) on an emulated I2C bus.
  tests/unit/common/emul/fake_imu.c defines its device: a sensor driver (Zephyr sensor
  API) that returns scripted accelerometer / gyroscope samples and records every
  sensor_attr_set() call. The node's reg is the lens' address (0x6b); nothing transfers
  to it, the fake has no emulator. aw93203_port.c takes the touch controller's bus from
  this node, as on the lens.

compatible: "vnd,g1-unit-lsm6dso"

include: i2c-device.yaml
```

## tests/unit/common/dts/bindings/vnd,g1-unit-nor-flash.yaml
```yaml
description: |
  Unit tests only (driver substrate). The external QSPI NOR flash of the lens as a RAM
  flash driver, tests/unit/common/emul/nor_flash.c: Zephyr flash API with the argument
  rules of the nRF QSPI NOR driver (writes at 4-byte aligned addresses, 1..4 bytes or a
  multiple of 4; erases of whole 4 KiB sectors), NOR programming (bits only cleared),
  4 KiB pages, erase value 0xff.

compatible: "vnd,g1-unit-nor-flash"

properties:
  size:
    type: int
    required: true
    description: capacity in bytes, a multiple of 4096
```

## tests/unit/common/dts/bindings/vnd,g1-unit-npm1300-regulator.yaml
```yaml
description: |
  Unit tests only. Stand-in for the nPM1300 regulators node (nordic,npm1300-regulator).
  tests/unit/common/emul/devices.c defines a device for this node and one for each child
  (BUCK1, BUCK2, LDO1, LDO2); a child's config starts like the private
  struct regulator_npm1300_config of drivers/regulator/regulator_npm1300.c (common
  config, then mfd = the parent PMIC device), which the firmware reads directly
  (opt3007.c, charger_box.c and main.c take the MFD device from it).

compatible: "vnd,g1-unit-npm1300-regulator"

child-binding:
  description: one regulator output (BUCK1, BUCK2, LDO1, LDO2)
  include:
    - name: regulator.yaml
      property-allowlist:
        - regulator-min-microvolt
        - regulator-max-microvolt
        - regulator-init-microvolt
```

## tests/unit/common/dts/bindings/vnd,g1-unit-npm1300.yaml
```yaml
description: |
  Unit tests only. Stand-in for the nPM1300 PMIC node (nordic,npm1300) on an emulated
  I2C bus. tests/unit/common/emul/devices.c defines a stub device for it; it has no
  emulator, the firmware's mfd_npm1300_* calls go to common/emul/fake_npm1300.c, which
  records them.

compatible: "vnd,g1-unit-npm1300"

include: i2c-device.yaml
```

## tests/unit/dashboard/testcase.yaml
```yaml
tests:
  unit.dashboard:
    platform_allow: native_sim
    integration_platforms:
      - native_sim
    tags: unit
```

## tests/unit/ipc_watchdog/testcase.yaml
```yaml
tests:
  unit.ipc_watchdog:
    platform_allow: native_sim
    integration_platforms:
      - native_sim
    tags: unit
```

## tests/unit/light/testcase.yaml
```yaml
tests:
  unit.light:
    platform_allow: native_sim
    integration_platforms:
      - native_sim
    tags: unit
```

## tests/unit/link/testcase.yaml
```yaml
tests:
  unit.link:
    platform_allow: native_sim
    integration_platforms:
      - native_sim
    tags: unit
```

## tests/unit/nfc/testcase.yaml
```yaml
tests:
  unit.nfc:
    platform_allow: native_sim
    integration_platforms:
      - native_sim
    tags: unit
```

## tests/unit/proto_session/testcase.yaml
```yaml
tests:
  unit.proto_session:
    platform_allow: native_sim
    integration_platforms:
      - native_sim
    tags: unit
```

## tests/unit/storage_drivers/testcase.yaml
```yaml
tests:
  unit.storage_drivers:
    platform_allow: native_sim
    integration_platforms:
      - native_sim
    tags: unit
```
