/* Shared by every suite. A suite may /delete-node/ &mx25r64 and put the label on its own device. */

/ {
	mx25r64: g1-unit-mx25r64 {
		compatible = "vnd,g1-unit-fake-device";
		status = "okay";
	};
};
