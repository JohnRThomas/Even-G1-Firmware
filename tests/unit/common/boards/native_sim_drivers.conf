## tests/unit/common/dts/bindings/vnd,g1-unit-charger.yaml
```yaml
description: |
  Unit tests only (driver suites). Stand-in for the nPM1300 charger node
  (nordic,npm1300-charger, label pmic_charger): a fake sensor driver in
  tests/unit/common/emul/fake_sensors.c that returns the measurements the test scripted
  (common/emul/drivers.h), latched at sensor_sample_fetch() like the real driver.

compatible: "vnd,g1-unit-charger"

properties:
  current-microamp:
    type: int
    required: true
    description: |
      charge current, reported on SENSOR_CHAN_GAUGE_DESIRED_CHARGING_CURRENT as the
      real driver does (40000 on the lens, boards/nrf5340dk_nrf5340_cpuapp.overlay)
```

## tests/unit/common/dts/bindings/vnd,g1-unit-i2c-chip.yaml
```yaml
description: |
  Unit tests only (driver suites). An I2C chip on a zephyr,i2c-emul-controller bus.
  tests/unit/common/emul/devices.c gives every enabled node a stub device (the emulated
  bus needs a device for each child); a suite that has the chip's emulator
  (<suite>/<chip>_emul.c) binds it to the node by its label with
  EMUL_DT_DEFINE(DT_NODELABEL(<label>), ...), and it answers at the node's reg address.

compatible: "vnd,g1-unit-i2c-chip"

include: i2c-device.yaml
```

## tests/unit/common/dts/bindings/vnd,g1-unit-intc.yaml
```yaml
description: |
  Unit tests only. Interrupt controller stand-in for the pdm0 node: native_sim's
  devicetree has no interrupt controller, and the nordic,nrf-pdm binding requires
  interrupts (Zephyr's dmic_nrfx_pdm.c reads DT_IRQN / DT_IRQ(priority)). Nothing raises
  these interrupts on the host.

compatible: "vnd,g1-unit-intc"

include: [base.yaml, interrupt-controller.yaml]

interrupt-cells:
  - irq
  - priority
```

## tests/unit/common/dts/bindings/vnd,g1-unit-lsm6dso.yaml
```yaml
description: |
  Unit tests only (driver suites). Stand-in for the LSM6DSO IMU node (st,lsm6dso on the
  lens) on an emulated I2C bus: a fake sensor driver in
  tests/unit/common/emul/fake_sensors.c returns scripted accelerometer / gyroscope
  samples and records every sensor_attr_set() call. The node's reg is the lens' address
  (0x6b); nothing transfers to it. aw93203_port.c takes the touch controller's bus from
  this node, as on the lens.

compatible: "vnd,g1-unit-lsm6dso"

include: i2c-device.yaml
```

## tests/unit/testcase.yaml
```yaml
# One twister scenario per unit suite; CMakeLists.txt describes what each suite builds.
# Start twister from the repo root (run.sh does): with no src/ here, it takes the ztest suite
# names it expects from the *.c* files in its working directory.
common:
  platform_allow: native_sim
  integration_platforms:
    - native_sim
  tags: unit
tests:
  unit.ahrs: {extra_args: G1_UNIT_SUITE=ahrs}
  unit.audio: {extra_args: G1_UNIT_SUITE=audio}
  unit.buttons_gpio: {extra_args: G1_UNIT_SUITE=buttons_gpio}
  unit.canvas_position: {extra_args: G1_UNIT_SUITE=canvas_position}
  unit.dashboard: {extra_args: G1_UNIT_SUITE=dashboard}
  unit.display_threads: {extra_args: G1_UNIT_SUITE=display_threads}
  unit.events: {extra_args: G1_UNIT_SUITE=events}
  unit.features: {extra_args: G1_UNIT_SUITE=features}
  unit.gui: {extra_args: G1_UNIT_SUITE=gui}
  unit.harness: {extra_args: G1_UNIT_SUITE=harness}
  unit.imu: {extra_args: G1_UNIT_SUITE=imu}
  unit.ipc_watchdog: {extra_args: G1_UNIT_SUITE=ipc_watchdog}
  unit.json: {extra_args: G1_UNIT_SUITE=json}
  unit.light: {extra_args: G1_UNIT_SUITE=light}
  unit.nfc: {extra_args: G1_UNIT_SUITE=nfc}
  unit.notifications: {extra_args: G1_UNIT_SUITE=notifications}
  unit.panel: {extra_args: G1_UNIT_SUITE=panel}
  unit.persistence: {extra_args: G1_UNIT_SUITE=persistence}
  unit.pkcs7: {extra_args: G1_UNIT_SUITE=pkcs7}
  unit.power: {extra_args: G1_UNIT_SUITE=power}
  unit.production_test: {extra_args: G1_UNIT_SUITE=production_test}
  unit.proto_dispatch: {extra_args: G1_UNIT_SUITE=proto_dispatch}
  unit.proto_session: {extra_args: G1_UNIT_SUITE=proto_session}
  unit.screen_state: {extra_args: G1_UNIT_SUITE=screen_state}
  unit.storage_drivers: {extra_args: G1_UNIT_SUITE=storage_drivers}
  unit.touch: {extra_args: G1_UNIT_SUITE=touch}
  unit.util: {extra_args: G1_UNIT_SUITE=util}
```
