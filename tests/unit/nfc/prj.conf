## CMakeLists.txt
```
# NFC tag, NDEF / WLC records and case link on the ST25DV emulator
cmake_minimum_required(VERSION 3.20.0)
set(G1_UNIT_DRIVERS ON)
include(${CMAKE_CURRENT_LIST_DIR}/../common/unit_setup.cmake)
project(unit_nfc)

g1_unit_firmware(nfc/eeprom_st25dv.c nfc/st25dv.c production_test/pt_comm.c
                 sensors_audio/charger_box.c)
g1_unit_emul(st25dv_emul fake_npm1300)
g1_unit_fakes(log misc)
target_include_directories(app PRIVATE src include)
target_sources(app PRIVATE
  src/fakes_nfc.c
  src/test_st25dv.c
  src/test_ndef.c
  src/test_wlc.c
  src/test_case_link.c
  src/test_case_events.c
)
```

## prj.conf
```kconfig
# nfc_wlc.c field voltage: adc0 channel 3
CONFIG_ADC=y
CONFIG_ADC_EMUL=y

# Lens tick rate; nfc_wlc.c times in ticks
CONFIG_SYS_CLOCK_TICKS_PER_SEC=32768
```

## include/nrfx.h
```c
/* Host stand-in for the one nRF register threads.c uses. */
#ifndef G1_UNIT_NFC_NRFX_STUB_H_
#define G1_UNIT_NFC_NRFX_STUB_H_

#include <stdint.h>

struct g1_nrf_reset_network {
	volatile uint32_t FORCEOFF;
};

struct g1_nrf_reset {
	struct g1_nrf_reset_network NETWORK;
};

extern struct g1_nrf_reset g1_nrf_reset_s;

#define NRF_RESET_S                          (&g1_nrf_reset_s)
#define RESET_NETWORK_FORCEOFF_FORCEOFF_Hold 1UL

#endif /* G1_UNIT_NFC_NRFX_STUB_H_ */
```

## src/fakes_nfc.c
```c
#define FFF_GCC_FUNCTION_ATTRIBUTES __attribute__((weak))

#include <errno.h>
#include <zephyr/kernel.h>
#include <zephyr/sys/reboot.h>
#include <zephyr/ztest.h>

#include "harness.h"
#include "fakes_nfc.h"

DEFINE_FAKE_VALUE_FUNC(int64_t, nfc_deadline_set, uint32_t);
DEFINE_FAKE_VOID_FUNC(update_activity_time);
DEFINE_FAKE_VOID_FUNC(enter_silent_mode);
DEFINE_FAKE_VOID_FUNC(exit_silent_mode);
DEFINE_FAKE_VALUE_FUNC(const struct device *, get_charger_device);
__weak uint8_t can_enter_low_power;

DEFINE_FAKE_VOID_FUNC(set_ncs_mem_pt_level, uint8_t);
__weak int esb_signal;

DEFINE_FAKE_VOID_FUNC(pt_comm_busy_set);
DEFINE_FAKE_VOID_FUNC(pt_comm_busy_clear);
DEFINE_FAKE_VOID_FUNC(aw9320x_diff_get, int32_t *);

DEFINE_FAKE_VALUE_FUNC(int, calc_flash_crc, uint16_t *, int, uint32_t);
DEFINE_FAKE_VALUE_FUNC(int, save_sys_settings, struct GlassesState *, int);
DEFINE_FAKE_VALUE_FUNC(int, save_usr_settings, struct GlassesState *, int);
DEFINE_FAKE_VALUE_FUNC(int, read_sys_settting_from_flash, struct sys_settings *);
DEFINE_FAKE_VALUE_FUNC(int, read_usr_settting_from_flash, struct usr_settings *);
DEFINE_FAKE_VALUE_FUNC(char *, get_serial_number);
DEFINE_FAKE_VALUE_FUNC(char *, get_glasses_name);
DEFINE_FAKE_VALUE_FUNC(int, save_serial_number, const char *);
DEFINE_FAKE_VALUE_FUNC(int, dump_serial_number, const char *);

DEFINE_FAKE_VALUE_FUNC(int, enable_power_for_panel);
DEFINE_FAKE_VALUE_FUNC(int, disable_power_for_panel);
DEFINE_FAKE_VALUE_FUNC(int, opt3007_read, int);
DEFINE_FAKE_VALUE_FUNC(int, erase_audio_buffer);
DEFINE_FAKE_VALUE_FUNC(int, request_dmic_stream_start);
DECLARE_FAKE_VOID_FUNC(dmic_stream_stop);
DEFINE_FAKE_VOID_FUNC(dmic_stream_stop);

DEFINE_FAKE_VALUE_FUNC(int, lpuart_async_b, const struct device *, uint8_t *, size_t);
DEFINE_FAKE_VALUE_FUNC(int, read_serial_data, const struct device *, uint8_t **, uint32_t *);
DEFINE_FAKE_VOID_FUNC(serial_rx_clear);

DEFINE_FAKE_VOID_FUNC(demo_image_select, uint8_t);
__weak uint8_t demo_mode;
__weak uint32_t imu_roll_x100;
__weak uint32_t imu_yaw_x100;

DEFINE_FAKE_VALUE_FUNC(int, enqueue_bt_data, void *, uint8_t);
DEFINE_FAKE_VALUE_FUNC(int, get_work_mode);
DEFINE_FAKE_VALUE_FUNC(int, is_task_running, struct GlassesState *);
DEFINE_FAKE_VALUE_FUNC(int, update_persist_task_status_to_idle, struct GlassesState *);
DEFINE_FAKE_VOID_FUNC(aw93203_init);
DEFINE_FAKE_VALUE_FUNC(int32_t, aw9320x_read_chipid);
DEFINE_FAKE_VALUE_FUNC(int, display_close_screen, int);
DEFINE_FAKE_VALUE_FUNC(int, display_reflash_screen, uint8_t);
DEFINE_FAKE_VOID_FUNC(enter_wear_burial_point);
DEFINE_FAKE_VOID_FUNC(exit_wear_burial_point);
DEFINE_FAKE_VOID_FUNC(free_demo_line_buf);
DEFINE_FAKE_VALUE_FUNC(int, global_system_resume, struct GlassesState *);
DEFINE_FAKE_VALUE_FUNC(int, global_system_suspend, struct GlassesState *);
DEFINE_FAKE_VALUE_FUNC(int, init_serial_comm);
DEFINE_FAKE_VALUE_FUNC(uint8_t, opt3007_get_brightness_level, struct opt3007_context *);
DEFINE_FAKE_VOID_FUNC(reset_dash_buf, int);
DEFINE_FAKE_VALUE_FUNC(uint32_t, set_date, uint32_t);
__weak uint8_t task_status_lock;

struct g1_pkt_log g1_nfc_bt_log;

static int enqueue_bt_data_log(void *data, uint8_t len)
{
	g1_pkt_log_add(&g1_nfc_bt_log, data, len);
	return 0;
}

static char serial[] = "S110LAAL290026";

static char *serial_default(void)
{
	return serial;
}

__weak FUNC_NORETURN void sys_reboot(int type)
{
	ARG_UNUSED(type);
	ztest_test_fail();
	CODE_UNREACHABLE;
}

static void fakes_nfc_reset(bool keep_media)
{
	ARG_UNUSED(keep_media);
	RESET_FAKE(nfc_deadline_set);
	RESET_FAKE(update_activity_time);
	RESET_FAKE(enter_silent_mode);
	RESET_FAKE(exit_silent_mode);
	RESET_FAKE(get_charger_device);
	RESET_FAKE(set_ncs_mem_pt_level);
	RESET_FAKE(pt_comm_busy_set);
	RESET_FAKE(pt_comm_busy_clear);
	RESET_FAKE(aw9320x_diff_get);
	RESET_FAKE(calc_flash_crc);
	RESET_FAKE(save_sys_settings);
	RESET_FAKE(save_usr_settings);
	RESET_FAKE(read_sys_settting_from_flash);
	RESET_FAKE(read_usr_settting_from_flash);
	RESET_FAKE(get_serial_number);
	RESET_FAKE(get_glasses_name);
	RESET_FAKE(save_serial_number);
	RESET_FAKE(dump_serial_number);
	RESET_FAKE(enable_power_for_panel);
	RESET_FAKE(disable_power_for_panel);
	RESET_FAKE(opt3007_read);
	RESET_FAKE(erase_audio_buffer);
	RESET_FAKE(request_dmic_stream_start);
	RESET_FAKE(dmic_stream_stop);
	RESET_FAKE(lpuart_async_b);
	RESET_FAKE(read_serial_data);
	RESET_FAKE(serial_rx_clear);
	RESET_FAKE(demo_image_select);
	RESET_FAKE(enqueue_bt_data);
	RESET_FAKE(get_work_mode);
	RESET_FAKE(is_task_running);
	RESET_FAKE(update_persist_task_status_to_idle);
	RESET_FAKE(aw93203_init);
	RESET_FAKE(aw9320x_read_chipid);
	RESET_FAKE(display_close_screen);
	RESET_FAKE(display_reflash_screen);
	RESET_FAKE(enter_wear_burial_point);
	RESET_FAKE(exit_wear_burial_point);
	RESET_FAKE(free_demo_line_buf);
	RESET_FAKE(global_system_resume);
	RESET_FAKE(global_system_suspend);
	RESET_FAKE(init_serial_comm);
	RESET_FAKE(opt3007_get_brightness_level);
	RESET_FAKE(reset_dash_buf);
	RESET_FAKE(set_date);
	task_status_lock = 0;
	g1_pkt_log_clear(&g1_nfc_bt_log);
	enqueue_bt_data_fake.custom_fake = enqueue_bt_data_log;
	get_serial_number_fake.custom_fake = serial_default;
	get_glasses_name_fake.custom_fake = serial_default;
	lpuart_async_b_fake.return_val = -EIO;
	read_serial_data_fake.return_val = -EIO;
	can_enter_low_power = 0;
	esb_signal = 0;
	demo_mode = 0;
	imu_roll_x100 = 0;
	imu_yaw_x100 = 0;
}

G1_UNIT_RESET_HOOK(fakes_nfc_reset);
```

## src/fakes_nfc.h
```c
/* Weak fakes (threads.c overrides some); sys_reboot() fails the test. */
#ifndef G1_UNIT_FAKES_NFC_H_
#define G1_UNIT_FAKES_NFC_H_

#include <stddef.h>
#include <stdint.h>
#include <zephyr/device.h>
#include <zephyr/fff.h>
#include <glasses_state.h>

#include "harness.h"

DECLARE_FAKE_VALUE_FUNC(int64_t, nfc_deadline_set, uint32_t);
DECLARE_FAKE_VOID_FUNC(update_activity_time);
DECLARE_FAKE_VOID_FUNC(enter_silent_mode);
DECLARE_FAKE_VOID_FUNC(exit_silent_mode);
DECLARE_FAKE_VALUE_FUNC(const struct device *, get_charger_device);
extern uint8_t can_enter_low_power;

DECLARE_FAKE_VOID_FUNC(set_ncs_mem_pt_level, uint8_t);
extern int esb_signal;

DECLARE_FAKE_VOID_FUNC(pt_comm_busy_set);
DECLARE_FAKE_VOID_FUNC(pt_comm_busy_clear);
DECLARE_FAKE_VOID_FUNC(aw9320x_diff_get, int32_t *);

DECLARE_FAKE_VALUE_FUNC(int, calc_flash_crc, uint16_t *, int, uint32_t);
DECLARE_FAKE_VALUE_FUNC(int, save_sys_settings, struct GlassesState *, int);
DECLARE_FAKE_VALUE_FUNC(int, save_usr_settings, struct GlassesState *, int);
DECLARE_FAKE_VALUE_FUNC(int, read_sys_settting_from_flash, struct sys_settings *);
DECLARE_FAKE_VALUE_FUNC(int, read_usr_settting_from_flash, struct usr_settings *);
DECLARE_FAKE_VALUE_FUNC(char *, get_serial_number);
DECLARE_FAKE_VALUE_FUNC(char *, get_glasses_name);
DECLARE_FAKE_VALUE_FUNC(int, save_serial_number, const char *);
DECLARE_FAKE_VALUE_FUNC(int, dump_serial_number, const char *);

DECLARE_FAKE_VALUE_FUNC(int, enable_power_for_panel);
DECLARE_FAKE_VALUE_FUNC(int, disable_power_for_panel);
DECLARE_FAKE_VALUE_FUNC(int, opt3007_read, int);
DECLARE_FAKE_VALUE_FUNC(int, erase_audio_buffer);
DECLARE_FAKE_VALUE_FUNC(int, request_dmic_stream_start);
/* dmic_stream_stop() is only in fakes_nfc.c: its two prototypes disagree */

DECLARE_FAKE_VALUE_FUNC(int, lpuart_async_b, const struct device *, uint8_t *, size_t);
DECLARE_FAKE_VALUE_FUNC(int, read_serial_data, const struct device *, uint8_t **, uint32_t *);
DECLARE_FAKE_VOID_FUNC(serial_rx_clear);

DECLARE_FAKE_VOID_FUNC(demo_image_select, uint8_t);
extern uint8_t demo_mode;
extern uint32_t imu_roll_x100;
extern uint32_t imu_yaw_x100;

DECLARE_FAKE_VALUE_FUNC(int, enqueue_bt_data, void *, uint8_t);
DECLARE_FAKE_VALUE_FUNC(int, get_work_mode);
DECLARE_FAKE_VALUE_FUNC(int, is_task_running, struct GlassesState *);
DECLARE_FAKE_VALUE_FUNC(int, update_persist_task_status_to_idle, struct GlassesState *);
DECLARE_FAKE_VOID_FUNC(aw93203_init);
DECLARE_FAKE_VALUE_FUNC(int32_t, aw9320x_read_chipid);
DECLARE_FAKE_VALUE_FUNC(int, display_close_screen, int);
DECLARE_FAKE_VALUE_FUNC(int, display_reflash_screen, uint8_t);
DECLARE_FAKE_VOID_FUNC(enter_wear_burial_point);
DECLARE_FAKE_VOID_FUNC(exit_wear_burial_point);
DECLARE_FAKE_VOID_FUNC(free_demo_line_buf);
DECLARE_FAKE_VALUE_FUNC(int, global_system_resume, struct GlassesState *);
DECLARE_FAKE_VALUE_FUNC(int, global_system_suspend, struct GlassesState *);
DECLARE_FAKE_VALUE_FUNC(int, init_serial_comm);
DECLARE_FAKE_VALUE_FUNC(uint8_t, opt3007_get_brightness_level, struct opt3007_context *);
DECLARE_FAKE_VOID_FUNC(reset_dash_buf, int);
DECLARE_FAKE_VALUE_FUNC(uint32_t, set_date, uint32_t);
extern uint8_t task_status_lock;

extern struct g1_pkt_log g1_nfc_bt_log;

#endif /* G1_UNIT_FAKES_NFC_H_ */
```

## src/nfc_test.h
```c
#ifndef G1_UNIT_NFC_TEST_H_
#define G1_UNIT_NFC_TEST_H_

#include <stddef.h>
#include <stdint.h>
#include <zephyr/device.h>
#include <zephyr/drivers/emul.h>

#include "st25dv_emul.h"

#define TAG_E G1_ST25DV_EMUL

extern uint32_t nfc_field_mv;

/* Every nfc test's before calls this. */
void nfc_wlc_test_reset(void);

void nfc_pt_test_reset(void);

void nfc_test_set_pin_mv(uint32_t mv);

uint8_t nfc_test_sum8(const uint8_t *buf, size_t n);

#endif /* G1_UNIT_NFC_TEST_H_ */
```

## src/test_case_events.c
```c
/* check_work_mode() is silent for the first 10 s after boot. */
#include <string.h>
#include <zephyr/kernel.h>
#include <zephyr/ztest.h>

#include "harness.h"
#include "fakes_nfc.h"
#include "nfc_test.h"

/* used before its definition; the host gcc rejects implicit declarations */
void init_key_event_sem(void);
#include "threads/threads.c"

#define E TAG_E

struct g1_nrf_reset g1_nrf_reset_s;

#define EVT_BOUND        0x11
#define EVT_OUT_UNWORN   0x07
#define EVT_CASE_CLOSED  0x0b
#define EVT_BATTERY      0x0a
#define EVT_CHARGING     0x09

static K_THREAD_STACK_DEFINE(test_nfc_stack, 8192);
static struct k_thread test_nfc_thread;
static bool test_nfc_thread_running;

static void events_before(void *fixture)
{
	ARG_UNUSED(fixture);
	nfc_wlc_test_reset();
	nfc_pt_test_reset();
	init_box_status();
	st25dv_emul_set_write_time_ms(E, 1);

	wear_state_event = 0xff;
	last_bind_state = 0xff;
	last_box_soc = 0xff;
	last_box_status = 0xff;
	last_battery = 0xff;
	last_charging = 0xff;
	last_brightness = 0xff;
	charging_cnt = 0;
	box_status_cnt = 0;
	unwear_cnt = 0;
	wear_cnt = 0;
	chipid_check_cnt = 0;
	is_wearing = 0;
	nfc_deadline = 0;
	nfc_sem_ready = 0;
	can_enter_low_power = 0;

	get_work_mode_fake.return_val = 5;            /* running, not boot / DFU */
	g1_ble()->receiver_thd_is_running = 1;
	g1_state()->battery_left = 50;
	if (g1_clock_uptime_ms() < 10000) {
		g1_clock_advance_ms(10000);
	}
}

static void events_after(void *fixture)
{
	ARG_UNUSED(fixture);
	if (test_nfc_thread_running) {
		k_thread_abort(&test_nfc_thread);
		test_nfc_thread_running = false;
	}
}

ZTEST_SUITE(nfc_events, NULL, NULL, events_before, events_after, NULL);

/* returns the event id, -1 for none */
static int poll(int in_box, int lid_closed)
{
	int n = g1_nfc_bt_log.count;

	check_work_mode(in_box, lid_closed, 1);
	if (g1_nfc_bt_log.count == n) {
		return -1;
	}
	zassert_equal(g1_nfc_bt_log.count, n + 1, "one event per poll");
	zassert_equal(g1_nfc_bt_log.len[n], 3);
	zassert_equal(g1_nfc_bt_log.data[n][0], 0xf5);
	return g1_nfc_bt_log.data[n][1];
}

static void first_polls(int in_box, int lid_closed, int where)
{
	zassert_equal(poll(in_box, lid_closed), EVT_BOUND);
	zassert_equal(poll(in_box, lid_closed), where);
	zassert_equal(poll(in_box, lid_closed), EVT_BATTERY);
}

/* ---- F5 09 / F5 0A ---- */

ZTEST(nfc_events, test_charging_in_the_case_is_reported_as_f5_09_with_1)
{
	set_box_status(2, 1);

	first_polls(1, 1, EVT_CASE_CLOSED);
	zassert_equal(poll(1, 1), EVT_CHARGING);
	zassert_equal(g1_ble()->charging, 1, "F5 09 payload");
	zassert_equal(poll(1, 1), -1, "reported once");
}

ZTEST(nfc_events, test_end_of_charging_in_the_case_is_reported_after_5_polls)
{
	set_box_status(2, 1);
	first_polls(1, 1, EVT_CASE_CLOSED);
	zassert_equal(poll(1, 1), EVT_CHARGING);

	set_box_status(2, 0);
	for (int i = 1; i <= 4; i++) {
		zassert_equal(poll(1, 1), -1, "poll %d", i);
	}
	zassert_equal(poll(1, 1), EVT_CHARGING);
	zassert_equal(g1_ble()->charging, 0);
}

ZTEST(nfc_events, test_taking_the_lens_out_reports_not_charging_at_once)
{
	set_box_status(2, 1);
	first_polls(1, 1, EVT_CASE_CLOSED);
	zassert_equal(poll(1, 1), EVT_CHARGING);

	zassert_equal(poll(0, 0), EVT_OUT_UNWORN);
	zassert_equal(poll(0, 0), EVT_CHARGING);
	zassert_equal(g1_ble()->charging, 0);
}

ZTEST(nfc_events, test_battery_level_is_reported_as_f5_0a_when_it_changes)
{
	first_polls(0, 0, EVT_OUT_UNWORN);
	zassert_equal(poll(0, 0), EVT_CHARGING, "not charging out of the case");
	zassert_equal(poll(0, 0), -1);

	g1_state()->battery_left = 51;
	zassert_equal(poll(0, 0), EVT_BATTERY);
	zassert_equal(poll(0, 0), -1, "same level: nothing");
	g1_state()->battery_left = 49;
	zassert_equal(poll(0, 0), EVT_BATTERY);
}

/* ---- nfc_related() ---- */

static void test_nfc_thread_start(void)
{
	k_thread_create(&test_nfc_thread, test_nfc_stack, K_THREAD_STACK_SIZEOF(test_nfc_stack), nfc_related,
			NULL, NULL, NULL, K_PRIO_PREEMPT(5), 0, K_NO_WAIT);
	test_nfc_thread_running = true;
	k_sleep(K_MSEC(1));
	zassert_equal(nfc_sem_ready, 1);
}

static void case_talks(void)
{
	static const uint8_t query[] = {0x13, 0x01, 0x02, 0x00, 0x16};

	st25dv_emul_set_sys(E, ST25DV_EMUL_SYS_GPO1, 0xff);
	st25dv_emul_enable_mailbox(E);
	zassert_ok(st25dv_emul_rf_put_msg(E, query, sizeof(query)));
	trigger_nfc_event();
}

ZTEST(nfc_events, test_message_from_the_case_puts_the_lens_in_the_case)
{
	uint8_t reply[256];

	test_nfc_thread_start();
	zassert_equal(is_in_box(), 0);

	case_talks();
	k_sleep(K_MSEC(200));

	zassert_equal(is_in_box(), 1, "isInbox");
	zassert_equal(st25dv_emul_rf_get_msg(E, reply, sizeof(reply)), 11, "answered");
	zassert_equal(reply[0], 0x13);
}

ZTEST(nfc_events, test_case_silent_for_3s_takes_the_lens_out_of_the_case)
{
	uint8_t reply[256];

	test_nfc_thread_start();
	case_talks();
	k_sleep(K_MSEC(200));
	zassert_equal(st25dv_emul_rf_get_msg(E, reply, sizeof(reply)), 11);
	set_box_status(BOX_LID_CLOSED, 1);

	g1_clock_advance_ms(2000);
	zassert_equal(is_in_box(), 1, "2.2 s of silence");
	g1_clock_advance_ms(4500);
	zassert_equal(is_in_box(), 0, "6.7 s of silence");
	zassert_equal(is_box_lid_closed(), 0);
}

ZTEST(nfc_events, test_interrupt_without_a_case_message_does_not_put_the_lens_in_the_case)
{
	test_nfc_thread_start();
	st25dv_emul_set_sys(E, ST25DV_EMUL_SYS_GPO1, 0xff);
	st25dv_emul_rf_field(E, true);
	trigger_nfc_event();
	k_sleep(K_MSEC(200));

	zassert_equal(is_in_box(), 0);
}
```

## src/test_case_link.c
```c
/* 0x13 request: 13 01 02 <n> [<case level | 80h charging> [<lid: 06 closed, 07 open>]] <sum>. */
#include <errno.h>
#include <string.h>
#include <zephyr/kernel.h>
#include <zephyr/ztest.h>

#include "harness.h"
#include "fake_npm1300.h"
#include "fakes_nfc.h"
#include "nfc_test.h"

#include "production_test/pt_data.c"
#include "production_test/production_test.c"

#define E TAG_E

void nfc_pt_test_reset(void)
{
	pt_comm.nfc = NULL;
	pt_comm.uart = (const struct device *)1;
	pt_comm.type = PT_COMM_NFC;
	memset(pt_resp_buf, 0, sizeof(pt_resp_buf));
	memset(pt_req_buf, 0, sizeof(pt_req_buf));
	pt_test_mode = 0;
	pt_level_flags.raw = 0;
	aging_mode = 0;
	aging_phase = 0;
	battery_full_flag = false;
	battery_high_v_count = 0;
	battery_full_count = 0;
	battery_info_last_ms = 0;
	charger_enable_ok = true;
	charger_retry_last_ms = 0;
	charger_retry_fail_count = 0;
	memset(pt_uart_frame, 0, sizeof(pt_uart_frame));
}

static void case_before(void *fixture)
{
	ARG_UNUSED(fixture);
	nfc_wlc_test_reset();
	nfc_pt_test_reset();
	init_box_status();
	st25dv_emul_enable_mailbox(E);
	st25dv_emul_set_write_time_ms(E, 1);

	g1_state()->battery_left = 50;
	g1_state()->battery_current_ma = 100;
	g1_state()->battery_temp_x100 = 2500;
	nfc_field_mv = 5500;
}

ZTEST_SUITE(nfc_case, NULL, NULL, case_before, NULL, NULL);

static void case_send(const uint8_t *frame, size_t n)
{
	uint8_t msg[64];

	memcpy(msg, frame, n);
	msg[n] = nfc_test_sum8(frame, n);
	zassert_ok(st25dv_emul_rf_put_msg(E, msg, n + 1));
}

static const uint8_t query[] = {0x13, 0x01, 0x02, 0x00};

static void expect_reply(const uint8_t *got, int n, const uint8_t *exp, size_t en)
{
	char g[3 * 32 + 4];
	char e[3 * 32 + 4];

	zassert_true(n > 0, "no reply (%d)", n);
	g1_hex_format(got, n, g, sizeof(g));
	g1_hex_format(exp, en, e, sizeof(e));
	zassert_true((size_t)n == en && memcmp(got, exp, en) == 0, "\n  got  %s\n  want %s", g,
		     e);
}

ZTEST(nfc_case, test_case_message_is_consumed_and_the_reply_waits_for_the_case)
{
	uint8_t ctrl;

	case_send(query, sizeof(query));
	zassert_equal(init_nfc_comm(), 0);

	ctrl = st25dv_emul_get_dyn(E, ST25DV_EMUL_DYN_MB_CTRL);
	zassert_equal(ctrl & ST25DV_EMUL_RF_PUT_MSG, 0, "case message consumed");
	zassert_equal(ctrl & ST25DV_EMUL_HOST_PUT_MSG, ST25DV_EMUL_HOST_PUT_MSG);
	zassert_equal(st25dv_emul_get_dyn(E, ST25DV_EMUL_DYN_MB_LEN), 10, "11-byte reply");
	zassert_equal(pt_comm_busy_set_fake.call_count, 1, "touch polling paused");
	zassert_equal(pt_comm_busy_clear_fake.call_count, 1);
}

ZTEST(nfc_case, test_charging_flag_follows_the_reply_status)
{
	uint8_t reply[256];

	case_send(query, sizeof(query));
	zassert_equal(init_nfc_comm(), 0);
	zassert_equal(st25dv_emul_rf_get_msg(E, reply, sizeof(reply)), 11);
	zassert_equal(reply[4], 0x00);
	zassert_equal(is_box_charging(), 1, "status 0: charging");

	g1_state()->battery_temp_x100 = 6000; /* status 2: too hot */
	case_send(query, sizeof(query));
	zassert_equal(init_nfc_comm(), 0);
	zassert_equal(st25dv_emul_rf_get_msg(E, reply, sizeof(reply)), 11);
	zassert_equal(reply[4], 0x02);
	zassert_equal(is_box_charging(), 0);

	g1_state()->battery_temp_x100 = 2500;
	g1_state()->battery_left = 100; /* status 1: full */
	case_send(query, sizeof(query));
	zassert_equal(init_nfc_comm(), 0);
	zassert_equal(st25dv_emul_rf_get_msg(E, reply, sizeof(reply)), 11);
	zassert_equal(reply[4], 0x01);
	zassert_equal(is_box_charging(), 0);
}

ZTEST(nfc_case, test_case_level_and_lid_closed_are_taken_from_the_request)
{
	static const uint8_t closed[] = {0x13, 0x01, 0x02, 0x02, 0x80 | 40, 0x06};

	case_send(closed, sizeof(closed));
	zassert_equal(init_nfc_comm(), 0);

	zassert_equal(is_box_lid_closed(), 1);
	zassert_equal(can_enter_low_power, 1, "closed case: low power allowed");
	zassert_equal(get_pt_level(), 40, "F5 0F payload");
	zassert_equal(get_pt_level_flag(), 1, "F5 0E payload");
	zassert_equal(set_ncs_mem_pt_level_fake.arg0_val, 40);
}

ZTEST(nfc_case, test_case_lid_open_clears_the_lid_flag)
{
	static const uint8_t closed[] = {0x13, 0x01, 0x02, 0x02, 60, 0x06};
	static const uint8_t open[] = {0x13, 0x01, 0x02, 0x02, 60, 0x07};
	uint8_t reply[256];

	case_send(closed, sizeof(closed));
	zassert_equal(init_nfc_comm(), 0);
	zassert_true(st25dv_emul_rf_get_msg(E, reply, sizeof(reply)) > 0);
	zassert_equal(is_box_lid_closed(), 1);

	case_send(open, sizeof(open));
	zassert_equal(init_nfc_comm(), 0);
	zassert_equal(is_box_lid_closed(), 0);
	zassert_equal(can_enter_low_power, 0);
	zassert_equal(get_pt_level_flag(), 0);
}

ZTEST(nfc_case, test_request_sum_is_not_read_as_a_lid_code)
{
	static const uint8_t closed[] = {0x13, 0x01, 0x02, 0x02, 60, 0x06};
	/* sum byte 07 = the lid-open code */
	static const uint8_t level_only[] = {0x13, 0x01, 0x02, 0x01, 0xf0};
	uint8_t reply[256];

	case_send(closed, sizeof(closed));
	zassert_equal(init_nfc_comm(), 0);
	zassert_true(st25dv_emul_rf_get_msg(E, reply, sizeof(reply)) > 0);

	case_send(level_only, sizeof(level_only));
	zassert_equal(st25dv_emul_mailbox(E)[5], 0x07);
	zassert_equal(init_nfc_comm(), 0);
	zassert_equal(is_box_lid_closed(), 1);
}

/* 4th high-field reply: byte 9 = 80h, resent 1 s later */
static uint8_t timer_reply[256];
static int timer_reply_len;

static void case_reads(struct k_timer *t)
{
	ARG_UNUSED(t);
	timer_reply_len = st25dv_emul_rf_get_msg(E, timer_reply, sizeof(timer_reply));
}

K_TIMER_DEFINE(case_timer, case_reads, NULL);

static void three_high_field_polls(void)
{
	uint8_t reply[256];

	nfc_field_mv = 6000;
	g1_clock_advance_ms(10001);
	for (int i = 0; i < 3; i++) {
		case_send(query, sizeof(query));
		zassert_equal(init_nfc_comm(), 0);
		zassert_equal(st25dv_emul_rf_get_msg(E, reply, sizeof(reply)), 11);
		zassert_equal(reply[9], 0x64, "poll %d not flagged", i + 1);
	}
}

ZTEST(nfc_case, test_flagged_reply_is_sent_again_when_the_case_has_read_it)
{
	static const uint8_t flagged[] = {0x13, 0x01, 0x02, 0x06, 0x00, 0x17, 0x70,
					  0x32, 0x00, 0x80, 0x55};
	uint8_t again[256];
	int n;

	three_high_field_polls();
	timer_reply_len = 0;
	case_send(query, sizeof(query));
	k_timer_start(&case_timer, K_MSEC(500), K_NO_WAIT);

	zassert_equal(init_nfc_comm(), 0);
	expect_reply(timer_reply, timer_reply_len, flagged, sizeof(flagged));
	n = st25dv_emul_rf_get_msg(E, again, sizeof(again));
	zassert_equal(n, 11, "second reply in the mailbox");
	zassert_mem_equal(again, flagged, 9);
	zassert_equal(again[9], 0x00);
}

ZTEST(nfc_case, test_flagged_reply_stays_when_the_case_has_not_read_it)
{
	uint8_t reply[256];

	three_high_field_polls();
	case_send(query, sizeof(query));

	zassert_equal(init_nfc_comm(), 0);
	zassert_equal(st25dv_emul_rf_get_msg(E, reply, sizeof(reply)), 11);
	zassert_equal(reply[9], 0x80, "the resend found the mailbox busy");
}

ZTEST(nfc_case, test_link_without_a_tag_fails)
{
	global_st25dv_context_ptr = NULL;

	zassert_equal(init_nfc_comm(), -1);
}

/* BCHGCHARGESTATUS: b0 battery detected, b3 constant current */
#define STAT_IDLE 0x01
#define STAT_CC   0x09

static const uint8_t *stat_seq;
static int stat_n;
static int stat_i;

static int read_stat(const struct device *dev, uint8_t base, uint8_t off, uint8_t *v)
{
	ARG_UNUSED(dev);
	zassert_equal(base, 0x03);
	zassert_equal(off, 0x34);
	*v = stat_seq[MIN(stat_i, stat_n - 1)];
	stat_i++;
	return 0;
}

static void charger_status(const uint8_t *seq, int n)
{
	stat_seq = seq;
	stat_n = n;
	stat_i = 0;
	mfd_npm1300_reg_read_fake.custom_fake = read_stat;
	RESET_FAKE(mfd_npm1300_reg_write);
}

ZTEST(nfc_case, test_charger_retry_leaves_a_charging_charger_alone)
{
	static const uint8_t seq[] = {STAT_CC};

	charger_status(seq, ARRAY_SIZE(seq));
	enable_charger_retry();
	zassert_equal(stat_i, 1);
	zassert_equal(mfd_npm1300_reg_write_fake.call_count, 0);
}

ZTEST(nfc_case, test_charger_retry_enables_the_charger_until_it_charges)
{
	static const uint8_t seq[] = {STAT_IDLE, STAT_IDLE, STAT_CC};
	int64_t t0 = g1_clock_uptime_ms();
	int64_t dt;

	charger_status(seq, ARRAY_SIZE(seq));
	enable_charger_retry();
	dt = g1_clock_uptime_ms() - t0;

	zassert_equal(stat_i, 3);
	zassert_equal(mfd_npm1300_reg_write_fake.call_count, 2);
	zassert_equal(mfd_npm1300_reg_write_fake.arg2_history[0], 0x04, "BCHGENABLESET");
	zassert_equal(mfd_npm1300_reg_write_fake.arg3_history[0], 0x01);
	zassert_true(dt >= 40 && dt <= 46, "20 ms after each enable: %lld ms", dt);
	zassert_true(charger_enable_ok);
}

ZTEST(nfc_case, test_charger_retry_gives_up_after_10_attempts)
{
	static const uint8_t seq[] = {STAT_IDLE};
	int64_t t0 = g1_clock_uptime_ms();
	int64_t dt;

	charger_status(seq, ARRAY_SIZE(seq));
	enable_charger_retry();
	dt = g1_clock_uptime_ms() - t0;

	zassert_equal(stat_i, 10);
	zassert_equal(mfd_npm1300_reg_write_fake.call_count, 10);
	zassert_true(dt >= 200 && dt <= 215, "%lld ms", dt);
}

ZTEST(nfc_case, test_charger_failing_four_rounds_a_second_apart_is_marked_failed)
{
	static const uint8_t idle[] = {STAT_IDLE};
	static const uint8_t cc[] = {STAT_CC};

	charger_status(idle, ARRAY_SIZE(idle));
	g1_clock_advance_ms(1000);
	for (int round = 1; round <= 3; round++) {
		enable_charger_retry();
		zassert_true(charger_enable_ok, "round %d", round);
		enable_charger_retry();
		g1_clock_advance_ms(1000);
	}
	enable_charger_retry();
	zassert_false(charger_enable_ok, "fourth round");

	g1_clock_advance_ms(1000);
	charger_status(cc, ARRAY_SIZE(cc));
	enable_charger_retry();
	zassert_true(charger_enable_ok);
}
```

## src/test_ndef.c
```c
/* Expected bytes follow the NFC Forum NDEF 1.0 and WLC 2.0 layouts. */
#include <string.h>
#include <zephyr/ztest.h>

#include "harness.h"
#include "nfc_test.h"

#include "nfc/nfc_wlc.h"

ReturnCode ndefMessageDecode(const ndefConstBuffer *bufPayload, ndefMessage *message);

static void ndef_before(void *fixture)
{
	ARG_UNUSED(fixture);
	nfc_wlc_test_reset();
}

ZTEST_SUITE(nfc_ndef, NULL, NULL, ndef_before, NULL, NULL);

static uint8_t out[512];

static uint32_t encode(const ndefRecord *r)
{
	ndefBuffer b = {out, sizeof(out)};

	zassert_equal(ndefRecordEncode(r, &b), ERR_NONE);
	return b.length;
}

static void expect_bytes(const uint8_t *got, uint32_t n, const uint8_t *exp, uint32_t en)
{
	char g[3 * 64 + 4];
	char e[3 * 64 + 4];

	g1_hex_format(got, n, g, sizeof(g));
	g1_hex_format(exp, en, e, sizeof(e));
	zassert_true(n == en && memcmp(got, exp, n) == 0, "\n  got  %s\n  want %s", g, e);
}

static void record(ndefRecord *r, const char *type, const uint8_t *payload, uint32_t len)
{
	ndefConstBuffer8 t = {(const uint8_t *)type, (uint8_t)strlen(type)};
	ndefConstBuffer p = {payload, len};

	zassert_equal(ndefRecordReset(r), ERR_NONE);
	zassert_equal(ndefRecordSetType(r, NDEF_TNF_RTD_WELL_KNOWN_TYPE, &t), ERR_NONE);
	zassert_equal(ndefRecordSetPayload(r, &p), ERR_NONE);
}

/* ---- records ---- */

ZTEST(nfc_ndef, test_empty_record_is_mb_me_sr_tnf_empty_with_zero_lengths)
{
	static const uint8_t exp[] = {0xd0, 0x00, 0x00};
	ndefRecord r;

	zassert_equal(ndefRecordReset(&r), ERR_NONE);
	expect_bytes(out, encode(&r), exp, sizeof(exp));
}

ZTEST(nfc_ndef, test_short_record_has_a_1_byte_payload_length)
{
	static const uint8_t exp[] = {0xd1, 0x01, 0x03, 'T', 0xaa, 0xbb, 0xcc};
	ndefRecord r;

	record(&r, "T", (const uint8_t *)"\xaa\xbb\xcc", 3);
	zassert_equal(ndefRecordGetHeaderLength(&r), 4);
	zassert_equal(ndefRecordGetLength(&r), 7);
	expect_bytes(out, encode(&r), exp, sizeof(exp));
}

ZTEST(nfc_ndef, test_255_byte_payload_is_still_a_short_record)
{
	static uint8_t payload[255];
	ndefRecord r;

	record(&r, "T", payload, sizeof(payload));
	zassert_equal(encode(&r), 3 + 1 + 255);
	zassert_equal(out[0], 0xd1, "SR set");
	zassert_equal(out[2], 0xff);
}

ZTEST(nfc_ndef, test_256_byte_payload_needs_a_4_byte_big_endian_length)
{
	static uint8_t payload[300];
	static const uint8_t hdr[] = {0xc1, 0x01, 0x00, 0x00, 0x01, 0x2c, 'T'};
	ndefRecord r;

	record(&r, "T", payload, sizeof(payload));
	zassert_equal(ndefRecordGetHeaderLength(&r), 7);
	zassert_equal(encode(&r), 7 + 300);
	expect_bytes(out, 7, hdr, sizeof(hdr));

	record(&r, "T", payload, 256);
	zassert_equal(encode(&r), 7 + 256);
	zassert_equal(out[0], 0xc1, "SR clear");
	zassert_mem_equal(&out[2], "\x00\x00\x01\x00", 4);
}

ZTEST(nfc_ndef, test_id_sets_il_and_adds_the_id_length_and_the_id)
{
	static const uint8_t exp[] = {0xd9, 0x01, 0x02, 0x02, 'U', 'i', 'd', 0x10, 0x20};
	ndefConstBuffer8 id = {(const uint8_t *)"id", 2};
	ndefConstBuffer8 none = {NULL, 0};
	ndefRecord r;

	record(&r, "U", (const uint8_t *)"\x10\x20", 2);
	zassert_equal(ndefRecordSetId(&r, &id), ERR_NONE);
	zassert_equal(ndefRecordGetHeaderLength(&r), 4 + 1 + 2);
	expect_bytes(out, encode(&r), exp, sizeof(exp));

	zassert_equal(ndefRecordSetId(&r, &none), ERR_NONE);
	zassert_equal(r.header & 0x08, 0, "IL cleared with the id");
}

ZTEST(nfc_ndef, test_header_encoder_needs_7_bytes_of_room)
{
	uint8_t small[6];
	ndefBuffer b = {small, sizeof(small)};
	ndefRecord r;

	record(&r, "T", (const uint8_t *)"\x01", 1);
	zassert_equal(ndefRecordEncodeHeader(&r, &b), ERR_NOMEM);
	zassert_equal(b.length, NDEF_RECORD_HEADER_LEN);
}

ZTEST(nfc_ndef, test_record_encoder_reports_the_length_it_needs)
{
	uint8_t small[6];
	ndefBuffer b = {small, sizeof(small)};
	ndefRecord r;

	record(&r, "T", (const uint8_t *)"\xaa\xbb\xcc", 3);
	zassert_equal(ndefRecordEncode(&r, &b), ERR_NOMEM);
	zassert_equal(b.length, 7);
}

ZTEST(nfc_ndef, test_codec_rejects_null_arguments)
{
	ndefRecord r;
	ndefBuffer b = {NULL, 10};
	ndefConstBuffer cb = {NULL, 3};
	ndefConstBuffer8 bad8 = {NULL, 3};

	zassert_equal(ndefRecordReset(NULL), ERR_PARAM);
	zassert_equal(ndefRecordEncode(NULL, &b), ERR_PARAM);
	zassert_equal(ndefRecordReset(&r), ERR_NONE);
	zassert_equal(ndefRecordEncode(&r, &b), ERR_PARAM, "NULL buffer");
	zassert_equal(ndefRecordDecode(&cb, &r), ERR_PARAM);
	zassert_equal(ndefRecordSetType(&r, 1, &bad8), ERR_PARAM, "NULL with a length");
	zassert_equal(ndefRecordSetPayload(&r, &cb), ERR_PARAM);
}

/* ---- decoding ---- */

ZTEST(nfc_ndef, test_short_record_decodes_header_type_and_payload)
{
	static const uint8_t in[] = {0xd1, 0x01, 0x03, 'T', 0xaa, 0xbb, 0xcc};
	ndefConstBuffer b = {in, sizeof(in)};
	ndefRecord r;

	zassert_equal(ndefRecordDecode(&b, &r), ERR_NONE);
	zassert_equal(r.header, 0xd1);
	zassert_equal(ndefHeaderTNF(&r), NDEF_TNF_RTD_WELL_KNOWN_TYPE);
	zassert_true(ndefHeaderIsSetSR(&r));
	zassert_false(ndefHeaderIsSetIL(&r));
	zassert_equal(r.typeLength, 1);
	zassert_equal_ptr(r.type, &in[3]);
	zassert_equal(r.idLength, 0);
	zassert_equal(r.bufPayload.length, 3);
	zassert_equal_ptr(r.bufPayload.buffer, &in[4]);
}

ZTEST(nfc_ndef, test_standard_record_decodes_the_4_byte_length)
{
	static uint8_t in[7 + 300] = {0x81, 0x01, 0x00, 0x00, 0x01, 0x2c, 'T'};
	ndefConstBuffer b = {in, sizeof(in)};
	ndefRecord r;

	zassert_equal(ndefRecordDecode(&b, &r), ERR_NONE);
	zassert_equal(r.header & 0xc0, 0x80, "MB, not ME");
	zassert_equal(r.bufPayload.length, 300);
	zassert_equal_ptr(r.bufPayload.buffer, &in[7]);
}

ZTEST(nfc_ndef, test_id_length_and_id_are_decoded_when_il_is_set)
{
	static const uint8_t in[] = {0xd9, 0x01, 0x02, 0x02, 'U', 'i', 'd', 0x10, 0x20};
	ndefConstBuffer b = {in, sizeof(in)};
	ndefRecord r;

	zassert_equal(ndefRecordDecode(&b, &r), ERR_NONE);
	zassert_equal(r.idLength, 2);
	zassert_equal_ptr(r.id, &in[5]);
	zassert_equal_ptr(r.bufPayload.buffer, &in[7]);
}

ZTEST(nfc_ndef, test_truncated_record_is_a_protocol_error)
{
	static const uint8_t in[] = {0xd9, 0x01, 0x02, 0x02, 'U', 'i', 'd', 0x10, 0x20};
	static const uint8_t std[] = {0xc1, 0x01, 0x00, 0x00, 0x00, 0x01, 'T', 0x55};
	ndefRecord r;

	for (uint32_t n = 0; n < sizeof(in); n++) {
		ndefConstBuffer b = {in, n};

		zassert_equal(ndefRecordDecode(&b, &r), ERR_PROTO, "%u bytes", n);
	}
	for (uint32_t n = 2; n < sizeof(std); n++) {
		ndefConstBuffer b = {std, n};

		zassert_equal(ndefRecordDecode(&b, &r), ERR_PROTO, "standard, %u bytes", n);
	}
}

/* ---- messages ---- */

static ndefRecord rec[3];

static void three_records(ndefMessage *m)
{
	memset(m, 0, sizeof(*m));
	record(&rec[0], "T", (const uint8_t *)"\x01", 1);
	record(&rec[1], "U", (const uint8_t *)"\x02\x03", 2);
	record(&rec[2], "Sp", (const uint8_t *)"\x04\x05\x06", 3);
	for (int i = 0; i < 3; i++) {
		zassert_equal(ndefMessageAppend(m, &rec[i]), ERR_NONE);
	}
}

ZTEST(nfc_ndef, test_append_sets_mb_on_the_first_and_me_on_the_last_record)
{
	ndefMessage m;

	three_records(&m);
	zassert_equal(rec[0].header & 0xc0, 0x80, "first: MB");
	zassert_equal(rec[1].header & 0xc0, 0x00, "middle: neither");
	zassert_equal(rec[2].header & 0xc0, 0x40, "last: ME");
	zassert_equal(m.info.recordCount, 3);
	zassert_equal(m.info.length, 5 + 6 + 8);
	zassert_equal_ptr(ndefMessageGetFirstRecord(&m), &rec[0]);
	zassert_equal_ptr(rec[0].next, &rec[1]);
	zassert_is_null(rec[2].next);
}

ZTEST(nfc_ndef, test_single_record_message_has_mb_and_me)
{
	ndefMessage m = {0};
	ndefRecord r;

	record(&r, "T", (const uint8_t *)"\x01", 1);
	zassert_equal(ndefMessageAppend(&m, &r), ERR_NONE);
	zassert_equal(r.header & 0xc0, 0xc0);
}

ZTEST(nfc_ndef, test_message_encodes_the_records_back_to_back)
{
	static const uint8_t exp[] = {
		0x91, 0x01, 0x01, 'T', 0x01,
		0x11, 0x01, 0x02, 'U', 0x02, 0x03,
		0x51, 0x02, 0x03, 'S', 'p', 0x04, 0x05, 0x06,
	};
	ndefMessage m;
	ndefBuffer b = {out, sizeof(out)};

	three_records(&m);
	zassert_equal(ndefMessageEncode(&m, &b), ERR_NONE);
	expect_bytes(out, b.length, exp, sizeof(exp));
}

ZTEST(nfc_ndef, test_message_encoder_reports_the_length_it_needs)
{
	ndefMessage m;
	uint8_t small[10];
	ndefBuffer b = {small, sizeof(small)};

	three_records(&m);
	zassert_equal(ndefMessageEncode(&m, &b), ERR_NOMEM);
	zassert_equal(b.length, 19);
}

ZTEST(nfc_ndef, test_message_decode_returns_the_encoded_records)
{
	ndefMessage m;
	ndefMessage d;
	ndefBuffer b = {out, sizeof(out)};
	ndefConstBuffer cb;
	const ndefRecord *r;
	static const char *const types[] = {"T", "U", "Sp"};
	static const uint32_t lens[] = {1, 2, 3};
	int i = 0;

	three_records(&m);
	zassert_equal(ndefMessageEncode(&m, &b), ERR_NONE);
	cb.buffer = out;
	cb.length = b.length;

	zassert_equal(ndefMessageDecode(&cb, &d), ERR_NONE);
	zassert_equal(d.info.recordCount, 3);
	zassert_equal(d.info.length, b.length);
	for (r = ndefMessageGetFirstRecord(&d); r != NULL; r = ndefMessageGetNextRecord(r), i++) {
		zassert_true(i < 3);
		zassert_equal(r->typeLength, strlen(types[i]));
		zassert_mem_equal(r->type, types[i], r->typeLength);
		zassert_equal(r->bufPayload.length, lens[i]);
		zassert_equal(r->bufPayload.buffer[0], (uint8_t)(1 + (i == 0 ? 0 : i == 1 ? 1 : 3)));
	}
	zassert_equal(i, 3);
}

/* ---- WLC records ---- */

static ndefType type;
static ndefRecord wlc;

static uint32_t encode_cap(const ndefTypeRtdWlcCapability *cap)
{
	zassert_equal(ndefRtdWlcCapabilityInit(&type, cap), ERR_NONE);
	zassert_equal(ndefTypeToRecord(&type, &wlc), ERR_NONE);
	return encode(&wlc);
}

static uint32_t encode_stai(const ndefTypeRtdWlcStatusInfo *stai)
{
	zassert_equal(ndefRtdWlcStatusInfoInit(&type, stai), ERR_NONE);
	zassert_equal(ndefTypeToRecord(&type, &wlc), ERR_NONE);
	return encode(&wlc);
}

ZTEST(nfc_ndef, test_wlc_capability_record_is_wlccap_with_6_payload_bytes)
{
	static const ndefTypeRtdWlcCapability cap = {
		.wlcProtocolVersion = 0x20,
		.wlcConfigModeReq = 1,
		.wlcConfigWaitTimeRetry = 5,
		.wlcConfigNegoWait = 1,
		.wlcConfigRdConf = 0,
		.capWtIntRfu = 0,
		.capWtInt = 9,
		.ndefRdWt = 0x1e,
		.ndefWriteToInt = 3,
		.ndefWriteWtInt = 0x0a,
	};
	static const uint8_t exp[] = {
		0xd1, 0x06, 0x06, 'W', 'L', 'C', 'C', 'A', 'P',
		0x20,
		0x56,                      /* 01 0101 1 0: mode 1, retry 5, nego 1, rd 0 */
		0x09,
		0x1e, 0x03, 0x0a,
	};

	expect_bytes(out, encode_cap(&cap), exp, sizeof(exp));
}

ZTEST(nfc_ndef, test_wlc_capability_fields_are_packed_at_their_bit_positions)
{
	static const ndefTypeRtdWlcCapability all = {
		.wlcConfigModeReq = 3, .wlcConfigWaitTimeRetry = 0xf, .wlcConfigNegoWait = 1,
		.wlcConfigRdConf = 1, .capWtIntRfu = 7, .capWtInt = 0x1f,
	};
	static const ndefTypeRtdWlcCapability rd_only = {.wlcConfigRdConf = 1};
	static const ndefTypeRtdWlcCapability rfu_only = {.capWtIntRfu = 1};

	encode_cap(&all);
	zassert_equal(out[10], 0xff);
	zassert_equal(out[11], 0xff);
	encode_cap(&rd_only);
	zassert_equal(out[10], 0x01);
	encode_cap(&rfu_only);
	zassert_equal(out[11], 0x20, "RFU starts at b5");
}

ZTEST(nfc_ndef, test_wlc_capability_values_are_cut_to_their_field_width)
{
	static const ndefTypeRtdWlcCapability wide = {
		.wlcConfigModeReq = 4, .wlcConfigWaitTimeRetry = 0x10, .wlcConfigNegoWait = 2,
		.wlcConfigRdConf = 2, .capWtIntRfu = 8, .capWtInt = 0x20,
	};

	encode_cap(&wide);
	zassert_equal(out[10], 0x00, "config 0x%02x", out[10]);
	zassert_equal(out[11], 0x00, "cap wt int 0x%02x", out[11]);
}

ZTEST(nfc_ndef, test_wlc_status_record_carries_only_the_announced_fields)
{
	static const ndefTypeRtdWlcStatusInfo stai = {
		.controlByte1 = 0x05, /* battery level, receive voltage */
		.batteryLevel = 0x32,
		.receivePower = 0x11,
		.receiveVoltage = 0x22,
		.receiveCurrent = 0x33,
	};
	static const uint8_t exp[] = {
		0xd1, 0x07, 0x03, 'W', 'L', 'C', 'S', 'T', 'A', 'I', 0x05, 0x32, 0x22,
	};

	expect_bytes(out, encode_stai(&stai), exp, sizeof(exp));
}

ZTEST(nfc_ndef, test_wlc_status_fields_follow_the_control_byte_bit_order)
{
	static const ndefTypeRtdWlcStatusInfo stai = {
		.controlByte1 = 0xbf, /* all but RFU (b6) */
		.batteryLevel = 0x01,
		.receivePower = 0x02,
		.receiveVoltage = 0x03,
		.receiveCurrent = 0x04,
		.temperatureBattery = 0x05,
		.temperatureWlcl = 0x06,
		.rfu = 0xee,
		.controlByte2 = 0x07,
	};
	static const uint8_t exp[] = {
		0xd1, 0x07, 0x08, 'W', 'L', 'C', 'S', 'T', 'A', 'I',
		0xbf, 0x01, 0x02, 0x03, 0x04, 0x05, 0x06, 0x07,
	};

	expect_bytes(out, encode_stai(&stai), exp, sizeof(exp));
}

ZTEST(nfc_ndef, test_wlc_status_without_fields_is_the_control_byte_alone)
{
	static const ndefTypeRtdWlcStatusInfo stai = {.controlByte1 = 0, .batteryLevel = 9};
	static const uint8_t exp[] = {0xd1, 0x07, 0x01, 'W', 'L', 'C', 'S', 'T', 'A', 'I', 0x00};

	expect_bytes(out, encode_stai(&stai), exp, sizeof(exp));
}

ZTEST(nfc_ndef, test_wlc_record_builders_check_the_type)
{
	static const ndefTypeRtdWlcCapability cap = {0};
	static const ndefTypeRtdWlcStatusInfo stai = {0};

	zassert_equal(ndefRtdWlcCapabilityInit(&type, &cap), ERR_NONE);
	zassert_equal(ndefRtdWlcStatusInfoToRecord(&type, &wlc), ERR_PARAM);
	zassert_equal(ndefRtdWlcStatusInfoInit(&type, &stai), ERR_NONE);
	zassert_equal(ndefRtdWlcCapabilityToRecord(&type, &wlc), ERR_PARAM);
	zassert_equal(ndefRtdWlcCapabilityInit(NULL, &cap), ERR_PARAM);
	zassert_equal(ndefRtdWlcStatusInfoInit(&type, NULL), ERR_PARAM);
	zassert_equal(ndefTypeToRecord(NULL, &wlc), ERR_PARAM);
}
```
