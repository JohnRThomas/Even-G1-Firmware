## CMakeLists.txt
```
# ext_flash, flash_settings and file_storage on emulated flash
cmake_minimum_required(VERSION 3.20.0)
set(G1_UNIT_DRIVERS ON)
include(${CMAKE_CURRENT_LIST_DIR}/../common/unit_setup.cmake)
project(unit_storage_drivers)

g1_unit_firmware(common_utils)
g1_unit_fakes(log misc display)
target_sources(app PRIVATE
  src/storage_fakes.c
  src/test_ext_flash.c
  src/test_flash_settings.c
  src/test_file_storage.c)
```

## prj.conf
```kconfig
# Settings on NVS, as the firmware
CONFIG_FLASH_MAP=y
CONFIG_NVS=y
CONFIG_SETTINGS=y
CONFIG_SETTINGS_NVS=y
```

## src/storage_fakes.c
```c
#include <string.h>

#include "harness.h"
#include "storage_fakes.h"

DEFINE_FAKE_VOID_FUNC(ext_flash_power_up);
DEFINE_FAKE_VOID_FUNC(ext_flash_power_down);
DEFINE_FAKE_VALUE_FUNC(int, watchdog_feed);
DEFINE_FAKE_VALUE_FUNC(uint8_t *, get_app_whitelist_info);

uint8_t watchdog_enabled;
uint8_t fuel_gauge_stuck;
uint8_t g1_test_whitelist[G1_TEST_WHITELIST_SIZE];

static uint8_t *whitelist_default(void)
{
	return g1_test_whitelist;
}

static void storage_fakes_reset(bool keep_media)
{
	ARG_UNUSED(keep_media);
	RESET_FAKE(ext_flash_power_up);
	RESET_FAKE(ext_flash_power_down);
	RESET_FAKE(watchdog_feed);
	RESET_FAKE(get_app_whitelist_info);
	get_app_whitelist_info_fake.custom_fake = whitelist_default;
	watchdog_enabled = 0;
	fuel_gauge_stuck = 0;
	memset(g1_test_whitelist, 0, sizeof(g1_test_whitelist));
}

G1_UNIT_RESET_HOOK(storage_fakes_reset);
```

## src/storage_fakes.h
```c
#ifndef STORAGE_FAKES_H_
#define STORAGE_FAKES_H_

#include <stdint.h>
#include <zephyr/fff.h>

#define G1_TEST_WHITELIST_SIZE 0x15e2

DECLARE_FAKE_VOID_FUNC(ext_flash_power_up);
DECLARE_FAKE_VOID_FUNC(ext_flash_power_down);
DECLARE_FAKE_VALUE_FUNC(int, watchdog_feed);
DECLARE_FAKE_VALUE_FUNC(uint8_t *, get_app_whitelist_info);

extern uint8_t watchdog_enabled;
extern uint8_t fuel_gauge_stuck;
extern uint8_t g1_test_whitelist[G1_TEST_WHITELIST_SIZE];

#endif /* STORAGE_FAKES_H_ */
```

## src/test_ext_flash.c
```c
#include <errno.h>
#include <string.h>
#include <zephyr/ztest.h>

#include "harness.h"
#include "nor_flash.h"
#include "storage_fakes.h"

#include "sensors_audio/ext_flash.c"

ZTEST_SUITE(ext_flash, NULL, NULL, NULL, NULL, NULL);

static struct GlassesState *gs(void)
{
	return g1_state();
}

/* ---- ext_flash_api_init ---- */

/* 32 MiB / 4 KiB pages */
ZTEST(ext_flash, test_api_init_installs_the_wrappers_and_the_page_count)
{
	gs()->flash_read = NULL;
	gs()->flash_write = NULL;
	gs()->flash_erase = NULL;
	gs()->flash_page_count = 0;

	zassert_equal(ext_flash_api_init(&gs()->flash_read, &gs()->flash_write,
					 &gs()->flash_erase), 0);

	zassert_equal_ptr(gs()->flash_read, ext_flash_read);
	zassert_equal_ptr(gs()->flash_write, ext_flash_write);
	zassert_equal_ptr(gs()->flash_erase, ext_flash_erase);
	zassert_equal(gs()->flash_page_count, 8192);
	zassert_equal_ptr(ext_flash_dev, G1_NOR_DEV);
}

ZTEST(ext_flash, test_api_init_without_the_flash_returns_minus_one_and_installs_nothing)
{
	ext_flash_dev = NULL;
	gs()->flash_read = NULL;
	gs()->flash_write = NULL;
	gs()->flash_erase = NULL;
	gs()->flash_page_count = 0;
	g1_device_set_ready(G1_NOR_DEV, false);

	zassert_equal(ext_flash_api_init(&gs()->flash_read, &gs()->flash_write,
					 &gs()->flash_erase), -1);

	zassert_is_null(gs()->flash_read);
	zassert_is_null(gs()->flash_write);
	zassert_is_null(gs()->flash_erase);
	zassert_equal(gs()->flash_page_count, 0);
	zassert_is_null(ext_flash_dev);
}

/* ---- read / write / erase ---- */

ZTEST(ext_flash, test_write_lands_at_its_address_and_reads_back_unaligned)
{
	static const uint8_t data[8] = { 0x11, 0x22, 0x33, 0x44, 0x55, 0x66, 0x77, 0x88 };
	static const uint8_t want[10] = { 0xff, 0x11, 0x22, 0x33, 0x44,
					  0x55, 0x66, 0x77, 0x88, 0xff };
	uint8_t buf[10];

	zassert_equal(gs()->flash_write(gs(), 0x1004, data, sizeof(data)), 0);
	zassert_equal(gs()->flash_read(gs(), 0x1003, buf, sizeof(buf)), 0);

	zassert_mem_equal(buf, want, sizeof(want));
}

ZTEST(ext_flash, test_erase_clears_whole_sectors_only)
{
	uint8_t *m = g1_nor_mem(0x1fff, 0x1002);

	memset(m, 0x00, 0x1002);

	zassert_equal(gs()->flash_erase(gs(), 0x2000, 0x1000), 0);

	zassert_equal(m[0], 0x00, "byte before the sector");
	for (int i = 1; i <= 0x1000; i++) {
		zassert_equal(m[i], 0xff, "0x%x not erased", 0x1fff + i);
	}
	zassert_equal(m[0x1001], 0x00, "byte after the sector");
}

ZTEST(ext_flash, test_driver_errors_are_returned_unchanged)
{
	static const uint8_t data[4] = { 0 };
	uint8_t buf[4];

	g1_nor_fail(G1_NOR_READ, 1, -ETIMEDOUT);
	g1_nor_fail(G1_NOR_WRITE, 1, -EIO);
	g1_nor_fail(G1_NOR_ERASE, 1, -EBUSY);

	zassert_equal(gs()->flash_read(gs(), 0, buf, 4), -ETIMEDOUT);
	zassert_equal(gs()->flash_write(gs(), 0, data, 4), -EIO);
	zassert_equal(gs()->flash_erase(gs(), 0, G1_NOR_SECTOR), -EBUSY);
}

/* ---- power hooks ---- */

static int reads_at_power_up;
static int reads_at_power_down;

static void power_up_probe(void)
{
	reads_at_power_up = g1_nor_stats()->calls[G1_NOR_READ];
}

static void power_down_probe(void)
{
	reads_at_power_down = g1_nor_stats()->calls[G1_NOR_READ];
}

/* module_mask bit 4: the flash module */
ZTEST(ext_flash, test_power_hooks_wrap_each_access_while_the_flash_module_is_off)
{
	static const uint8_t data[4] = { 0 };
	uint8_t buf[4];

	gs()->module_mask &= ~BIT(4);
	ext_flash_power_up_fake.custom_fake = power_up_probe;
	ext_flash_power_down_fake.custom_fake = power_down_probe;

	zassert_equal(gs()->flash_read(gs(), 0, buf, 4), 0);
	zassert_equal(reads_at_power_up, 0, "powered up after the read");
	zassert_equal(reads_at_power_down, 1, "powered down before the read");

	zassert_equal(gs()->flash_write(gs(), 0, data, 4), 0);
	zassert_equal(gs()->flash_erase(gs(), 0, G1_NOR_SECTOR), 0);
	zassert_equal(ext_flash_power_up_fake.call_count, 3);
	zassert_equal(ext_flash_power_down_fake.call_count, 3);
}

ZTEST(ext_flash, test_power_hooks_are_skipped_while_the_flash_module_is_on)
{
	static const uint8_t data[4] = { 0 };
	uint8_t buf[4];

	zassert_true(gs()->module_mask & BIT(4));

	gs()->flash_read(gs(), 0, buf, 4);
	gs()->flash_write(gs(), 0, data, 4);
	gs()->flash_erase(gs(), 0, G1_NOR_SECTOR);

	zassert_equal(ext_flash_power_up_fake.call_count, 0);
	zassert_equal(ext_flash_power_down_fake.call_count, 0);
}

/* ---- serialisation ---- */

K_THREAD_STACK_DEFINE(writer_stack, 2048);
static struct k_thread writer;
static int writer_ret;

static void writer_fn(void *p1, void *p2, void *p3)
{
	static const uint8_t data[4] = { 0xa5, 0xa5, 0xa5, 0xa5 };

	ARG_UNUSED(p1);
	ARG_UNUSED(p2);
	ARG_UNUSED(p3);
	writer_ret = g1_state()->flash_write(g1_state(), 0x4000, data, sizeof(data));
}

ZTEST(ext_flash, test_an_access_waits_for_the_flash_mutex)
{
	writer_ret = 1;
	k_mutex_lock(&ext_flash_mutex, K_FOREVER);
	k_thread_create(&writer, writer_stack, K_THREAD_STACK_SIZEOF(writer_stack), writer_fn,
			NULL, NULL, NULL, K_PRIO_PREEMPT(1), 0, K_NO_WAIT);

	g1_clock_advance_ms(10); /* the writer runs and blocks on the mutex */
	zassert_equal(g1_nor_stats()->calls[G1_NOR_WRITE], 0, "write went past the mutex");
	zassert_equal(*g1_nor_mem(0x4000, 4), 0xff);

	k_mutex_unlock(&ext_flash_mutex);
	zassert_ok(k_thread_join(&writer, K_MSEC(100)));
	zassert_equal(writer_ret, 0);
	zassert_equal(*g1_nor_mem(0x4000, 4), 0xa5);
}
```

## src/test_file_storage.c
```c
#include <errno.h>
#include <string.h>
#include <zephyr/ztest.h>
#include <zephyr/sys/byteorder.h>

#include "harness.h"
#include "fakes_display.h"
#include "nor_flash.h"

#include "storage/file_storage.c"

#define FILE_ADDR 0x300000

static void file_storage_before(void *fixture)
{
	ARG_UNUSED(fixture);
	file_addr = 0;
	file_buf_len = 0;
	file_type = 0;
}

ZTEST_SUITE(file_storage, NULL, NULL, file_storage_before, NULL, NULL);

/* ---- queue ---- */

ZTEST(file_storage, test_queue_returns_messages_in_order_with_their_length)
{
	static const uint8_t a[3] = { 1, 2, 3 };
	static const uint8_t b[200] = { 4 };
	struct file_msg m;

	zassert_ok(enqueue_file(a, sizeof(a)));
	zassert_ok(enqueue_file(b, sizeof(b)));

	zassert_ok(dequeue_file(&m));
	zassert_equal(m.len, 3);
	zassert_mem_equal(m.data, a, 3);
	zassert_ok(dequeue_file(&m));
	zassert_equal(m.len, 200);
	zassert_mem_equal(m.data, b, 200);
	zassert_equal(dequeue_file(&m), -ENOMSG);
}

ZTEST(file_storage, test_full_queue_drops_the_oldest_message)
{
	struct file_msg m;

	for (uint8_t i = 0; i < 31; i++) {
		zassert_ok(enqueue_file(&i, 1));
	}
	for (uint8_t i = 1; i <= 30; i++) {
		zassert_ok(dequeue_file(&m));
		zassert_equal(m.data[0], i, "got %u, want %u", m.data[0], i);
	}
	zassert_equal(dequeue_file(&m), -ENOMSG);
}

/* DEFECT: no length check; 255 bytes overflow enqueue_file()'s stack frame. Skipped. */
ZTEST(file_storage, test_enqueue_refuses_more_than_200_bytes)
{
	static uint8_t big[255];

	ztest_test_skip();
	zassert_not_equal(enqueue_file(big, sizeof(big)), 0);
}

/* ---- upload assembly ---- */

static uint8_t payload[0x1200];

static void make_payload(size_t n)
{
	for (size_t k = 0; k < n; k++) {
		payload[k] = (uint8_t)(k * 7 + 3);
	}
}

static void chunk_first(uint32_t addr, const uint8_t *data, size_t n)
{
	uint8_t msg[FILE_MSG_LEN];

	msg[0] = 0x01;
	sys_put_be32(addr, &msg[1]);
	memcpy(&msg[5], data, n);
	zassert_ok(enqueue_file(msg, 5 + n));
	try_to_save_file(g1_state());
}

static void chunk_next(uint8_t id, const uint8_t *data, size_t n)
{
	uint8_t msg[FILE_MSG_LEN];

	msg[0] = id;
	memcpy(&msg[1], data, n);
	zassert_ok(enqueue_file(msg, 1 + n));
	try_to_save_file(g1_state());
}

static void chunk_end(void)
{
	static const uint8_t end[2] = { 0x0d, 0x0e };

	zassert_ok(enqueue_file(end, sizeof(end)));
	try_to_save_file(g1_state());
}

/* LAST_FILE_CRC: zlib.crc32 of the 4 address bytes + the data */
ZTEST(file_storage, test_small_upload_is_stored_at_its_address_with_its_crc)
{
	chunk_first(FILE_ADDR, (const uint8_t *)"123456789abc", 12);
	zassert_equal(g1_nor_stats()->calls[G1_NOR_WRITE], 0, "written before the end");

	chunk_end();

	zassert_mem_equal(g1_nor_mem(FILE_ADDR, 12), "123456789abc", 12);
	zassert_equal(*g1_nor_mem(FILE_ADDR + 12, 1), 0xff);
	zassert_equal(LAST_FILE_CRC, 0xe679ec0f, "crc 0x%08x", LAST_FILE_CRC);
}

ZTEST(file_storage, test_upload_is_written_in_4_kib_blocks_and_the_tail_at_the_end)
{
	make_payload(22 * 192);
	chunk_first(FILE_ADDR, payload, 192);
	for (int i = 1; i < 22; i++) {
		chunk_next((uint8_t)(i + 1), &payload[i * 192], 192);
	}

	zassert_equal(g1_nor_stats()->calls[G1_NOR_WRITE], 1);
	zassert_mem_equal(g1_nor_mem(FILE_ADDR, 0x1000), payload, 0x1000);
	zassert_equal(file_addr, FILE_ADDR + 0x1000);
	zassert_equal(file_buf_len, 128);

	chunk_end();

	zassert_mem_equal(g1_nor_mem(FILE_ADDR + 0x1000, 128), &payload[0x1000], 128);
	zassert_equal(LAST_FILE_CRC, 0xb14f3a7b, "crc 0x%08x", LAST_FILE_CRC);
}

ZTEST(file_storage, test_demo_image_upload_starts_the_demo_task)
{
	static const uint8_t data[4] = { 1, 2, 3, 4 };

	chunk_first(0x1c0000, data, sizeof(data));

	zassert_equal(g1_state()->dash_buf->type, 0x0c);
	zassert_equal(g1_state()->dash_buf->data[0], 10);
	zassert_equal(update_persist_task_status_fake.call_count, 1);
	zassert_equal_ptr(update_persist_task_status_fake.arg0_val, g1_state());
	zassert_equal(update_persist_task_status_fake.arg1_val, 0x10);
	zassert_equal(update_persist_task_status_fake.arg2_val, 2);
}

ZTEST(file_storage, test_demo_image_upload_while_the_demo_task_runs_does_not_restart_it)
{
	static const uint8_t data[4] = { 1, 2, 3, 4 };

	g1_state()->task_status->task = 0x10;
	g1_state()->dash_buf->data[0] = 3;

	chunk_first(0x1c0000, data, sizeof(data));

	zassert_equal(g1_state()->dash_buf->type, 0x0c);
	zassert_equal(g1_state()->dash_buf->data[0], 3);
	zassert_equal(update_persist_task_status_fake.call_count, 0);
}

/* the demo region ends at 0x200000 */
static void fill_demo_region(void)
{
	make_payload(192);
	chunk_first(0x1c0000, payload, 192);
	for (int i = 0; file_addr < 0x200000; i++) {
		zassert_true(i < 2000, "demo region never filled");
		chunk_next((uint8_t)i, payload, 192);
	}
}

ZTEST(file_storage, test_demo_image_data_past_the_region_is_not_written)
{
	fill_demo_region();

	for (int i = 0; i < 3; i++) {
		chunk_next(0x55, payload, 192);
	}
	chunk_end();

	zassert_equal(g1_nor_stats()->last_addr[G1_NOR_WRITE], 0x200000 - 0x1000);
	zassert_equal(*g1_nor_mem(0x200000, 1), 0xff);
}

/* DEFECT: chunks past the region are still appended to file_buf, which overflows. */
ZTEST_EXPECT_FAIL(file_storage, test_demo_image_data_past_the_region_is_not_buffered);
ZTEST(file_storage, test_demo_image_data_past_the_region_is_not_buffered)
{
	uint32_t len;

	fill_demo_region();
	len = file_buf_len;

	for (int i = 0; i < 3; i++) {
		chunk_next(0x55, payload, 192);
	}

	zassert_equal(file_buf_len, len, "buffered %u bytes past the region",
		      file_buf_len - len);
}

/* ---- commit request ---- */

ZTEST(file_storage, test_commit_request_sets_the_command_and_wakes_the_commit_thread)
{
	storage_commit_request(6, 0);

	zassert_equal(g1_state()->dashboard_cmd, 6);
	zassert_equal(sys_settings_dirty, 0);
	zassert_equal(k_sem_count_get(&g1_state()->dashboard_position_sem), 1);
}

ZTEST(file_storage, test_commit_requests_coalesce_with_the_newest_command_and_sticky_dirty)
{
	storage_commit_request(6, 1);
	storage_commit_request(3, 0);

	zassert_equal(g1_state()->dashboard_cmd, 3);
	zassert_equal(sys_settings_dirty, 1);
	zassert_equal(k_sem_count_get(&g1_state()->dashboard_position_sem), 1);
}
```

## src/test_flash_settings.c
```c
#include <errno.h>
#include <string.h>
#include <zephyr/ztest.h>
#include <zephyr/settings/settings.h>

#include "harness.h"
#include "nor_flash.h"
#include "storage_fakes.h"

#include "storage/flash_settings.c"

#define SECTOR    G1_NOR_SECTOR
#define USR_ADDR  0x134000
#define WL_ADDR   0x131000
#define FONT_ADDR 0x300000

static struct local_store first_store;

static void *flash_settings_setup(void)
{
	sett_init(&first_store);
	return NULL;
}

ZTEST_SUITE(flash_settings, NULL, flash_settings_setup, NULL, NULL, NULL);

static const struct g1_nor_stats *st(void)
{
	return g1_nor_stats();
}

static void fill(uint32_t addr, uint8_t v, size_t len)
{
	memset(g1_nor_mem(addr, len), v, len);
}

/* A 100 ms sleep on the 1 ms tick lasts up to 101 ms. */
static void assert_slept(int64_t t0, int n)
{
	int64_t dt = g1_clock_uptime_ms() - t0;

	zassert_true(dt >= n * 100 && dt <= n * 101, "%lld ms, want %d sleeps of 100 ms",
		     (long long)dt, n);
}

static void assert_bytes(uint32_t addr, uint8_t v, size_t len, const char *what)
{
	const uint8_t *m = g1_nor_mem(addr, len);

	for (size_t i = 0; i < len; i++) {
		zassert_equal(m[i], v, "%s: 0x%x is 0x%02x, want 0x%02x", what,
			      (unsigned int)(addr + i), m[i], v);
	}
}

/* ---- flash_settings_read ---- */

ZTEST(flash_settings, test_read_returns_the_bytes_at_the_address)
{
	static const uint8_t rec[5] = { 1, 2, 3, 4, 5 };
	uint8_t buf[5] = { 0 };

	memcpy(g1_nor_mem(USR_ADDR, 5), rec, 5);

	zassert_equal(flash_settings_read(USR_ADDR, buf, 5), 0);
	zassert_mem_equal(buf, rec, 5);
	zassert_equal(st()->calls[G1_NOR_READ], 1);
}

ZTEST(flash_settings, test_read_retries_a_failed_read_every_100_ms)
{
	static const uint8_t rec[4] = { 9, 8, 7, 6 };
	uint8_t buf[4] = { 0 };
	int64_t t0;

	memcpy(g1_nor_mem(USR_ADDR, 4), rec, 4);
	g1_nor_fail(G1_NOR_READ, 2, -EIO);
	t0 = g1_clock_uptime_ms();

	zassert_equal(flash_settings_read(USR_ADDR, buf, 4), 0);

	zassert_mem_equal(buf, rec, 4);
	zassert_equal(st()->calls[G1_NOR_READ], 3);
	assert_slept(t0, 2);
}

ZTEST(flash_settings, test_read_gives_up_after_ten_retries_with_the_error)
{
	uint8_t buf[4];
	int64_t t0 = g1_clock_uptime_ms();

	g1_nor_fail(G1_NOR_READ, 100, -EIO);

	zassert_equal(flash_settings_read(USR_ADDR, buf, 4), -EIO);
	zassert_equal(st()->calls[G1_NOR_READ], 11);
	assert_slept(t0, 10);
}

ZTEST(flash_settings, test_read_without_the_flash_device_returns_minus_one)
{
	uint8_t buf[4];
	int64_t t0 = g1_clock_uptime_ms();

	g1_device_set_ready(G1_NOR_DEV, false);

	zassert_equal(flash_settings_read(USR_ADDR, buf, 4), -1);
	zassert_equal(st()->calls[G1_NOR_READ], 0);
	assert_slept(t0, 10);
}

/* ---- write_and_verify ---- */

ZTEST(flash_settings, test_write_and_verify_replaces_the_sector_with_data_and_zero_fill)
{
	static const uint8_t rec[5] = { 0x10, 0x20, 0x30, 0x40, 0x50 };

	fill(USR_ADDR, 0xaa, SECTOR);

	zassert_equal(flash_settings_write_and_verify(USR_ADDR, rec, sizeof(rec)), 0);

	zassert_mem_equal(g1_nor_mem(USR_ADDR, 5), rec, 5);
	assert_bytes(USR_ADDR + 5, 0x00, SECTOR - 5, "zero fill");
	assert_bytes(USR_ADDR + SECTOR, 0xff, 16, "next sector");
	zassert_equal(st()->calls[G1_NOR_ERASE], 1);
	zassert_equal(st()->last_addr[G1_NOR_ERASE], USR_ADDR);
	zassert_equal(st()->last_len[G1_NOR_ERASE], SECTOR);
	zassert_equal(st()->calls[G1_NOR_WRITE], 1);
	zassert_equal(st()->last_len[G1_NOR_WRITE], SECTOR);
	zassert_equal(st()->calls[G1_NOR_READ], 2);
}

ZTEST(flash_settings, test_write_and_verify_leaves_unchanged_data_alone)
{
	static const uint8_t rec[5] = { 0x10, 0x20, 0x30, 0x40, 0x50 };

	fill(USR_ADDR, 0xaa, SECTOR);
	memcpy(g1_nor_mem(USR_ADDR, 5), rec, 5);

	zassert_equal(flash_settings_write_and_verify(USR_ADDR, rec, sizeof(rec)), 0);

	zassert_equal(st()->calls[G1_NOR_ERASE], 0);
	zassert_equal(st()->calls[G1_NOR_WRITE], 0);
	assert_bytes(USR_ADDR + 5, 0xaa, SECTOR - 5, "rest of the sector");
}

ZTEST(flash_settings, test_write_and_verify_reports_a_verify_mismatch_as_1)
{
	static const uint8_t rec[4] = { 0x01, 0x02, 0x03, 0x04 };

	g1_nor_fail(G1_NOR_WRITE, 1, 0); /* write-protected: data dropped, success reported */

	zassert_equal(flash_settings_write_and_verify(USR_ADDR, rec, sizeof(rec)), 1);
}

ZTEST(flash_settings, test_write_and_verify_returns_a_read_error_without_erasing)
{
	static const uint8_t rec[4] = { 0x01, 0x02, 0x03, 0x04 };

	g1_nor_fail(G1_NOR_READ, 1, -EIO);

	zassert_equal(flash_settings_write_and_verify(USR_ADDR, rec, sizeof(rec)), -EIO);
	zassert_equal(st()->calls[G1_NOR_ERASE], 0);
}

ZTEST(flash_settings, test_write_and_verify_returns_an_erase_error_without_writing)
{
	static const uint8_t rec[4] = { 0x01, 0x02, 0x03, 0x04 };

	fill(USR_ADDR, 0xaa, SECTOR);
	g1_nor_fail(G1_NOR_ERASE, 1, -EIO);

	zassert_equal(flash_settings_write_and_verify(USR_ADDR, rec, sizeof(rec)), -EIO);
	zassert_equal(st()->calls[G1_NOR_WRITE], 0);
	assert_bytes(USR_ADDR, 0xaa, SECTOR, "old record");
}

ZTEST(flash_settings, test_write_and_verify_returns_a_write_error)
{
	static const uint8_t rec[4] = { 0x01, 0x02, 0x03, 0x04 };

	g1_nor_fail(G1_NOR_WRITE, 1, -EIO);

	zassert_equal(flash_settings_write_and_verify(USR_ADDR, rec, sizeof(rec)), -EIO);
}

ZTEST(flash_settings, test_write_and_verify_at_an_address_inside_a_sector_fails)
{
	static const uint8_t rec[4] = { 0x01, 0x02, 0x03, 0x04 };

	fill(USR_ADDR, 0xaa, SECTOR);

	zassert_equal(flash_settings_write_and_verify(USR_ADDR + 0x10, rec, sizeof(rec)),
		      -EINVAL);
	assert_bytes(USR_ADDR, 0xaa, SECTOR, "sector");
}

ZTEST(flash_settings, test_write_and_verify_without_the_flash_device_returns_minus_one)
{
	static const uint8_t rec[4] = { 0x01, 0x02, 0x03, 0x04 };

	g1_device_set_ready(G1_NOR_DEV, false);

	zassert_equal(flash_settings_write_and_verify(USR_ADDR, rec, sizeof(rec)), -1);
	zassert_equal(st()->calls[G1_NOR_READ] + st()->calls[G1_NOR_ERASE] +
			      st()->calls[G1_NOR_WRITE], 0);
}

/* DEFECT: no length check; overruns the 4 KiB heap buffer. Skipped. */
ZTEST(flash_settings, test_write_and_verify_refuses_more_than_one_sector)
{
	static uint8_t big[SECTOR + 16];

	ztest_test_skip();
	memset(big, 0x5a, sizeof(big));
	zassert_not_equal(flash_settings_write_and_verify(USR_ADDR, big, sizeof(big)), 0);
	zassert_equal(st()->calls[G1_NOR_WRITE], 0);
}

/* ---- whitelist ---- */

ZTEST(flash_settings, test_whitelist_is_written_over_two_sectors)
{
	static uint8_t wl[0x15e2];

	for (size_t i = 0; i < sizeof(wl); i++) {
		wl[i] = (uint8_t)(i * 31 + 7);
	}

	zassert_equal(write_whitelist_to_flash(WL_ADDR, wl, sizeof(wl)), 0);

	zassert_mem_equal(g1_nor_mem(WL_ADDR, sizeof(wl)), wl, sizeof(wl));
	assert_bytes(WL_ADDR + sizeof(wl), 0x00, 2 * SECTOR - sizeof(wl), "zero fill");
	assert_bytes(WL_ADDR + 2 * SECTOR, 0xff, 16, "third sector");
	zassert_equal(st()->calls[G1_NOR_ERASE], 2);
}

ZTEST(flash_settings, test_whitelist_with_a_failing_page_reports_the_error)
{
	static uint8_t wl[0x15e2];

	memset(wl, 0x3c, sizeof(wl));
	g1_nor_fail(G1_NOR_ERASE, 1, -EIO);

	zassert_equal(write_whitelist_to_flash(WL_ADDR, wl, sizeof(wl)), -EIO);
	assert_bytes(WL_ADDR + SECTOR, 0x3c, sizeof(wl) - SECTOR, "second page");
}

ZTEST(flash_settings, test_whitelist_of_exactly_one_sector_writes_one_sector)
{
	static uint8_t wl[SECTOR];

	memset(wl, 0x3c, sizeof(wl));
	fill(WL_ADDR + SECTOR, 0x00, 16);

	zassert_equal(write_whitelist_to_flash(WL_ADDR, wl, sizeof(wl)), 0);

	assert_bytes(WL_ADDR, 0x3c, SECTOR, "first sector");
	assert_bytes(WL_ADDR + SECTOR, 0x00, 16, "next sector");
	zassert_equal(st()->calls[G1_NOR_ERASE], 1);
}

/* ---- write_font ---- */

ZTEST(flash_settings, test_font_write_programs_len_bytes_and_leaves_the_rest_erased)
{
	static const uint8_t glyph[12] = { 1, 2, 3, 4, 5, 6, 7, 8, 9, 10, 11, 12 };

	fill(FONT_ADDR, 0x00, SECTOR);

	zassert_equal(write_font(FONT_ADDR, glyph, sizeof(glyph)), 0);

	zassert_mem_equal(g1_nor_mem(FONT_ADDR, 12), glyph, 12);
	assert_bytes(FONT_ADDR + 12, 0xff, SECTOR - 12, "rest of the sector");
	zassert_equal(st()->calls[G1_NOR_WRITE], 1);
	zassert_equal(st()->last_len[G1_NOR_WRITE], 12);
}

ZTEST(flash_settings, test_font_write_leaves_unchanged_data_alone)
{
	static const uint8_t glyph[12] = { 1, 2, 3, 4, 5, 6, 7, 8, 9, 10, 11, 12 };

	memcpy(g1_nor_mem(FONT_ADDR, 12), glyph, 12);

	zassert_equal(write_font(FONT_ADDR, glyph, sizeof(glyph)), 0);
	zassert_equal(st()->calls[G1_NOR_ERASE], 0);
	zassert_equal(st()->calls[G1_NOR_WRITE], 0);
}

ZTEST(flash_settings, test_font_write_retries_after_a_failed_verify)
{
	static const uint8_t glyph[8] = { 1, 2, 3, 4, 5, 6, 7, 8 };
	int64_t t0 = g1_clock_uptime_ms();

	g1_nor_fail(G1_NOR_WRITE, 1, 0);

	zassert_equal(write_font(FONT_ADDR, glyph, sizeof(glyph)), 0);

	zassert_mem_equal(g1_nor_mem(FONT_ADDR, 8), glyph, 8);
	zassert_equal(st()->calls[G1_NOR_WRITE], 2);
	assert_slept(t0, 1);
}

ZTEST(flash_settings, test_font_write_gives_up_after_ten_attempts)
{
	static const uint8_t glyph[8] = { 1, 2, 3, 4, 5, 6, 7, 8 };
	int64_t t0 = g1_clock_uptime_ms();

	g1_nor_fail(G1_NOR_WRITE, 100, 0);

	zassert_equal(write_font(FONT_ADDR, glyph, sizeof(glyph)), 1);
	zassert_equal(st()->calls[G1_NOR_WRITE], 10);
	assert_slept(t0, 9);
}

ZTEST(flash_settings, test_font_write_without_the_flash_device_gives_up_with_minus_one)
{
	static const uint8_t glyph[8] = { 1, 2, 3, 4, 5, 6, 7, 8 };
	int64_t t0 = g1_clock_uptime_ms();

	g1_device_set_ready(G1_NOR_DEV, false);

	zassert_equal(write_font(FONT_ADDR, glyph, sizeof(glyph)), -1);
	assert_slept(t0, 9);
}

/* DEFECT: the QSPI driver rejects lengths > 4 not a multiple of 4; the tail is never stored. */
ZTEST_EXPECT_FAIL(flash_settings, test_font_write_stores_a_length_that_is_not_a_multiple_of_4);
ZTEST(flash_settings, test_font_write_stores_a_length_that_is_not_a_multiple_of_4)
{
	static const uint8_t tail[10] = { 1, 2, 3, 4, 5, 6, 7, 8, 9, 10 };

	zassert_equal(write_font(FONT_ADDR, tail, sizeof(tail)), 0);
	zassert_mem_equal(g1_nor_mem(FONT_ADDR, sizeof(tail)), tail, sizeof(tail));
}

/* ---- calc_flash_crc ---- */

ZTEST(flash_settings, test_crc_of_the_check_string_is_0xb4c8)
{
	uint16_t crc = 0xffff;

	memcpy(g1_nor_mem(0x140000, 9), "123456789", 9);

	zassert_equal(calc_flash_crc(&crc, 0x140000, 9), 0);
	zassert_equal(crc, 0xb4c8, "crc 0x%04x", crc);
	zassert_equal(st()->calls[G1_NOR_READ], 1);
	zassert_equal(st()->last_len[G1_NOR_READ], 9);
}

ZTEST(flash_settings, test_crc_refuses_a_null_crc_or_an_empty_range)
{
	uint16_t crc = 0xffff;

	zassert_equal(calc_flash_crc(NULL, 0x140000, 9), -1);
	zassert_equal(calc_flash_crc(&crc, 0x140000, 0), -1);
	zassert_equal(crc, 0xffff);
	zassert_equal(st()->calls[G1_NOR_READ], 0);
}

ZTEST(flash_settings, test_crc_without_the_flash_device_returns_minus_one)
{
	uint16_t crc = 0xffff;

	g1_device_set_ready(G1_NOR_DEV, false);

	zassert_equal(calc_flash_crc(&crc, 0x140000, 9), -1);
	zassert_equal(crc, 0xffff);
}

ZTEST(flash_settings, test_crc_read_error_returns_minus_one)
{
	uint16_t crc = 0xffff;

	g1_nor_fail(G1_NOR_READ, 1, -EIO);

	zassert_equal(calc_flash_crc(&crc, 0x140000, 9), -1);
	zassert_equal(crc, 0xffff);
}

ZTEST(flash_settings, test_crc_feeds_the_watchdog_only_when_it_runs_and_the_gauge_is_ok)
{
	uint16_t crc = 0xffff;

	calc_flash_crc(&crc, 0x140000, 9);
	zassert_equal(watchdog_feed_fake.call_count, 0, "watchdog disabled");

	watchdog_enabled = 1;
	fuel_gauge_stuck = 1;
	calc_flash_crc(&crc, 0x140000, 9);
	zassert_equal(watchdog_feed_fake.call_count, 0, "gauge stuck");

	fuel_gauge_stuck = 0;
	calc_flash_crc(&crc, 0x140000, 9);
	zassert_equal(watchdog_feed_fake.call_count, 1);
}

/*
 * 0x1379 from an independent CRC-16/USB. DEFECT: a uint8_t loop index hangs for len >= 256.
 * Skipped.
 */
ZTEST(flash_settings, test_crc_over_300_bytes)
{
	uint16_t crc = 0xffff;
	uint8_t *m = g1_nor_mem(0x140000, 300);

	ztest_test_skip();
	for (int k = 0; k < 300; k++) {
		m[k] = (uint8_t)(k * 13 + 5);
	}
	zassert_equal(calc_flash_crc(&crc, 0x140000, 300), 0);
	zassert_equal(crc, 0x1379, "crc 0x%04x", crc);
}

/* ---- settings glue ---- */

ZTEST(flash_settings, test_sett_init_mounts_the_settings_and_installs_the_local_store)
{
	zassert_equal(first_store.status, 1, "status %d", first_store.status);
	zassert_equal_ptr(first_store.write, local_store_write);
	zassert_equal_ptr(first_store.load, local_store_load);
	zassert_equal_ptr(first_store.del, local_store_delete);
}

struct read_req {
	void *dst;
	size_t len;
	int calls;
	int ret;
};

static ssize_t record_read(void *cb_arg, void *data, size_t len)
{
	struct read_req *r = cb_arg;

	r->dst = data;
	r->len = len;
	r->calls++;
	if (r->ret < 0) {
		return r->ret;
	}
	memset(data, 0x5a, len);
	return len;
}

ZTEST(flash_settings, test_sett_handler_loads_each_key_into_its_field)
{
	struct GlassesState *s = g1_state();
	const struct {
		const char *key;
		void *dst;
		size_t len;
	} keys[] = {
		{ "ble_whitelist_app", g1_test_whitelist, 0x15e2 },
		{ "dashboard_ts", s->dashboard_ts, 0x75 },
		{ "countdown_ts", s->countdown_ts, 7 },
		{ "first_enter_flag", &s->first_enter_flag, 4 },
		{ "brightness_level", &s->panel.panel_brightness_level, 1 },
		{ "3dof_enable", &s->imu.dof3_enable, 1 },
		{ "display_mode", &s->display_mode, 1 },
		{ "runtime_mode", &s->work_mode, 1 },
		{ "user_sched_info", s->user_sched_info, 0x16a },
		{ "wakeup_angle", &s->imu.level, 1 },
	};

	for (size_t i = 0; i < ARRAY_SIZE(keys); i++) {
		struct read_req r = { 0 };

		zassert_equal(sett_handler(keys[i].key, keys[i].len, record_read, &r), 0, "%s",
			      keys[i].key);
		zassert_equal(r.calls, 1, "%s", keys[i].key);
		zassert_equal_ptr(r.dst, keys[i].dst, "%s: wrong field", keys[i].key);
		zassert_equal(r.len, keys[i].len, "%s: length %u", keys[i].key,
			      (unsigned int)r.len);
	}
}

ZTEST(flash_settings, test_sett_handler_returns_the_read_error)
{
	struct read_req r = { .ret = -EIO };

	zassert_equal(sett_handler("brightness_level", 1, record_read, &r), -EIO);
}

ZTEST(flash_settings, test_sett_handler_ignores_unknown_keys)
{
	struct read_req r = { 0 };

	zassert_equal(sett_handler("no_such_key", 1, record_read, &r), 0);
	zassert_equal(r.calls, 0);
}

ZTEST(flash_settings, test_sett_handler_skips_blocks_that_are_not_allocated)
{
	struct GlassesState *s = g1_state();
	void *dash = s->dashboard_ts;
	void *count = s->countdown_ts;
	void *sched = s->user_sched_info;
	struct read_req r = { 0 };

	s->dashboard_ts = NULL;
	s->countdown_ts = NULL;
	s->user_sched_info = NULL;
	zassert_equal(sett_handler("dashboard_ts", 0x75, record_read, &r), 0);
	zassert_equal(sett_handler("countdown_ts", 7, record_read, &r), 0);
	zassert_equal(sett_handler("user_sched_info", 0x16a, record_read, &r), 0);
	s->dashboard_ts = dash;
	s->countdown_ts = count;
	s->user_sched_info = sched;

	zassert_equal(r.calls, 0);
}

ZTEST(flash_settings, test_local_store_value_comes_back_on_load)
{
	uint8_t level = 7;

	zassert_equal(local_store_write("brightness_level", &level, 1), 0);
	g1_state()->panel.panel_brightness_level = 0;

	zassert_ok(settings_load_subtree("ar_glass_userdata_settings"));
	zassert_equal(g1_state()->panel.panel_brightness_level, 7);
}

ZTEST(flash_settings, test_local_store_delete_removes_the_key)
{
	uint8_t mode = 3;

	zassert_equal(local_store_write("display_mode", &mode, 1), 0);
	local_store_delete("display_mode");
	g1_state()->display_mode = 0x55;

	zassert_ok(settings_load_subtree("ar_glass_userdata_settings"));
	zassert_equal(g1_state()->display_mode, 0x55);
}

/* DEFECT: local_store_write() returns 0 when the save fails. */
ZTEST_EXPECT_FAIL(flash_settings, test_local_store_write_reports_a_failed_save);
ZTEST(flash_settings, test_local_store_write_reports_a_failed_save)
{
	static uint8_t big[SECTOR];

	zassert_not_equal(local_store_write("user_sched_info", big, sizeof(big)), 0);
}

/* DEFECT: unbounded strcat() into path[128] overflows the stack. Skipped. */
ZTEST(flash_settings, test_local_store_refuses_a_key_longer_than_the_path_buffer)
{
	static char key[160];
	uint8_t v = 1;

	ztest_test_skip();
	memset(key, 'k', sizeof(key) - 1);
	zassert_not_equal(local_store_write(key, &v, 1), 0);
}
```
