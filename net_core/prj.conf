## CMakeLists.txt
```
# SPDX-License-Identifier: Apache-2.0
#
# Even Realities G1 network core firmware (reconstruction of v1.66).  Built as the
# network core child image of the application (../cmake/modules/mcuboot/CMakeLists.txt);
# NCS signs it for b0n and MCUboot into net_core_app_update.bin.

cmake_minimum_required(VERSION 3.20.0)

find_package(Zephyr REQUIRED HINTS $ENV{ZEPHYR_BASE})
project(net_core)

# Link order = target address order of the vendor code.
target_sources(app PRIVATE
  src/main.c
  src/ipc.c
  src/hci_rpmsg.c
  src/app_esb.c
  src/timeslot.c
)

# The NCS ESB driver signals its events on SWI0, which MPSL already uses on this core.
# src/esb_evt_irq.h moves them to SWI3; it is force-included in front of the SDK's esb.c
set(G1_ESB_DIR ${ZEPHYR_NRF_MODULE_DIR}/subsys/esb)
set(G1_ESB_LIB ..__nrf__subsys__esb)
if(NOT EXISTS ${G1_ESB_DIR}/esb.c OR NOT TARGET ${G1_ESB_LIB})
  message(FATAL_ERROR "NCS ESB driver (${G1_ESB_DIR}/esb.c, target ${G1_ESB_LIB}) not found: "
                      "cannot move its event interrupt off SWI0")
endif()
set_property(SOURCE ${G1_ESB_DIR}/esb.c TARGET_DIRECTORY ${G1_ESB_LIB} APPEND PROPERTY
             COMPILE_OPTIONS -I${G1_ESB_DIR} -include ${CMAKE_CURRENT_SOURCE_DIR}/src/esb_evt_irq.h)

# Build time reported to the application core: configure time.
string(TIMESTAMP G1_BUILD_TIME "%Y-%m-%d %H:%M:%S")
set_property(SOURCE src/main.c TARGET_DIRECTORY app APPEND PROPERTY
             COMPILE_DEFINITIONS G1_BUILD_TIME="${G1_BUILD_TIME}")
```

## Kconfig
```
# ESB raises its event interrupt on SWI0 (IRQ 26), which is also the default MPSL
# low-priority interrupt on the nRF5340 network core.  ESB and the Bluetooth
# controller share the radio through MPSL timeslots here, so MPSL is moved to
# SWI3 (IRQ 29).  The option has no prompt, hence the default here and not in prj.conf.
config MPSL_LOW_PRIO_IRQN
	default 29

source "Kconfig.zephyr"
```

## prj.conf
```kconfig
CONFIG_SPEED_OPTIMIZATIONS=y
CONFIG_ASSERT=y
CONFIG_ASSERT_NO_COND_INFO=y
CONFIG_ASSERT_NO_MSG_INFO=y
CONFIG_SPIN_VALIDATE=y
CONFIG_SMP=n
CONFIG_THREAD_NAME=n
CONFIG_LOG=y
CONFIG_LOG_MODE_DEFERRED=y
CONFIG_LOG_FRONTEND=n
CONFIG_LOG_PRINTK=y
CONFIG_BT=y
CONFIG_BT_HCI_RAW=y
CONFIG_BT_HCI_RAW_RESERVE=1
CONFIG_IPC_SERVICE=y
CONFIG_IPC_SERVICE_BACKEND_RPMSG=y
CONFIG_MBOX=y
CONFIG_OPENAMP_MASTER=n
CONFIG_OPENAMP_SLAVE=y
CONFIG_BT_LL_SOFTDEVICE=y
CONFIG_BT_LL_SOFTDEVICE_BUILD_TYPE_LIB=y
CONFIG_BT_LL_SOFTDEVICE_MULTIROLE=y
CONFIG_BT_CTLR_LE_ENC=y
CONFIG_DYNAMIC_INTERRUPTS=y
CONFIG_DYNAMIC_DIRECT_INTERRUPTS=y
CONFIG_ESB=y
CONFIG_ESB_DYNAMIC_INTERRUPTS=y
CONFIG_ESB_MAX_PAYLOAD_LENGTH=251
CONFIG_NRF_RPC=y
CONFIG_MPSL_TIMESLOT_SESSION_COUNT=1
CONFIG_POSIX_API=y
CONFIG_TINYCRYPT=y
CONFIG_TINYCRYPT_AES=y
CONFIG_HEAP_MEM_POOL_SIZE=2560
CONFIG_SYS_HEAP_AUTO=y
CONFIG_MAIN_STACK_SIZE=1024
CONFIG_SYSTEM_WORKQUEUE_STACK_SIZE=1024
CONFIG_BT_MAX_CONN=2
CONFIG_BT_BUF_CMD_TX_COUNT=32
CONFIG_BT_BUF_ACL_TX_COUNT=24
CONFIG_NRF_RTC_TIMER_USER_CHAN_COUNT=1

# controller assertions go to bt_ctlr_assert_handle() (src/hci_rpmsg.c)
CONFIG_BT_CTLR_ASSERT_HANDLER=y

CONFIG_BT_BUF_ACL_TX_SIZE=251
CONFIG_BT_BUF_ACL_RX_SIZE=502
CONFIG_BT_CTLR_DATA_LENGTH_MAX=251

CONFIG_BT_CTLR_TX_PWR_PLUS_3=y
CONFIG_BT_CTLR_SDC_MAX_CONN_EVENT_LEN_DEFAULT_OVERRIDE=y
CONFIG_BT_CTLR_SDC_MAX_CONN_EVENT_LEN_DEFAULT=4000000

CONFIG_BT_HCI_ACL_FLOW_CONTROL=n

CONFIG_MPU_STACK_GUARD=y

# None of these are used, save space in the netcore image by turning them off.
CONFIG_BT_CENTRAL=n
CONFIG_BT_OBSERVER=n
CONFIG_BT_CTLR_PHY_CODED=n
CONFIG_GPIO=n
```

## src/main.c
```c
/*
 * Even Realities G1 network core - main.c.
 *
 * Global context, "cpunet-hw-id" endpoint (configuration from the app core),
 * ESB event bookkeeping/statistics and the main supervision loop.
 */
#include <string.h>
#include <stdlib.h>
#include <zephyr/kernel.h>
#include <zephyr/sys/reboot.h>
#include <esb.h>
#include <zephyr/drivers/timer/nrf_rtc_timer.h>

#include "net_common.h"
#include "main.h"
#include "app_esb.h"
#include "hci_rpmsg.h"
#include "ipc.h"
#include "timeslot.h"

/* G1_BUILD_TIME (reported to the app core) is defined by ../CMakeLists.txt */

int net_log_level = 2;
static int sync_offset = -EBUSY;
static uint8_t first_cfg_log = 1;

static struct net_ctx *net_ctx;
static uint32_t esb_tx_ok_cnt;
static uint32_t esb_tx_fail_cnt;
static uint32_t esb_rx_cnt;
static size_t tx_len;
static struct k_msgq esb_msgq;

static int64_t now_ticks;                      /* signed: matches k_uptime_ticks() */
static uint64_t now_ms;
static uint64_t esb_rx_ms;
static uint64_t last_report_ms;

uint8_t esb_evt_active;
static uint8_t esb_rssi;
static uint8_t last_rssi;
uint8_t esb_tx_done;
uint8_t esb_tx_state;
uint8_t esb_tx_kind;
uint8_t esb_tx_buf[ESB_TX_BUF_SIZE];
uint8_t esb_channel;
static uint8_t rx_repeat;
static uint8_t last_seq;

static int hwid_received(struct net_ctx *ctx, const uint8_t *data, size_t len)
{
	uint8_t buf[16] = {0};

	switch (data[0]) {
	case 0:
		ctx->role = data[1];
		ctx->mode = data[2];
		ctx->channel = data[3];
		if (data[4] != 0xff && data[5] != 0 && data[5] != 0xff && data[4] != 0) {
			base_addr_0[0] = data[4];
			base_addr_0[1] = data[4];
			base_addr_0[2] = data[4];
			base_addr_0[3] = data[4];
			addr_prefix[0] = data[4];
			addr_prefix[1] = data[5];
			base_addr_1[0] = data[5];
			base_addr_1[1] = data[5];
			base_addr_1[2] = data[5];
			base_addr_1[3] = data[5];
		}
		buf[0] = 1;
		buf[1] = 1;
		ctx->ipc.send(buf, sizeof(buf));
		if (first_cfg_log) {
			first_cfg_log = 0;
			NET_INF("L %d, R %d, M %d C %d\n", len, ctx->role, ctx->mode, ctx->channel);
		}
		break;
	case 8:
		net_ctx->mode = 1;
		timeslot_handler_stop();
		NET_INF("M %d\n", net_ctx->mode);
		break;
	case 10:
		esb_link_set_high();
		NET_INF("H\n");
		break;
	case 11:
		esb_link_set_low();
		NET_INF("L\n");
		break;
	case 12:
		esb_link_set_paused();
		NET_INF("P\n");
		break;
	default:
		break;
	}

	return 0;
}

/* Sends the ESB statistics to the application core; returns 1 if the report was sent. */
static int send_esb_stats(void)
{
	uint8_t buf[32] = {0};
	uint8_t retry = 10;
	int sent = 0;

	buf[0] = 1;
	buf[1] = 7;
	memcpy(&buf[2], &esb_tx_ok_cnt, 4);
	memcpy(&buf[6], &esb_tx_fail_cnt, 4);
	memcpy(&buf[10], &esb_rx_cnt, 4);
	buf[14] = esb_rssi;

	do {
		if (net_ctx->ipc.send(buf, sizeof(buf)) > 0) {
			sent = 1;
			break;
		}
		retry--;
		if (retry == 0) {
			break;
		}
		k_msleep(10);
	} while (1);

	return sent;
}

void ipc_send_esb_status(uint8_t val)
{
	uint8_t buf[8] = {0};
	uint8_t retry = 10;

	buf[0] = 1;
	buf[1] = 0xd;
	buf[2] = val;

	do {
		if (net_ctx->ipc.send(buf, sizeof(buf)) > 0) {
			break;
		}
		retry--;
		if (retry == 0) {
			break;
		}
		k_msleep(10);
	} while (1);
}

int esb_tx_buf_set(const uint8_t *data, size_t len)
{
	memcpy(esb_tx_buf, data, len);
	tx_len = len;
	return 0;
}

size_t esb_tx_buf_len_get(void)
{
	return tx_len;
}

void esb_tx_buf_clear(void)
{
	memset(esb_tx_buf, 0, sizeof(esb_tx_buf));
	tx_len = 0;
	esb_tx_state = 0;
}

int net_mode_get(void)
{
	return net_ctx->mode;
}

int net_role_get(void)
{
	return net_ctx->role;
}

static void esb_thread_wake(void)
{
	if (k_sem_count_get(&net_ctx->sem1) == 0) {
		k_sem_give(&net_ctx->sem1);
	}
}

static int esb_rx_msgq_put(const uint8_t *data);

/* Queues a received ESB packet and wakes the ESB thread. */
static void esb_rx_enqueue(const uint8_t *data, size_t len)
{
	uint8_t buf[252] = {0};

	memcpy(buf, data, len);
	esb_rx_msgq_put(buf);
	esb_thread_wake();
}

static void app_esb_event_handler(struct app_esb_evt *evt)
{
	esb_evt_active = 1;

	switch (evt->type) {
	case 0:
		esb_tx_ok_cnt++;
		break;
	case 1:
		esb_tx_fail_cnt++;
		break;
	case 2:
		esb_rx_cnt++;
		if (net_ctx->mode == 1) {
			break;
		}
		if (net_ctx->role == 2) {
			if ((esb_tx_kind == 1 && esb_tx_state == 2) && (++rx_repeat > 1)) {
				rx_repeat = 0;
				esb_tx_state = 0;
				esb_tx_kind = 0;
				esb_tx_done = 2;
				esb_thread_wake();
			}

		} else if (esb_tx_kind != 0) {
			if (esb_tx_kind == 2) {
				esb_tx_kind = 0;
			} else if (esb_tx_kind == 1 && esb_tx_state == 2) {
				esb_tx_kind = 0;
				esb_tx_done = 2;
				esb_thread_wake();
			}
		}
		esb_rssi = evt->rssi;
		if (evt->data[0] == 0x10 || evt->data[0] == 0x11) {
			break;
		}
		if (net_ctx->role == 2 && evt->len > 15) {
			if (last_seq == evt->data[0x11]) {
				break;
			}
			last_seq = evt->data[0x11];
		}
		esb_rx_enqueue(evt->data, evt->len);
		esb_rx_ms = k_ticks_to_ms_ceil64(k_uptime_ticks());
		break;
	default:
		NET_ERR("UN ESB!\n");
		break;
	}

	esb_evt_active = 0;
}

static int rtc_sync_check(void)
{
	int offset;

	if (sync_offset != -EBUSY) {
		return 0;
	}
	offset = z_nrf_rtc_timer_nrf53net_offset_get();
	if (offset == -EBUSY) {
		return 1;
	}
	sync_offset = offset;
	*(volatile uint32_t *)0x20070000 = 0xa5a5a5a5;
	NET_INF("SYNC, offset %d\n", sync_offset);

	return 0;
}

int esb_rx_msgq_init(void)
{
	int err = k_msgq_alloc_init(&esb_msgq, 0xfb, 4);

	if (err) {
		NET_ERR("k_msgq alloc failed\n");
	}

	return err;
}

static int esb_rx_msgq_put(const uint8_t *data)
{
	uint8_t buf[252];
	int err;

	if (esb_msgq.max_msgs == 0) {
		return 1;
	}

	memcpy(buf, data, 0xfb);
	err = k_msgq_put(&esb_msgq, buf, K_NO_WAIT);
	if (err) {
		NET_ERR("en ESB F\n");
	}

	return err;
}

int esb_rx_msgq_get(uint8_t *data)
{
	uint8_t buf[252];
	int err;

	memset(buf, 0, 0xfb);
	if (esb_msgq.max_msgs == 0) {
		return 1;
	}

	err = k_msgq_get(&esb_msgq, buf, K_NO_WAIT);
	if (err == 0) {
		memcpy(data, buf, 0xfb);
	}

	return err;
}

/* App-core handshake messages; main() retries each send up to 20 times. */
static int mac_send(void)
{
	uint8_t buf[16] = {0};
	int ret;

	buf[0] = 1;
	buf[1] = 3;
	if (net_ctx->role == 1) {
		memcpy(&buf[2], net_ctx->mac0, 6);
	} else {
		memcpy(&buf[2], net_ctx->mac1, 6);
	}
	ret = net_ctx->ipc.send(buf, sizeof(buf));
	NET_INF("mac\n");
	return ret;
}

static int bt_send(void)
{
	uint8_t buf[32] = {0};
	int ret;

	buf[0] = 1;
	buf[1] = 6;
	strcpy((char *)&buf[2], G1_BUILD_TIME);
	ret = net_ctx->ipc.send(buf, sizeof(buf));
	NET_INF("bt\n");
	return ret;
}

int main(void)
{
	struct net_ctx *ctx;
	int cnt;
	uint8_t err;
	int ret;
	int i;

	NET_INF("net %s\n", G1_BUILD_TIME);
	ipc_init();
	NET_INF("global init\n");

	ctx = k_malloc(sizeof(*ctx));
	memset(ctx, 0, sizeof(*ctx));
	memset(ctx->mac0, 0xff, sizeof(ctx->mac0));
	memset(ctx->mac1, 0xff, sizeof(ctx->mac1));
	k_sem_init(&ctx->sem0, 0, 1);
	k_sem_init(&ctx->sem1, 0, 1);
	ctx->channel = 0xff;
	ipc_ops_init(&ctx->ipc);
	ctx->hwid_ep.id = 1;
	ctx->hwid_ep.name = "cpunet-hw-id";
	ctx->hwid_ep.cb = hwid_received;
	ctx->ipc.reg(&ctx->hwid_ep);
	NET_INF("done\n");

	net_ctx = ctx;

	/* Wait (up to 20 x 300 ms) for the app core to answer the role request. */
	i = 20;
	while ((ret = net_ctx->role) == 0) {
		rtc_sync_check();
		{
			uint8_t buf[8] = {0};

			buf[0] = 1;
			buf[1] = 2;
			net_ctx->ipc.send(buf, sizeof(buf));
		}
		NET_INF("resend\n");
		if (net_ctx->role == 0) {
			k_msleep(300);
		}
		if (--i == 0) {
			sys_reboot(SYS_REBOOT_COLD);
		}
	}
	NET_INF("role %d mode %d\n", ret, net_ctx->mode);

	if (net_ctx->role == 1) {
		hci_rpmsg_get_static_addr(net_ctx->mac0);
		NET_INF("M\n");
	} else if (net_ctx->role == 2) {
		hci_rpmsg_get_static_addr(net_ctx->mac1);
		NET_INF("S\n");
	}

	for (i = 0; i < 20; i++) {
		if (mac_send() >= 0) {
			break;
		}
		k_msleep(50);
	}

	for (i = 20; i && rtc_sync_check(); i--) {
		k_msleep(50);
	}

	esb_msgq.max_msgs = 0;

	if (net_ctx->channel != 0xff) {
		esb_set_rf_channel(net_ctx->channel);
		esb_channel = net_ctx->channel;
	} else {
		esb_set_rf_channel(0);
	}

	NET_INF("addr 0 0x%02X-0x%02X-0x%02X-0x%02X\n", base_addr_0[0], base_addr_0[1],
		base_addr_0[2], base_addr_0[3]);
	NET_INF("addr 1 0x%02X-0x%02X-0x%02X-0x%02X\n", base_addr_1[0], base_addr_1[1],
		base_addr_1[2], base_addr_1[3]);

	if (net_ctx->role == 1 || net_ctx->role == 2) {
		esb_ops_init(&net_ctx->esb);
		hci_rpmsg_init();
		k_msleep(1000);
		net_ctx->esb.start();
	}

	if (net_ctx->role == 1) {
		err = app_esb_init(ESB_MODE_PTX, app_esb_event_handler);
	} else {
		err = app_esb_init(ESB_MODE_PRX, app_esb_event_handler);
	}
	if (err) {
		NET_ERR("esb init failed %d\n", err);
		return 0;
	}

	for (i = 0; i < 20; i++) {
		if (bt_send() >= 0) {
			break;
		}
		k_msleep(100);
	}

	rtc_sync_check();

	cnt = 0;
	while (1) {
		if (esb_link_state_get() != 3 && net_ctx->mode != 1) {
			now_ticks = k_uptime_ticks();
			now_ms = k_ticks_to_ms_ceil64(now_ticks);

			if (last_rssi > 50) {
				if (esb_rssi >= 1 && esb_rssi <= 39) {
					cnt++;
				} else {
					cnt = 0;
				}
			} else if (last_rssi <= 39) {
				cnt = (esb_rssi > 50) ? 3 : 0;
			}

			if (now_ms - last_report_ms >= 10000) {
				last_report_ms = now_ms;
				send_esb_stats();
			} else if ((((esb_rssi <= 39 && last_rssi > 50) ||
				     (esb_rssi > 50 && last_rssi <= 39)) &&
				    cnt > 2) &&
				   send_esb_stats()) {
				last_report_ms = now_ms;
				last_rssi = esb_rssi;
				cnt = 0;
			}
		}
		k_msleep(1000);
	}

	return 0;
}
```

## src/app_esb.c
```c
/*
 * Even Realities G1 network core - ESB link between the two glasses
 * (derived from nrf/samples/esb/esb_ptx|esb_prx).
 */
#include <string.h>
#include <zephyr/kernel.h>
#include <zephyr/irq.h>
#include <zephyr/logging/log.h>
#include <zephyr/drivers/clock_control.h>
#include <zephyr/drivers/clock_control/nrf_clock_control.h>
#include <esb.h>
#include <nrf.h>

#include "net_common.h"
#include "app_esb.h"
#include "main.h"
#include "timeslot.h"

/* NOLINTNEXTLINE(misc-use-internal-linkage): kernel macro */
LOG_MODULE_REGISTER(app_esb);

uint8_t base_addr_0[4] = {0xC9, 0xC9, 0xC9, 0xC9};
uint8_t base_addr_1[4] = {0xA3, 0xA3, 0xA3, 0xA3};
uint8_t addr_prefix[2] = {0xE9, 0xD3};

static int esb_link_state = 1;

static app_esb_cb_t app_evt_cb;
static struct app_esb_evt app_evt;
static int tx_count;
static struct esb_ops *g_esb_ops;

static uint8_t tx_busy;
static uint8_t esb_prx;
static uint8_t radio_active;
static struct esb_payload ack_payload;
static struct esb_payload rx_payload;
static struct esb_payload tx_payload;

static K_THREAD_STACK_DEFINE(esb_thread_stack, 0x600);
static struct k_thread esb_thread_data;

static int esb_ipc_recv(struct net_ctx *ctx, const uint8_t *data, size_t len)
{
	uint8_t buf[252] = {0};

	memcpy(buf, data, len);

	if (net_mode_get() == 1) {
		return 0;
	}

	if (len > CONFIG_ESB_MAX_PAYLOAD_LENGTH) {
		NET_ERR("data len exceed:%d %d\n", len, CONFIG_ESB_MAX_PAYLOAD_LENGTH);
		return -1;
	}

	if (esb_tx_buf_len_get() != 0) {
		return -1;
	}

	esb_tx_buf_set(buf, len);
	esb_tx_state = 1;
	return 0;
}

static void esb_thread(void)
{
	struct esb_ops *ops = g_esb_ops;
	struct net_ctx *ctx = CONTAINER_OF(ops, struct net_ctx, esb);
	uint8_t buf[252] = {0};
	uint8_t retry;

	buf[0] = (ctx->role == 1) ? 6 : 4;

	esb_rx_msgq_init();

	while (1) {
		if (net_mode_get() == 1) {
			k_sleep(K_MSEC(5000));
			continue;
		}

		if (esb_tx_done == 2 && esb_evt_active == 0) {
			esb_tx_buf_clear();
			ipc_send_esb_status(2);
			esb_tx_done = 0;
		}

		if (esb_rx_msgq_get(&buf[1]) == 0) {
			retry = 10;
			while (1) {
				if (ctx->ipc.send(buf, sizeof(buf)) > 0) {
					break;
				}
				retry--;
				if (retry == 0) {
					break;
				}
				k_sleep(K_MSEC(10));
			}
		}

		k_sem_take(&ctx->sem1, K_FOREVER);
	}
}

static void esb_thread_start(void)
{
	k_thread_create(&esb_thread_data, esb_thread_stack, 0x600, (k_thread_entry_t)esb_thread,
			NULL, NULL, NULL, K_PRIO_COOP(5), 0, K_NO_WAIT);
}

void esb_ops_init(struct esb_ops *ops)
{
	struct net_ctx *ctx = CONTAINER_OF(ops, struct net_ctx, esb);
	uint8_t *buf;

	ops->buf = k_malloc(ESB_OPS_BUF_SIZE);
	memset(ops->buf, 0, ESB_OPS_BUF_SIZE);
	buf = ops->buf;
	buf[0] = 0xfb;
	memcpy(&buf[0x11], ctx->mac1, 6);

	ops->start = esb_thread_start;
	if (ctx->role == 1) {
		ops->ep.id = 2;
		ops->ep.name = "cpunet-esbm";
	} else {
		ops->ep.id = 4;
		ops->ep.name = "cpunet-esbs";
	}
	ops->ep.cb = esb_ipc_recv;
	ctx->ipc.reg(&ops->ep);
	g_esb_ops = ops;
}

static void event_handler(struct esb_evt const *event);

static int esb_initialize(uint8_t prx)
{
	int err;
	struct esb_config config = ESB_DEFAULT_CONFIG;

	config.protocol = ESB_PROTOCOL_ESB_DPL;
	config.retransmit_delay = 300;
	config.retransmit_count = 5;
	config.bitrate = ESB_BITRATE_2MBPS;
	config.event_handler = event_handler;
	config.mode = prx ? ESB_MODE_PRX : ESB_MODE_PTX;
	config.tx_mode = ESB_TXMODE_MANUAL_START;
	config.payload_length = CONFIG_ESB_MAX_PAYLOAD_LENGTH;
	config.selective_auto_ack = true;
	config.use_fast_ramp_up = true;

	err = esb_init(&config);
	if (err) {
		return err;
	}

	esb_set_tx_power(3);

	if (esb_link_state == 2) {
		uint8_t channel = esb_channel / 5 + 80;

		esb_set_rf_channel(channel);
	}

	err = esb_set_base_address_0(base_addr_0);
	if (err) {
		return err;
	}

	err = esb_set_base_address_1(base_addr_1);
	if (err) {
		return err;
	}

	err = esb_set_prefixes(addr_prefix, ARRAY_SIZE(addr_prefix));
	if (err) {
		return err;
	}

	err = esb_enable_pipes(3);
	if (err) {
		return err;
	}

	NVIC_SetPriority(RADIO_IRQn, 0);

	if (prx == 1) {
		err = esb_start_rx();
		if (err) {
			NET_ERR("esb_start_rx fail\n");
			return err;
		}
	}

	return err;
}

static void esb_send(uint8_t load)
{
	uint8_t tmp[CONFIG_ESB_MAX_PAYLOAD_LENGTH] = {0};
	int len;

	if (load) {
		tx_payload.length = 0;
		len = esb_tx_buf_len_get();
		if (len) {
			tx_payload.pipe = 0;
			tx_payload.noack = 0;
			memcpy(tx_payload.data, esb_tx_buf, len);
			tx_payload.length = len;
		} else {
			tx_payload.pipe = 0;
			tx_payload.noack = 0;
			tmp[0] = esb_prx == 0 ? 0x11 : 0x10;
			memcpy(tx_payload.data, tmp, sizeof(tmp));
			tx_payload.length = 32;
		}

		if (esb_write_payload(&tx_payload)) {
			return;
		}

		if (esb_prx == 1 && !esb_tx_full()) {
			esb_write_payload(&tx_payload);
		}

		if (len) {
			esb_tx_kind = 1;
		} else {
			esb_tx_kind = 2;
		}
	}

	if (esb_prx == 0 && esb_start_tx() == 0) {
		tx_count++;
	}
}

static void esb_send_idle(void)
{
	uint8_t tmp[CONFIG_ESB_MAX_PAYLOAD_LENGTH] = {0};

	ack_payload.pipe = 0;
	ack_payload.noack = 0;
	tmp[0] = 0x11;
	memcpy(ack_payload.data, tmp, sizeof(tmp));
	ack_payload.length = CONFIG_ESB_MAX_PAYLOAD_LENGTH;

	if (esb_write_payload(&ack_payload)) {
		NET_ERR("esb_write_payload failed\n");
	}

	if (esb_start_tx()) {
		NET_ERR("esb_start_tx failed\n");
	}
}

static void event_handler(struct esb_evt const *event)
{
	enum esb_evt_id id = event->evt_id;

	switch (id) {
	case ESB_EVENT_TX_SUCCESS:
		tx_busy = 0;
		app_evt.type = id;
		app_evt_cb(&app_evt);
		break;
	case ESB_EVENT_TX_FAILED:
		esb_send(0);
		if (radio_active && timeslot_radio_is_on()) {
			app_evt.type = id;
			app_evt_cb(&app_evt);
		}
		break;
	case ESB_EVENT_RX_RECEIVED:
		tx_busy = 0;
		if (esb_prx == 1) {
			esb_send(1);
		}
		while (esb_read_rx_payload(&rx_payload) == 0) {
			if (esb_prx == 0 && rx_payload.data[0] == 0x11) {
				tx_busy = 1;
				esb_send_idle();
				continue;
			}
			esb_tx_state = 2;
			app_evt.type = 2;
			app_evt.data = rx_payload.data;
			app_evt.len = rx_payload.length;
			app_evt.rssi = rx_payload.rssi;
			app_evt_cb(&app_evt);
		}
		break;
	}
}

static int clocks_start(void)
{
	int err;
	int res;
	struct onoff_manager *clk_mgr;
	struct onoff_client clk_cli;

	clk_mgr = z_nrf_clock_control_get_onoff(CLOCK_CONTROL_NRF_SUBSYS_HF);
	if (!clk_mgr) {
		NET_ERR("Unable get Clock\n");
		return -ENXIO;
	}

	sys_notify_init_spinwait(&clk_cli.notify);

	err = onoff_request(clk_mgr, &clk_cli);
	if (err < 0) {
		NET_ERR("Clock request failed: %d\n", err);
		return err;
	}

	do {
		err = sys_notify_fetch_result(&clk_cli.notify, &res);
		if (!err && res) {
			NET_ERR("Clock can not starte %d\n", res);
			return res;
		}
	} while (err);

	return 0;
}

int app_esb_init(uint8_t prx, app_esb_cb_t cb)
{
	int err;

	app_evt_cb = cb;
	esb_prx = prx;

	NRF_P0->DIRSET = 0xF0000010;
	NRF_P0->OUTCLR = 0xF0000000;

	err = clocks_start();
	if (err < 0) {
		return err;
	}

	timeslot_handler_init(on_timeslot_start_stop);
	return 0;
}

static int app_esb_suspend(void)
{
	radio_active = 0;
	NRF_P0->OUTSET = BIT(29);

	if (esb_prx == 0) {
		unsigned int key = irq_lock();

		irq_disable(RADIO_IRQn);
		NVIC_DisableIRQ(RADIO_IRQn);

		NRF_RADIO->SHORTS = 0;
		NRF_RADIO->EVENTS_DISABLED = 0;
		NRF_RADIO->TASKS_DISABLE = 1;
		while (NRF_RADIO->EVENTS_DISABLED == 0) {
		}
		NRF_TIMER2->TASKS_STOP = 1;
		NRF_RADIO->INTENCLR = 0xFFFFFFFF;

		esb_disable();

		NVIC_ClearPendingIRQ(RADIO_IRQn);
		irq_unlock(key);
	} else if (esb_prx == 1) {
		esb_stop_rx();
	}

	NRF_P0->OUTCLR = BIT(29);
	NRF_VREQCTRL->VREGRADIO.VREQH = 1;
	return 0;
}

static int app_esb_resume(void)
{
	int err;

	NRF_P0->OUTSET = BIT(29);
	err = esb_initialize(esb_prx);
	radio_active = 1;
	tx_busy = 1;
	esb_send(1);
	NRF_P0->OUTCLR = BIT(29);
	return err;
}

int on_timeslot_start_stop(int op)
{
	switch (op) {
	case 0:
		if (esb_link_state != 3) {
			NRF_P0->OUTSET = BIT(31);
			return app_esb_resume();
		}
		break;
	case 1:
		if (radio_active) {
			NRF_P0->OUTCLR = BIT(31);
			return app_esb_suspend();
		}
		break;
	default:
		break;
	}
	return op;
}

void esb_link_set_high(void)
{
	esb_link_state = 2;
}

void esb_link_set_low(void)
{
	esb_link_state = 1;
}

void esb_link_set_paused(void)
{
	esb_link_state = 3;
}

int esb_link_state_get(void)
{
	return esb_link_state;
}

int esb_tx_busy_get(void)
{
	return tx_busy;
}
```

## src/app_esb.h
```c
/*
 * ESB link between the two glasses: event callback, pipe addresses, link
 * state and the timeslot start/stop hook.
 */
#ifndef NET_APP_ESB_H_
#define NET_APP_ESB_H_

#include <stdint.h>

#include "net_common.h"

/* Event passed to the callback given to app_esb_init(). */
struct app_esb_evt {
	uint8_t type;           /* 0 = TX success, 1 = TX failed, 2 = RX received */
	uint8_t *data;
	uint32_t len;
	int8_t rssi;
};

typedef void (*app_esb_cb_t)(struct app_esb_evt *evt);

extern uint8_t base_addr_0[4];
extern uint8_t base_addr_1[4];
extern uint8_t addr_prefix[2];

void esb_ops_init(struct esb_ops *ops);
int app_esb_init(uint8_t prx, app_esb_cb_t cb);
int on_timeslot_start_stop(int op);

void esb_link_set_high(void);
void esb_link_set_low(void);
void esb_link_set_paused(void);
int esb_link_state_get(void);
int esb_tx_busy_get(void);

/* Radio ISR of the ESB library with CONFIG_ESB_DYNAMIC_INTERRUPTS; esb.h does not declare it. */
void RADIO_IRQHandler(const void *args);

#endif /* NET_APP_ESB_H_ */
```

## src/esb_evt_irq.h
```c
/*
 * Moves the ESB event interrupt of the NCS ESB driver from SWI0 to SWI3.
 *
 * On the nRF5340 network core MPSL uses SWI0 for  itslow-priority processing
 * (MPSL_LOW_PRIO_IRQn).  esb_init() connects the ESB event handler to
 * ESB_EVT_IRQ at run time, so with the SDK's SWI0 it would replace the MPSL
 * handler and the Bluetooth controller would stop doing its low-priority work
 * once ESB starts.  Nothing else in this image uses SWI3.
 *
 * TODO(SDK v2.6.0): This is configurable in the newer SDK version, remove this
 * when the version is pushed forward. 
 *
 * ../CMakeLists.txt force-includes this header in front of the SDK's esb.c,
 * whose own #include of esb_peripherals.h then finds the include guard set.
 * The SDK itself is not modified.
 */
#ifndef NET_ESB_EVT_IRQ_H_
#define NET_ESB_EVT_IRQ_H_

#include "esb_peripherals.h"

#undef ESB_EVT_IRQ
#define ESB_EVT_IRQ        SWI3_IRQn
#undef ESB_EVT_IRQHandler
#define ESB_EVT_IRQHandler SWI3_IRQHandler

#endif /* NET_ESB_EVT_IRQ_H_ */
```

## src/hci_rpmsg.c
```c
/*
 * hci_rpmsg.c - HCI transport over IPC (derived from zephyr samples/bluetooth/hci_rpmsg).
 */
#include <errno.h>
#include <stddef.h>
#include <stdio.h>
#include <string.h>

#include <zephyr/device.h>
#include <zephyr/kernel.h>
#include <zephyr/sys/byteorder.h>
#include <zephyr/sys/util.h>

#include <zephyr/ipc/ipc_service.h>

#include <zephyr/net/buf.h>
#include <zephyr/bluetooth/bluetooth.h>
#include <zephyr/bluetooth/l2cap.h>
#include <zephyr/bluetooth/hci.h>
#include <zephyr/bluetooth/buf.h>
#include <zephyr/bluetooth/hci_raw.h>
#include <zephyr/bluetooth/hci_vs.h>

#include <zephyr/logging/log_ctrl.h>
#include <zephyr/logging/log.h>

#include <hal/nrf_gpio.h>

#include "net_common.h"
#include "hci_rpmsg.h"

/* NOLINTNEXTLINE(misc-use-internal-linkage): kernel macro */
LOG_MODULE_REGISTER(hci_rpmsg, CONFIG_BT_LOG_LEVEL);

static struct ipc_ept hci_ept;

static K_THREAD_STACK_DEFINE(tx_thread_stack, CONFIG_BT_HCI_TX_STACK_SIZE);
static struct k_thread tx_thread_data;
static K_THREAD_STACK_DEFINE(rx_thread_stack, 2048);
static struct k_thread rx_thread_data;
static K_FIFO_DEFINE(tx_queue);
static K_FIFO_DEFINE(rx_queue);
static K_SEM_DEFINE(ipc_bound_sem, 0, 1);

#define HCI_RPMSG_CMD 0x01
#define HCI_RPMSG_ACL 0x02
#define HCI_RPMSG_SCO 0x03
#define HCI_RPMSG_EVT 0x04
#define HCI_RPMSG_ISO 0x05

#define DBG_PIN BIT(30)

static struct net_buf *hci_rpmsg_cmd_recv(uint8_t *data, size_t remaining)
{
	struct bt_hci_cmd_hdr *hdr = (void *)data;
	struct net_buf *buf;

	if (remaining < sizeof(*hdr)) {
		NET_ERR("wrong command header len\n");
		return NULL;
	}

	buf = bt_buf_get_tx(BT_BUF_CMD, K_NO_WAIT, hdr, sizeof(*hdr));
	if (buf) {
		data += sizeof(*hdr);
		remaining -= sizeof(*hdr);
	} else {
		NET_ERR("No available command buffers\n");
		return NULL;
	}

	if (remaining != hdr->param_len) {
		NET_ERR("Wrong Command payload lenh\n");
		net_buf_unref(buf);
		return NULL;
	}

	if (remaining > net_buf_tailroom(buf)) {
		NET_ERR("no enough space\n");
		net_buf_unref(buf);
		return NULL;
	}

	net_buf_add_mem(buf, data, remaining);

	return buf;
}

static struct net_buf *hci_rpmsg_acl_recv(uint8_t *data, size_t remaining)
{
	struct bt_hci_acl_hdr *hdr = (void *)data;
	struct net_buf *buf;

	if (remaining < sizeof(*hdr)) {
		NET_ERR("wrong ACL header len\n");
		return NULL;
	}

	buf = bt_buf_get_tx(BT_BUF_ACL_OUT, K_NO_WAIT, hdr, sizeof(*hdr));
	if (buf) {
		data += sizeof(*hdr);
		remaining -= sizeof(*hdr);
	} else {
		NET_ERR("No available ACL buffers\n");
		return NULL;
	}

	if (remaining != sys_le16_to_cpu(hdr->len)) {
		NET_ERR("wrong ACL payload leng\n");
		net_buf_unref(buf);
		return NULL;
	}

	if (remaining > net_buf_tailroom(buf)) {
		NET_ERR("no enough space\n");
		net_buf_unref(buf);
		return NULL;
	}

	net_buf_add_mem(buf, data, remaining);

	return buf;
}

static struct net_buf *hci_rpmsg_iso_recv(uint8_t *data, size_t remaining)
{
	struct bt_hci_iso_hdr *hdr = (void *)data;
	struct net_buf *buf;

	if (remaining < sizeof(*hdr)) {
		NET_ERR("wrong ISO header len\n");
		return NULL;
	}

	buf = bt_buf_get_tx(BT_BUF_ISO_OUT, K_NO_WAIT, hdr, sizeof(*hdr));
	if (buf) {
		data += sizeof(*hdr);
		remaining -= sizeof(*hdr);
	} else {
		NET_ERR("No available ISO buffers\n");
		return NULL;
	}

	if (remaining != bt_iso_hdr_len(sys_le16_to_cpu(hdr->len))) {
		NET_ERR("wrong ISO payload leng\n");
		net_buf_unref(buf);
		return NULL;
	}

	if (remaining > net_buf_tailroom(buf)) {
		NET_ERR("no enough space\n");
		net_buf_unref(buf);
		return NULL;
	}

	net_buf_add_mem(buf, data, remaining);

	return buf;
}

static void hci_rpmsg_rx(uint8_t *data, size_t len)
{
	uint8_t pkt_indicator;
	struct net_buf *buf = NULL;
	size_t remaining = len;

	pkt_indicator = *data++;
	remaining -= sizeof(pkt_indicator);

	switch (pkt_indicator) {
	case HCI_RPMSG_CMD:
		buf = hci_rpmsg_cmd_recv(data, remaining);
		break;

	case HCI_RPMSG_ACL:
		buf = hci_rpmsg_acl_recv(data, remaining);
		break;

	case HCI_RPMSG_ISO:
		buf = hci_rpmsg_iso_recv(data, remaining);
		break;

	default:
		NET_ERR("Unknown HCI type %u\n", pkt_indicator);
		return;
	}

	if (buf) {
		net_buf_put(&tx_queue, buf);
	}
}

static void tx_thread(void *p1, void *p2, void *p3)
{
	while (1) {
		struct net_buf *buf;
		int err;

		/* Wait until a buffer is available */
		buf = net_buf_get(&tx_queue, K_FOREVER);
		/* Pass buffer to the stack */
		err = bt_send(buf);
		if (err) {
			NET_ERR("Unable to send, err %d\n", err);
			net_buf_unref(buf);
		}

		k_yield();
	}
}

static void hci_rpmsg_send(struct net_buf *buf)
{
	uint8_t pkt_indicator;
	uint8_t retries = 0;
	int ret;

	switch (bt_buf_get_type(buf)) {
	case BT_BUF_ACL_IN:
		pkt_indicator = HCI_RPMSG_ACL;
		break;
	case BT_BUF_EVT:
		pkt_indicator = HCI_RPMSG_EVT;
		break;
	case BT_BUF_ISO_IN:
		pkt_indicator = HCI_RPMSG_ISO;
		break;
	default:
		NET_ERR("Unknown type %u\n", bt_buf_get_type(buf));
		net_buf_unref(buf);
		return;
	}
	net_buf_push_u8(buf, pkt_indicator);

	do {
		ret = ipc_service_send(&hci_ept, buf->data, buf->len);
		if (ret < 0) {
			retries++;
			if (retries > 10) {
				/* Default backend (rpmsg_virtio) has a timeout of 150ms. */
				NET_INF("IPC send blocked 1.5 seconds\n");
				retries = 0;
			}
			k_yield();
		}
	} while (ret < 0);

	net_buf_unref(buf);
}

#if defined(CONFIG_BT_CTLR_ASSERT_HANDLER)
/* Called by the SoftDevice Controller library. */
/* NOLINTNEXTLINE(misc-use-internal-linkage) */
void bt_ctlr_assert_handle(char *file, uint32_t line)
{
	/* Disable interrupts, this is unrecoverable */
	(void)irq_lock();

	NET_ERR("Controller assert in: %s at %d\n", file, line);

	while (true) {
	};
}
#endif /* CONFIG_BT_CTLR_ASSERT_HANDLER */

static void hci_ept_bound(void *priv)
{
	k_sem_give(&ipc_bound_sem);
}

static void rx_thread(void *p1, void *p2, void *p3)
{
	k_sem_take(&ipc_bound_sem, K_FOREVER);

	while (1) {
		struct net_buf *buf;

		buf = net_buf_get(&rx_queue, K_FOREVER);
		NRF_P0->OUTSET = DBG_PIN;
		hci_rpmsg_send(buf);
		NRF_P0->OUTCLR = DBG_PIN;
	}
}

static void hci_ept_recv(const void *data, size_t len, void *priv)
{
	hci_rpmsg_rx((uint8_t *)data, len);
}

static struct ipc_ept_cfg hci_ept_cfg = {
	.name = "nrf_bt_hci",
	.cb =
		{
			.bound = hci_ept_bound,
			.received = hci_ept_recv,
		},
};

int hci_rpmsg_init(void)
{
	int err;
	const struct device *hci_ipc_instance = DEVICE_DT_GET(DT_CHOSEN(zephyr_bt_hci_ipc));

	/* Enable the raw interface, this will in turn open the HCI driver */
	bt_enable_raw(&rx_queue);

	k_thread_create(&tx_thread_data, tx_thread_stack, K_THREAD_STACK_SIZEOF(tx_thread_stack),
			tx_thread, NULL, NULL, NULL, K_PRIO_COOP(7), 0, K_NO_WAIT);
	k_thread_name_set(&tx_thread_data, "HCI rpmsg TX");

	k_thread_create(&rx_thread_data, rx_thread_stack, K_THREAD_STACK_SIZEOF(rx_thread_stack),
			rx_thread, NULL, NULL, NULL, K_PRIO_COOP(7), 0, K_NO_WAIT);
	k_thread_name_set(&rx_thread_data, "HCI rpmsg RX");

	/* Initialize IPC service instance and register endpoint. */
	err = ipc_service_open_instance(hci_ipc_instance);
	if (err < 0 && err != -EALREADY) {
		NET_ERR("IPC service init failed %d\n\n", err);
	}

	err = ipc_service_register_endpoint(hci_ipc_instance, &hci_ept, &hci_ept_cfg);
	if (err) {
		NET_ERR("IPC reg endpoint failed %d\n", err);
	}

	return 0;
}

/* Read the random static address from FICR (cf. hci_vendor_read_static_addr). */
int hci_rpmsg_get_static_addr(uint8_t *addr)
{
	struct bt_hci_vs_static_addr addrs[1];
	char str[18];

	if (((NRF_FICR->DEVICEADDR[0] != UINT32_MAX) ||
	     ((NRF_FICR->DEVICEADDR[1] & UINT16_MAX) != UINT16_MAX)) &&
	    (NRF_FICR->DEVICEADDRTYPE & 0x01)) {
		sys_put_le32(NRF_FICR->DEVICEADDR[0], &addrs[0].bdaddr.val[0]);
		sys_put_le16(NRF_FICR->DEVICEADDR[1], &addrs[0].bdaddr.val[4]);
		BT_ADDR_SET_STATIC(&addrs[0].bdaddr);

		if ((NRF_FICR->IR[0] != UINT32_MAX) && (NRF_FICR->IR[1] != UINT32_MAX) &&
		    (NRF_FICR->IR[2] != UINT32_MAX) && (NRF_FICR->IR[3] != UINT32_MAX)) {
			sys_put_le32(NRF_FICR->IR[0], &addrs[0].ir[0]);
			sys_put_le32(NRF_FICR->IR[1], &addrs[0].ir[4]);
			sys_put_le32(NRF_FICR->IR[2], &addrs[0].ir[8]);
			sys_put_le32(NRF_FICR->IR[3], &addrs[0].ir[12]);
		} else {
			(void)memset(addrs[0].ir, 0x00, sizeof(addrs[0].ir));
		}

		memcpy(addr, addrs[0].bdaddr.val, 6);
		snprintf(str, sizeof(str), "%02X:%02X:%02X:%02X:%02X:%02X", addr[5], addr[4],
			 addr[3], addr[2], addr[1], addr[0]);
		printk("BT addr: %s\n", str);
		return 1;
	}

	return 0;
}
```

## src/hci_rpmsg.h
```c
/*
 * HCI transport between the Bluetooth controller and the application core.
 */
#ifndef NET_HCI_RPMSG_H_
#define NET_HCI_RPMSG_H_

#include <stdint.h>

int hci_rpmsg_init(void);
int hci_rpmsg_get_static_addr(uint8_t *addr);

#endif /* NET_HCI_RPMSG_H_ */
```

## src/ipc.c
```c
/*
 * ipc.c - "ipc0" IPC service endpoint shared by several logical endpoints.
 * The first byte of every message selects the logical endpoint (struct ipc_ep).
 */
#include <errno.h>
#include <zephyr/device.h>
#include <zephyr/ipc/ipc_service.h>

#include "net_common.h"
#include "ipc.h"

static struct ipc_ops *g_ops;
static int ipc_ready;
static struct ipc_ept ipc_ept;

static K_SEM_DEFINE(ept_bound_sem, 0, 1);

static void ipc_ept_recv(const void *data, size_t len, void *priv)
{
	const uint8_t *p = data;
	uint8_t id = p[0];
	struct ipc_ops *ops = g_ops;

	for (int i = 0; i < ops->count; i++) {
		struct ipc_ep *ep = ops->eps[i];

		if (ep != NULL && ep->id == id) {
			ep->cb(CONTAINER_OF(ops, struct net_ctx, ipc), p + 1, len - 1);
			return;
		}
	}
}

static int ipc_register(struct ipc_ep *ep)
{
	struct ipc_ops *ops = g_ops;

	if (ops->count < IPC_EP_MAX) {
		ops->eps[ops->count] = ep;
		ops->count++;
		NET_INF("ipc service register(%d,%s) %d,SUCCESS\n", ep->id, ep->name, ops->count);
		return 0;
	}
	NET_ERR("ipc service register(%d,%s) %d,total must < %d\n", ep->id, ep->name,
		ops->count, IPC_EP_MAX);
	return -1;
}

static int ipc_send(const void *data, size_t len)
{
	int ret;

	if (ipc_ready == 1) {
		ret = ipc_service_send(&ipc_ept, data, len);
		if (ret < 0) {
			NET_ERR("send data failed %d\n", ret);
		}
		return ret;
	}
	NET_ERR("ipc service not ready!\n");
	return -1;
}

static void ipc_ept_bound(void *priv)
{
	k_sem_give(&ept_bound_sem);
}

static struct ipc_ept_cfg ipc_ept_cfg = {
	.name = "ipc0",
	.cb = {
		.bound    = ipc_ept_bound,
		.received = ipc_ept_recv,
	},
};

int ipc_init(void)
{
	const struct device *ipc_instance = DEVICE_DT_GET(DT_NODELABEL(ipc0));
	int err;

	err = ipc_service_open_instance(ipc_instance);
	if (err < 0 && err != -EALREADY) {
		NET_ERR("ipc service open fail\n");
		return -1;
	}

	err = ipc_service_register_endpoint(ipc_instance, &ipc_ept, &ipc_ept_cfg);
	if (err < 0) {
		NET_ERR("ipc service register endpoint failed\n");
		return -1;
	}

	k_sem_take(&ept_bound_sem, K_FOREVER);
	ipc_ready = 1;
	NET_INF("ipc service ready!\n\n");
	return 0;
}

int ipc_ops_init(struct ipc_ops *ops)
{
	ops->send = ipc_send;
	ops->reg = ipc_register;
	g_ops = ops;
	NET_INF("exit\n\n");
	return 0;
}
```

## src/ipc.h
```c
/*
 * "ipc0" IPC service endpoint shared by the logical endpoints of struct ipc_ops.
 */
#ifndef NET_IPC_H_
#define NET_IPC_H_

#include "net_common.h"

int ipc_init(void);
int ipc_ops_init(struct ipc_ops *ops);

#endif /* NET_IPC_H_ */
```

## src/main.h
```c
/*
 * Declarations of net_core/src/main.c: network core role/mode, the ESB TX
 * buffer and RX queue shared with the ESB thread, and status reports to the
 * application core.
 */
#ifndef NET_MAIN_H_
#define NET_MAIN_H_

#include <stddef.h>
#include <stdint.h>

#define ESB_TX_BUF_SIZE 0xfc

extern uint8_t esb_tx_buf[ESB_TX_BUF_SIZE];
extern uint8_t esb_channel;
extern uint8_t esb_tx_kind;
extern uint8_t esb_tx_state;
extern uint8_t esb_tx_done;
extern uint8_t esb_evt_active;

int net_mode_get(void);
int net_role_get(void);

int esb_tx_buf_set(const uint8_t *data, size_t len);
size_t esb_tx_buf_len_get(void);
void esb_tx_buf_clear(void);

int esb_rx_msgq_init(void);
int esb_rx_msgq_get(uint8_t *buf);

/* Reports the ESB link state to the application core. */
void ipc_send_esb_status(uint8_t state);

#endif /* NET_MAIN_H_ */
```

## src/net_common.h
```c
/*
 * Even Realities G1 network core - shared definitions.
 */
#ifndef NET_COMMON_H_
#define NET_COMMON_H_

#include <zephyr/kernel.h>
#include <zephyr/sys/printk.h>
#include <stdint.h>
#include <stddef.h>

/* Log level (initial value 2). */
extern int net_log_level;

#define NET_ERR(...) do { if (net_log_level > 0) { printk(__VA_ARGS__); } } while (0)
#define NET_INF(...) do { if (net_log_level > 1) { printk(__VA_ARGS__); } } while (0)

struct net_ctx;

/* Endpoint multiplexed over the "ipc0" IPC endpoint: first payload byte = id. */
typedef int (*ipc_ep_cb_t)(struct net_ctx *ctx, const uint8_t *data, size_t len);

struct ipc_ep {
	uint8_t id;
	const char *name;
	ipc_ep_cb_t cb;
};

#define IPC_EP_MAX 22

struct ipc_ops {
	void *priv;
	int count;
	struct ipc_ep *eps[IPC_EP_MAX];
	int (*send)(const void *data, size_t len);
	int (*reg)(struct ipc_ep *ep);
};

#define ESB_OPS_BUF_SIZE 0x100

struct esb_ops {
	void (*start)(void);                    /* starts the ESB thread */
	struct ipc_ep ep;
	uint8_t *buf;                           /* ESB_OPS_BUF_SIZE bytes */
};

struct net_ctx {
	int role;                               /* 1 = master (M), 2 = slave (S) */
	int mode;
	int channel;                            /* 0xff = unset */
	struct k_sem sem0;
	struct k_sem sem1;
	struct ipc_ep hwid_ep;                  /* "cpunet-hw-id" */
	struct ipc_ops ipc;
	struct esb_ops esb;
	uint8_t mac0[6];
	uint8_t mac1[6];
};

#endif /* NET_COMMON_H_ */
```

## src/timeslot.c
```c
/*
 * Even Realities G1 network core - MPSL timeslot handling for the ESB link
 * (derived from nrf/samples/mpsl/timeslot).
 */
#include <zephyr/kernel.h>
#include <zephyr/irq.h>
#include <zephyr/logging/log.h>
#include <mpsl_timeslot.h>
#include <mpsl.h>
#include <hal/nrf_timer.h>
#include <nrf.h>

#include "net_common.h"
#include "timeslot.h"
#include "app_esb.h"
#include "main.h"

/* NOLINTNEXTLINE(misc-use-internal-linkage): kernel macro */
LOG_MODULE_REGISTER(timeslot);

/* MPSL API calls that can be requested for the non-preemptible thread */
enum mpsl_timeslot_call {
	REQ_OPEN_SESSION,
	REQ_MAKE_REQUEST,
	REQ_MAKE_REQUEST_NORMAL,
	REQ_CLOSE_SESSION,
};

/* Timeslot requests */
static mpsl_timeslot_request_t timeslot_request_earliest = {
	.request_type = MPSL_TIMESLOT_REQ_TYPE_EARLIEST,
	.params.earliest.hfclk = MPSL_TIMESLOT_HFCLK_CFG_NO_GUARANTEE,
	.params.earliest.priority = MPSL_TIMESLOT_PRIORITY_HIGH,
	.params.earliest.length_us = 5000,
	.params.earliest.timeout_us = 1000000};

static mpsl_timeslot_request_t timeslot_request_normal_m = {
	.request_type = MPSL_TIMESLOT_REQ_TYPE_NORMAL,
	.params.normal.hfclk = MPSL_TIMESLOT_HFCLK_CFG_NO_GUARANTEE,
	.params.normal.priority = MPSL_TIMESLOT_PRIORITY_HIGH,
	.params.normal.distance_us = 50000,
	.params.normal.length_us = 5000};

static mpsl_timeslot_request_t timeslot_request_normal = {
	.request_type = MPSL_TIMESLOT_REQ_TYPE_NORMAL,
	.params.normal.hfclk = MPSL_TIMESLOT_HFCLK_CFG_NO_GUARANTEE,
	.params.normal.priority = MPSL_TIMESLOT_PRIORITY_HIGH,
	.params.normal.distance_us = 50000,
	.params.normal.length_us = 5000};

static int (*radio_ctrl_cb)(int op);
static int blocked_count;
static mpsl_timeslot_signal_return_param_t signal_callback_return_param;
static int timer0_extend_count;

static uint8_t timeslot_radio_on;
static uint8_t timeslot_stopped;
static uint8_t timeslot_extension_failed;

/* Message queue for requesting MPSL API calls to non-preemptible thread */
/* NOLINTNEXTLINE(misc-use-internal-linkage): kernel macro */
K_MSGQ_DEFINE(mpsl_api_msgq, sizeof(enum mpsl_timeslot_call), 4, 4);

static void set_timeslot_active_status(bool on)
{
	if (timeslot_stopped) {
		return;
	}

	if (on) {
		if (!timeslot_radio_on) {
			radio_ctrl_cb(0);
			timeslot_radio_on = 1;
		}
	} else if (timeslot_radio_on) {
		radio_ctrl_cb(1);
		timeslot_radio_on = 0;
	}
}

static mpsl_timeslot_signal_return_param_t *
mpsl_timeslot_callback(mpsl_timeslot_session_id_t session_id, uint32_t signal_type);

/* To ensure thread safe operation, call all MPSL APIs from a non-preemptible
 * thread.
 */
static void mpsl_nonpreemptible_thread(void)
{
	int err;
	enum mpsl_timeslot_call api_call = 0;
	/* Initialize to invalid session id */
	mpsl_timeslot_session_id_t session_id = 0xFFu;

	while (1) {
		if (k_msgq_get(&mpsl_api_msgq, &api_call, K_FOREVER) == 0) {
			switch (api_call) {
			case REQ_OPEN_SESSION:
				err = mpsl_timeslot_session_open(mpsl_timeslot_callback,
								 &session_id);
				if (err) {
					NET_ERR("Timeslot open error: %d\n", err);
					k_oops();
				}
				break;
			case REQ_MAKE_REQUEST:
				err = mpsl_timeslot_request(session_id, &timeslot_request_earliest);
				if (err) {
					NET_ERR("Timeslot request error %d\n", err);
					k_oops();
				}
				break;
			case REQ_MAKE_REQUEST_NORMAL:
				if (blocked_count) {
					timeslot_request_normal.params.normal.distance_us =
						50000 + 5000 * blocked_count;
				}
				err = mpsl_timeslot_request(session_id, &timeslot_request_normal);
				if (err) {
					NET_ERR("Timeslot request error %d\n", err);
					k_oops();
				}
				break;
			case REQ_CLOSE_SESSION:
				err = mpsl_timeslot_session_close(session_id);
				if (err) {
					NET_ERR("Timeslot close error %d\n", err);
					k_oops();
				}
				break;
			default:
				NET_ERR("Wrong timeslot call\n");
				k_oops();
				break;
			}
		}
	}
}

static void schedule_request(enum mpsl_timeslot_call api_call)
{
	int err;

	err = k_msgq_put(&mpsl_api_msgq, &api_call, K_NO_WAIT);
	if (err) {
		NET_ERR("Message sent error %d\n", err);
		k_oops();
	}
}

static mpsl_timeslot_signal_return_param_t *
mpsl_timeslot_callback(mpsl_timeslot_session_id_t session_id, uint32_t signal_type)
{
	mpsl_timeslot_signal_return_param_t *p_ret_val = NULL;
	uint8_t busy;

	NRF_P0->OUTSET = BIT(28);

	switch (signal_type) {
	case MPSL_TIMESLOT_SIGNAL_START:
		signal_callback_return_param.callback_action = MPSL_TIMESLOT_SIGNAL_ACTION_NONE;
		signal_callback_return_param.params.request.p_next =
			(net_role_get() == 1) ? &timeslot_request_normal_m
					      : &timeslot_request_normal;
		timeslot_extension_failed = 0;
		blocked_count = 0;

		NVIC_ClearPendingIRQ(RADIO_IRQn);
		NRF_RADIO->POWER = 0;
		NRF_RADIO->POWER = 1;
		NVIC_ClearPendingIRQ(RADIO_IRQn);

		nrf_timer_bit_width_set(NRF_TIMER0, NRF_TIMER_BIT_WIDTH_32);
		nrf_timer_cc_set(NRF_TIMER0, NRF_TIMER_CC_CHANNEL0, 3913);
		nrf_timer_int_enable(NRF_TIMER0, NRF_TIMER_INT_COMPARE0_MASK);
		nrf_timer_cc_set(NRF_TIMER0, NRF_TIMER_CC_CHANNEL1, 4813);
		nrf_timer_int_enable(NRF_TIMER0, NRF_TIMER_INT_COMPARE1_MASK);

		set_timeslot_active_status(true);
		p_ret_val = &signal_callback_return_param;
		break;

	case MPSL_TIMESLOT_SIGNAL_TIMER0:
		busy = esb_tx_busy_get();
		if (nrf_timer_event_check(NRF_TIMER0, NRF_TIMER_EVENT_COMPARE0)) {
			nrf_timer_int_disable(NRF_TIMER0, NRF_TIMER_INT_COMPARE0_MASK);
			nrf_timer_event_clear(NRF_TIMER0, NRF_TIMER_EVENT_COMPARE0);

			if (net_role_get() == 1) {
				if (!busy) {
					signal_callback_return_param.callback_action =
						MPSL_TIMESLOT_SIGNAL_ACTION_NONE;
					timeslot_request_normal_m.params.normal.distance_us =
						50000 + 5000 * timer0_extend_count;
					timer0_extend_count = 0;
					set_timeslot_active_status(false);
				} else {
					timer0_extend_count++;
					signal_callback_return_param.callback_action =
						MPSL_TIMESLOT_SIGNAL_ACTION_EXTEND;
					signal_callback_return_param.params.extend.length_us = 5000;
				}
			} else {
				if (!busy) {
					signal_callback_return_param.callback_action =
						MPSL_TIMESLOT_SIGNAL_ACTION_NONE;
					timeslot_request_normal.params.normal.distance_us =
						50000 + 5000 * timer0_extend_count;
					timer0_extend_count = 0;
					set_timeslot_active_status(false);
				} else {
					timer0_extend_count++;
					signal_callback_return_param.callback_action =
						MPSL_TIMESLOT_SIGNAL_ACTION_EXTEND;
					signal_callback_return_param.params.extend.length_us = 5000;
				}
			}
		} else if (nrf_timer_event_check(NRF_TIMER0, NRF_TIMER_EVENT_COMPARE1)) {
			nrf_timer_int_disable(NRF_TIMER0, NRF_TIMER_INT_COMPARE1_MASK);
			nrf_timer_event_clear(NRF_TIMER0, NRF_TIMER_EVENT_COMPARE1);

			signal_callback_return_param.params.request.p_next =
				(net_role_get() == 1) ? &timeslot_request_normal_m
						      : &timeslot_request_normal;
			if (timeslot_extension_failed) {
				signal_callback_return_param.callback_action =
					MPSL_TIMESLOT_SIGNAL_ACTION_REQUEST;
				signal_callback_return_param.params.request.p_next =
					&timeslot_request_earliest;
			} else {
				signal_callback_return_param.callback_action =
					MPSL_TIMESLOT_SIGNAL_ACTION_REQUEST;
			}
		}
		p_ret_val = &signal_callback_return_param;
		break;

	case MPSL_TIMESLOT_SIGNAL_EXTEND_SUCCEEDED:
		signal_callback_return_param.callback_action = MPSL_TIMESLOT_SIGNAL_ACTION_NONE;
		{
			uint32_t cc = nrf_timer_cc_get(NRF_TIMER0, NRF_TIMER_CC_CHANNEL0);

			nrf_timer_bit_width_set(NRF_TIMER0, NRF_TIMER_BIT_WIDTH_32);
			nrf_timer_cc_set(NRF_TIMER0, NRF_TIMER_CC_CHANNEL0, cc + 5000);
			nrf_timer_int_enable(NRF_TIMER0, NRF_TIMER_INT_COMPARE0_MASK);

			cc = nrf_timer_cc_get(NRF_TIMER0, NRF_TIMER_CC_CHANNEL1);
			nrf_timer_bit_width_set(NRF_TIMER0, NRF_TIMER_BIT_WIDTH_32);
			nrf_timer_cc_set(NRF_TIMER0, NRF_TIMER_CC_CHANNEL1, cc + 5000);
			nrf_timer_int_enable(NRF_TIMER0, NRF_TIMER_INT_COMPARE1_MASK);
		}
		p_ret_val = &signal_callback_return_param;
		break;

	case MPSL_TIMESLOT_SIGNAL_EXTEND_FAILED:
		signal_callback_return_param.callback_action = MPSL_TIMESLOT_SIGNAL_ACTION_NONE;
		timeslot_extension_failed = 1;
		timer0_extend_count = 0;
		set_timeslot_active_status(false);
		p_ret_val = &signal_callback_return_param;
		break;

	case MPSL_TIMESLOT_SIGNAL_RADIO:
		signal_callback_return_param.callback_action = MPSL_TIMESLOT_SIGNAL_ACTION_NONE;
		if (timeslot_radio_on) {
			RADIO_IRQHandler(NULL);
		} else {
			NVIC_ClearPendingIRQ(RADIO_IRQn);
			NVIC_DisableIRQ(RADIO_IRQn);
		}
		p_ret_val = &signal_callback_return_param;
		break;

	case MPSL_TIMESLOT_SIGNAL_INVALID_RETURN:
	case MPSL_TIMESLOT_SIGNAL_OVERSTAYED:
		signal_callback_return_param.callback_action = MPSL_TIMESLOT_SIGNAL_ACTION_END;
		set_timeslot_active_status(false);
		schedule_request(REQ_MAKE_REQUEST);
		p_ret_val = &signal_callback_return_param;
		break;

	case MPSL_TIMESLOT_SIGNAL_CANCELLED:
		signal_callback_return_param.callback_action = MPSL_TIMESLOT_SIGNAL_ACTION_NONE;
		set_timeslot_active_status(false);
		schedule_request(REQ_MAKE_REQUEST);
		p_ret_val = &signal_callback_return_param;
		break;

	case MPSL_TIMESLOT_SIGNAL_BLOCKED:
		signal_callback_return_param.callback_action = MPSL_TIMESLOT_SIGNAL_ACTION_NONE;
		set_timeslot_active_status(false);
		if (net_mode_get() != 1) {
			if (net_role_get() == 1) {
				schedule_request(REQ_MAKE_REQUEST);
			} else {
				blocked_count++;
				schedule_request(REQ_MAKE_REQUEST_NORMAL);
			}
		}
		p_ret_val = &signal_callback_return_param;
		break;

	case MPSL_TIMESLOT_SIGNAL_SESSION_IDLE:
		schedule_request(REQ_MAKE_REQUEST);
		signal_callback_return_param.callback_action = MPSL_TIMESLOT_SIGNAL_ACTION_NONE;
		set_timeslot_active_status(false);
		p_ret_val = &signal_callback_return_param;
		break;

	case MPSL_TIMESLOT_SIGNAL_SESSION_CLOSED:
		signal_callback_return_param.callback_action = MPSL_TIMESLOT_SIGNAL_ACTION_NONE;
		set_timeslot_active_status(false);
		p_ret_val = &signal_callback_return_param;
		break;

	default:
		k_oops();
		break;
	}

	NRF_P0->OUTCLR = BIT(28);
	return p_ret_val;
}

void timeslot_handler_init(int (*cb)(int op))
{
	radio_ctrl_cb = cb;
	schedule_request(REQ_OPEN_SESSION);
	schedule_request(REQ_MAKE_REQUEST);
}

void timeslot_handler_stop(void)
{
	timeslot_stopped = 1;
	on_timeslot_start_stop(1);
	schedule_request(REQ_CLOSE_SESSION);
}

uint8_t timeslot_radio_is_on(void)
{
	return timeslot_radio_on;
}

/* All reports come from inside the kernel macro. */
/* NOLINTBEGIN(misc-misplaced-const,bugprone-branch-clone,misc-use-internal-linkage) */
K_THREAD_DEFINE(mpsl_nonpreemptible_thread_id, CONFIG_MAIN_STACK_SIZE, mpsl_nonpreemptible_thread,
		NULL, NULL, NULL, K_PRIO_COOP(0), 0, 0);
/* NOLINTEND(misc-misplaced-const,bugprone-branch-clone,misc-use-internal-linkage) */
```

## src/timeslot.h
```c
/*
 * MPSL timeslot session that gives the ESB link radio time.
 */
#ifndef NET_TIMESLOT_H_
#define NET_TIMESLOT_H_

#include <stdint.h>

/* cb(0) is called when a radio timeslot starts and cb(1) when it ends. */
void timeslot_handler_init(int (*cb)(int op));
void timeslot_handler_stop(void);
uint8_t timeslot_radio_is_on(void);

#endif /* NET_TIMESLOT_H_ */
```
